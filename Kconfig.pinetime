## Kconfig.pinetime
```kconfig
menu "Pinetime"

rsource "drivers/sensor/Kconfig"
rsource "subsys/Kconfig"

endmenu
```

## app/build/Kconfig/Kconfig.modules
```kconfig
menu "hal_nordic (/root/work/zephyrproject/modules/hal/nordic)"
osource "$(ZEPHYR_HAL_NORDIC_KCONFIG)"
config ZEPHYR_HAL_NORDIC_MODULE
	bool
	default y
endmenu
menu "mbedtls (/root/work/zephyrproject/modules/crypto/mbedtls)"
osource "$(ZEPHYR_MBEDTLS_KCONFIG)"
config ZEPHYR_MBEDTLS_MODULE
	bool
	default y
endmenu
menu "sof (/root/work/zephyrproject/modules/audio/sof)"
osource "/root/work/zephyrproject/modules/audio/sof/zephyr/Kconfig"
config ZEPHYR_SOF_MODULE
	bool
	default y
endmenu
menu "TraceRecorder (/root/work/zephyrproject/modules/debug/TraceRecorder)"
osource "/root/work/zephyrproject/modules/debug/TraceRecorder/kernelports/Zephyr/Kconfig"
config ZEPHYR_TRACERECORDER_MODULE
	bool
	default y
endmenu
menu "trusted-firmware-m (/root/work/zephyrproject/modules/tee/tfm)"
osource "$(ZEPHYR_TRUSTED_FIRMWARE_M_KCONFIG)"
config ZEPHYR_TRUSTED_FIRMWARE_M_MODULE
	bool
	default y
endmenu
menu "nanopb (/root/work/zephyrproject/modules/lib/nanopb)"
osource "$(ZEPHYR_NANOPB_KCONFIG)"
config ZEPHYR_NANOPB_MODULE
	bool
	default y
endmenu
menu "tensorflow (/root/work/zephyrproject/modules/lib/tensorflow)"
osource "$(ZEPHYR_TENSORFLOW_KCONFIG)"
config ZEPHYR_TENSORFLOW_MODULE
	bool
	default y
endmenu
menu "drivers (/root/work/zephyrproject/app/oswatch-lowpower/drivers)"
osource "/root/work/zephyrproject/app/oswatch-lowpower/drivers/zephyr/Kconfig"
config ZEPHYR_DRIVERS_MODULE
	bool
	default y
endmenu
```

## app/build/Kconfig/Kconfig.shield
```kconfig
osource "/root/work/zephyrproject/app/oswatch-lowpower/boards/shields/*/Kconfig.shield"
osource "/root/work/zephyrproject/zephyr/boards/shields/*/Kconfig.shield"
```

## app/build/Kconfig/Kconfig.shield.defconfig
```kconfig
osource "/root/zephyrproject/app/oswatch-motion2/boards/shields/*/Kconfig.defconfig"
```

## app/build/Kconfig/Kconfig.soc.arch
```kconfig
osource "/root/work/zephyrproject/zephyr/soc/$(ARCH)/Kconfig"
osource "/root/work/zephyrproject/zephyr/soc/$(ARCH)/*/Kconfig"
```

## app/oswatch-battery/boards/arm/pinetime_devkit1/Kconfig.defconfig
```kconfig
# PineTime DevKit1 board configuration

# Copyright (c) 2021  <najnesnaj@yahoo.com>
# SPDX-License-Identifier: Apache-2.0

if BOARD_PINETIME_DEVKIT0

config BOARD
	default "pinetime_devkit1"

config BT_CTLR
	default BT

config KSCAN
	default y if LVGL

if KSCAN

config KSCAN_FT5336
        default y

config KSCAN_FT5336_INTERRUPT
        default y

config KSCAN_INIT_PRIORITY
        default 60

endif # KSCAN


if LVGL

config LVGL_DISPLAY_DEV_NAME
        default "ST7789V"

config LVGL_POINTER_KSCAN
        default y

config LVGL_POINTER_KSCAN_DEV_NAME
        default "FT5336"

config LVGL_HOR_RES_MAX
        default 240

config LVGL_VER_RES_MAX
        default 240

config LVGL_VDB_SIZE
        default 16

config LVGL_DPI
        default 128

choice LVGL_COLOR_DEPTH
        default LVGL_COLOR_DEPTH_16
endchoice

endif # LVGL



endif # BOARD_PINETIME_DEVKIT0
```

## app/oswatch-battery/boards/native_posix_64.conf
```kconfig
CONFIG_SDL_DISPLAY_DEV_NAME="DISPLAY"
CONFIG_SDL_DISPLAY_X_RES=300
CONFIG_SDL_DISPLAY_Y_RES=94
CONFIG_KSCAN=y
CONFIG_LVGL_POINTER_KSCAN=y
CONFIG_LVGL_POINTER_KSCAN_DEV_NAME="KSCAN"
CONFIG_SDL_POINTER_KSCAN_DEV_NAME="KSCAN"
CONFIG_CONSOLE=y
CONFIG_UART_CONSOLE=y
CONFIG_UART_CONSOLE_ON_DEV_NAME="UART_0"
CONFIG_UART_NATIVE_POSIX_PORT_1_ENABLE=y
CONFIG_UART_NATIVE_POSIX_PORT_1_NAME="UART_1"
CONFIG_SHELL=y
CONFIG_UART_SHELL_ON_DEV_NAME="UART_0"
```

## app/oswatch-bt/boards/arm/pinetime_devkit1/pinetime_devkit1_defconfig
```kconfig
# SPDX-License-Identifier: Apache-2.0

CONFIG_SOC_SERIES_NRF52X=y
CONFIG_SOC_NRF52832_QFAA=y
CONFIG_BOARD_PINETIME_DEVKIT1=y
CONFIG_HWINFO=y
CONFIG_HWINFO_NRF=y

CONFIG_ARM_MPU=y

CONFIG_GPIO=y

#CONFIG_SERIAL=y

CONFIG_I2C=y

CONFIG_SPI=y

CONFIG_CONSOLE=y
#CONFIG_UART_CONSOLE=y

# use P0.09 and P0.10 as GPIOs
CONFIG_NFCT_PINS_AS_GPIOS=y

# use P0.21 as RST
CONFIG_GPIO_AS_PINRESET=y

CONFIG_LVGL_USE_BTN=y
CONFIG_LVGL_USE_THEME_MATERIAL=n
CONFIG_ST7789V=y
CONFIG_LVGL_VDB_SIZE=2
CONFIG_USE_SEGGER_RTT=y
CONFIG_LVGL_POINTER_KSCAN=y
#CONFIG_LVGL_FONT_MONTSERRAT_28_COMPRESSED=y
CONFIG_LVGL_FONT_UNSCII_8=n
CONFIG_LVGL_USE_THEME_MATERIAL=y
CONFIG_LVGL_THEME_DEFAULT_COLOR_PRIMARY_BLACK=y
CONFIG_LVGL_FONT_MONTSERRAT_28=y
```

## app/oswatch-bt/drivers/zephyr/Kconfig
```kconfig
# SSD1306 display controller configuration options

# Copyright (c) 2018 Phytec Messtechnik GmbH
# Copyright (c) 2021 najnesnaj@yahoo.Com           
# SPDX-License-Identifier: Apache-2.0

config SSD1306NEW
	bool "SSD1306 display driver"
	depends on SPI
        default y
	help
	  Enable driver for SSD1306 display driver.

if SSD1306NEW  

config SSD1306_DEFAULT_CONTRAST
	int "SSD1306 default contrast"
	default 128
	range 0 255
	help
	  SSD16XX default contrast.

choice SSD1306_CONTROLLER_TYPE
	prompt "Display controller type"
	default SSD1306_DEFAULT
	help
	  Specify the type of the controller.

config SSD1306_DEFAULT
	bool "Default SSD1306 controller"

config SSD1306_SH1106_COMPATIBLE
	bool "Enable SH1106 compatible mode"

endchoice

config SSD1306_REVERSE_MODE
	bool "SSD1306 reverse mode"
	help
	  SSD16XX reverse video mode.

endif # SSD1306
```

## app/oswatch-lowpower/boards/arm/ds_d6/Kconfig.defconfig
```kconfig
#
# Copyright (c) 2019 Nordic Semiconductor
#
# SPDX-License-Identifier: LicenseRef-BSD-5-Clause-Nordic
#

if BOARD_DS_D6

config BOARD
	default "ds_d6"

config BT_CTLR
	default BT

endif # BOARD_DS_D6
```

## app/oswatch-motion2/build/Kconfig/Kconfig.modules
```kconfig
menu "CANopenNode (/root/zephyrproject/modules/lib/canopennode)"
osource "$(ZEPHYR_CANOPENNODE_KCONFIG)"
config ZEPHYR_CANOPENNODE_MODULE
	bool
	default y
endmenu
menu "hal_nordic (/root/zephyrproject/modules/hal/nordic)"
osource "$(ZEPHYR_HAL_NORDIC_KCONFIG)"
config ZEPHYR_HAL_NORDIC_MODULE
	bool
	default y
endmenu
menu "hal_nxp (/root/zephyrproject/modules/hal/nxp)"
osource "$(ZEPHYR_HAL_NXP_KCONFIG)"
config ZEPHYR_HAL_NXP_MODULE
	bool
	default y
endmenu
menu "loramac-node (/root/zephyrproject/modules/lib/loramac-node)"
osource "$(ZEPHYR_LORAMAC_NODE_KCONFIG)"
config ZEPHYR_LORAMAC_NODE_MODULE
	bool
	default y
endmenu
menu "lz4 (/root/zephyrproject/modules/lib/lz4)"
osource "$(ZEPHYR_LZ4_KCONFIG)"
config ZEPHYR_LZ4_MODULE
	bool
	default y
endmenu
menu "mbedtls (/root/zephyrproject/modules/crypto/mbedtls)"
osource "$(ZEPHYR_MBEDTLS_KCONFIG)"
config ZEPHYR_MBEDTLS_MODULE
	bool
	default y
endmenu
menu "nanopb (/root/zephyrproject/modules/lib/nanopb)"
osource "$(ZEPHYR_NANOPB_KCONFIG)"
config ZEPHYR_NANOPB_MODULE
	bool
	default y
endmenu
menu "sof (/root/zephyrproject/modules/audio/sof)"
osource "/root/zephyrproject/modules/audio/sof/zephyr/Kconfig"
config ZEPHYR_SOF_MODULE
	bool
	default y
endmenu
menu "tflite-micro (/root/zephyrproject/modules/lib/tflite-micro)"
osource "$(ZEPHYR_TFLITE_MICRO_KCONFIG)"
config ZEPHYR_TFLITE_MICRO_MODULE
	bool
	default y
endmenu
menu "TraceRecorder (/root/zephyrproject/modules/debug/TraceRecorder)"
osource "/root/zephyrproject/modules/debug/TraceRecorder/kernelports/Zephyr/Kconfig"
config ZEPHYR_TRACERECORDER_MODULE
	bool
	default y
endmenu
menu "trusted-firmware-m (/root/zephyrproject/modules/tee/tfm)"
osource "$(ZEPHYR_TRUSTED_FIRMWARE_M_KCONFIG)"
config ZEPHYR_TRUSTED_FIRMWARE_M_MODULE
	bool
	default y
endmenu
menu "drivers (/root/zephyrproject/app/oswatch-motion2/drivers)"
osource "/root/zephyrproject/app/oswatch-motion2/drivers/zephyr/Kconfig"
config ZEPHYR_DRIVERS_MODULE
	bool
	default y
endmenu
```

## app/oswatch/boards/arm/ds_d6/ds_d6_defconfig
```kconfig
CONFIG_SOC_SERIES_NRF52X=y
CONFIG_SOC_NRF52832_QFAA=y
CONFIG_BOARD_DS_D6=y

# Enable MPU
CONFIG_ARM_MPU=y



#CONFIG_GPIO_AS_PINRESET=n

# enable GPIO
CONFIG_GPIO=y

# enable uart driver
CONFIG_SERIAL=y
#CONFIG_UART_0_NRF_UART=y

# enable console
CONFIG_CONSOLE=y
#serial output is not set, to enable RTT
CONFIG_UART_CONSOLE=n

# additional board options
CONFIG_GPIO_AS_PINRESET=y

# bluetooth no external crystal
CONFIG_CLOCK_CONTROL_NRF=y
CONFIG_CLOCK_CONTROL_NRF_K32SRC_RC=y

CONFIG_CLOCK_CONTROL_NRF_K32SRC_XTAL=n
CONFIG_CLOCK_CONTROL_NRF_K32SRC_20PPM=y

CONFIG_SPI=y
CONFIG_SSD1306=y

CONFIG_LOG=y
CONFIG_USE_SEGGER_RTT=y
CONFIG_SHELL=y
CONFIG_SHELL_BACKEND_RTT=y


CONFIG_LVGL=y
CONFIG_LVGL_USE_LABEL=y
CONFIG_LVGL_USE_THEME_MATERIAL=n
CONFIG_LVGL_DISPLAY_DEV_NAME="SSD1306"
CONFIG_LVGL_HOR_RES_MAX=128
CONFIG_LVGL_VER_RES_MAX=32
CONFIG_LVGL_BITS_PER_PIXEL=1
CONFIG_LVGL_COLOR_DEPTH_1=y
CONFIG_LVGL_COLOR_TRANSP_GREEN=y
CONFIG_LVGL_USE_API_EXTENSION_V6=y
CONFIG_LVGL_USE_API_EXTENSION_V7=y
CONFIG_LVGL_USE_THEME_MONO=y
CONFIG_LVGL_THEME_DEFAULT_COLOR_PRIMARY_WHITE=y
CONFIG_LVGL_THEME_DEFAULT_COLOR_SECONDARY_BLACK=y

CONFIG_LVGL_EXT_CLICK_AREA_OFF=y
```

## app/samples/button/sdlbutton2/boards/native_posix_64.conf
```kconfig
CONFIG_SDL_DISPLAY_DEV_NAME="DISPLAY"
CONFIG_SDL_DISPLAY_X_RES=300
CONFIG_SDL_DISPLAY_Y_RES=150
CONFIG_KSCAN=y
CONFIG_LVGL_POINTER_KSCAN=y
CONFIG_LVGL_POINTER_KSCAN_DEV_NAME="KSCAN"
CONFIG_SDL_POINTER_KSCAN_DEV_NAME="KSCAN"
```

## app/samples/button/sdlbutton2/oswatch_drivers/zephyr/Kconfig
```kconfig
# Keyboard scan configuration options

# Copyright (c) 2019 Intel Corporation
# SPDX-License-Identifier: Apache-2.0
# Copyright 2021 <najnesnaj@yahoo.com> 

menuconfig KSCAN2
	bool "Keyboard Scan Drivers"
	help
	  Include Keyboard scan drivers in system config.

if KSCAN2 
menuconfig KSCAN_FT9999
        bool "FT9999 capacitive touch panel driver"
        depends on I2C
        help
          Enable driver for multiple Focaltech capacitive touch panel
          controllers. This driver should support FT5x06, FT5606, FT5x16,
          FT6x06, Ft6x36, FT5x06i, FT9999, FT3316, FT5436i, FT9999i and FT5x46.

if KSCAN_FT9999

config KSCAN_FT9999_PERIOD
        int "Sample period"
        depends on !KSCAN_FT9999_INTERRUPT
        default 10
        help
          Sample period in milliseconds when in polling mode.

config KSCAN_FT9999_INTERRUPT
        bool "Enable interrupt"
        help
          Enable interrupt support (requires GPIO).

endif # KSCAN_FT9999
#source "oswatch/oswatch_drivers/zephyr/Kconfig.ft5336"
#source "oswatch_drivers/zephyr/Kconfig.xec"
#source "oswatch_drivers/zephyr/Kconfig.sdl"

#module = KSCAN
#module-str = kscan
#source "subsys/logging/Kconfig.template.log_config"

config KSCANR2_INIT_PRIORITY
	int "Keyboard scan driver init priority"
	default 40
	help
	  Keyboard scan device driver initialization priority.

endif # KSCAN2
```

## app/samples/cfb/boards/arm/ds_d6/ds_d6_defconfig
```kconfig
CONFIG_SOC_SERIES_NRF52X=y
CONFIG_SOC_NRF52832_QFAA=y
CONFIG_BOARD_DS_D6=y

# Enable MPU
CONFIG_ARM_MPU=y



#CONFIG_GPIO_AS_PINRESET=n

# enable GPIO
CONFIG_GPIO=y

# enable uart driver
CONFIG_SERIAL=y
#CONFIG_UART_0_NRF_UART=y

# enable console
CONFIG_CONSOLE=y
CONFIG_UART_CONSOLE=y

# additional board options
CONFIG_GPIO_AS_PINRESET=y

# bluetooth no external crystal
CONFIG_CLOCK_CONTROL_NRF=y
CONFIG_CLOCK_CONTROL_NRF_K32SRC_RC=y

CONFIG_CLOCK_CONTROL_NRF_K32SRC_XTAL=n
CONFIG_CLOCK_CONTROL_NRF_K32SRC_20PPM=y

CONFIG_SPI=y
CONFIG_SSD1306=y

CONFIG_LOG=y
CONFIG_USE_SEGGER_RTT=y
CONFIG_SHELL=y
CONFIG_SHELL_BACKEND_RTT=y
```

## app/samples/cfb_shell/boards/native_posix_64.conf
```kconfig
CONFIG_SDL_DISPLAY_DEV_NAME="DISPLAY"
CONFIG_SDL_DISPLAY_X_RES=300
CONFIG_SDL_DISPLAY_Y_RES=300
#CONFIG_KSCAN=y
#CONFIG_LVGL_POINTER_KSCAN=y
#CONFIG_LVGL_POINTER_KSCAN_DEV_NAME="KSCAN"
#CONFIG_SDL_POINTER_KSCAN_DEV_NAME="KSCAN"
# enable uart driver
CONFIG_SERIAL=y
#CONFIG_UART_0_NRF_UART=y
CONFIG_CHARACTER_FRAMEBUFFER_SHELL_DRIVER_NAME="DISPLAY"
# enable console
CONFIG_CONSOLE=y
CONFIG_UART_CONSOLE=y
```

## app/samples/lvgl/boards/arm/ds_d6/ds_d6_defconfig
```kconfig
CONFIG_SOC_SERIES_NRF52X=y
CONFIG_SOC_NRF52832_QFAA=y
CONFIG_BOARD_DS_D6=y

# Enable MPU
CONFIG_ARM_MPU=y



#CONFIG_GPIO_AS_PINRESET=n

# enable GPIO
CONFIG_GPIO=y

# enable uart driver
CONFIG_SERIAL=y
#CONFIG_UART_0_NRF_UART=y

# enable console
CONFIG_CONSOLE=y
CONFIG_UART_CONSOLE=y

# additional board options
CONFIG_GPIO_AS_PINRESET=y

# bluetooth no external crystal
CONFIG_CLOCK_CONTROL_NRF=y
CONFIG_CLOCK_CONTROL_NRF_K32SRC_RC=y

CONFIG_CLOCK_CONTROL_NRF_K32SRC_XTAL=n
CONFIG_CLOCK_CONTROL_NRF_K32SRC_20PPM=y

CONFIG_LVGL_DISPLAY_DEV_NAME="SSD1306NEW"
CONFIG_LVGL_HOR_RES_MAX=128
CONFIG_LVGL_VER_RES_MAX=32
CONFIG_LVGL_VDB_SIZE=64
CONFIG_LVGL_BITS_PER_PIXEL=1
CONFIG_LVGL_COLOR_DEPTH_1=y
#CONFIG_LVGL_THEME_MONO=y




CONFIG_SPI=y
#CONFIG_SSD1306=y

CONFIG_LOG=y
CONFIG_USE_SEGGER_RTT=y
CONFIG_SHELL=y
CONFIG_SHELL_BACKEND_RTT=y
```

## app/samples/max44009/boards/arm/ds_d6/Kconfig
```kconfig
#
# Copyright (c) 2019 Nordic Semiconductor
#
# SPDX-License-Identifier: LicenseRef-BSD-5-Clause-Nordic
#

if BOARD_DS_D6

config BOARD_ENABLE_DCDC
	bool "Enable DCDC mode"
	select SOC_DCDC_NRF52X
	default y

config BOARD_VDD_PWR_CTRL_INIT_PRIORITY
        int "VDD power rail init priority"
        default 50
        depends on GPIO
        help
          Initialization priority for the VDD power rail. Has to be greater
          than GPIO_NRF_INIT_PRIORITY.


endif # BOARD_DS_D6
```

## app/samples/pinebutton/boards/arm/ds_d6/Kconfig.board
```kconfig
#
# Copyright (c) 2019 Nordic Semiconductor
#
# SPDX-License-Identifier: LicenseRef-BSD-5-Clause-Nordic
#

config BOARD_DS_D6
	bool "DS_D6"
	depends on SOC_NRF52832_QFAA
```

## app/samples/sdlbutton/oswatch_drivers/zephyr-old/Kconfig
```kconfig
# Keyboard scan configuration options

# Copyright (c) 2019 Intel Corporation
# SPDX-License-Identifier: Apache-2.0
# Copyright 2021 <najnesnaj@yahoo.com> 

menuconfig KSCAN2
	bool "Keyboard Scan Drivers"
	help
	  Include Keyboard scan drivers in system config.

if KSCAN2 
menuconfig KSCAN_FT5336
        bool "FT5XX6/FT6XX6 capacitive touch panel driver"
        depends on I2C
        help
          Enable driver for multiple Focaltech capacitive touch panel
          controllers. This driver should support FT5x06, FT5606, FT5x16,
          FT6x06, Ft6x36, FT5x06i, FT5336, FT3316, FT5436i, FT5336i and FT5x46.

if KSCAN_FT5336

config KSCAN_FT5336_PERIOD
        int "Sample period"
        depends on !KSCAN_FT5336_INTERRUPT
        default 10
        help
          Sample period in milliseconds when in polling mode.

config KSCAN_FT5336_INTERRUPT
        bool "Enable interrupt"
        help
          Enable interrupt support (requires GPIO).

endif # KSCAN_FT5336
#source "oswatch/oswatch_drivers/zephyr/Kconfig.ft5336"
#source "oswatch_drivers/zephyr/Kconfig.xec"
#source "oswatch_drivers/zephyr/Kconfig.sdl"

#module = KSCAN
#module-str = kscan
#source "subsys/logging/Kconfig.template.log_config"

config KSCANR2_INIT_PRIORITY
	int "Keyboard scan driver init priority"
	default 40
	help
	  Keyboard scan device driver initialization priority.

endif # KSCAN2
```

## boards/arm/pinetime/Kconfig
```kconfig
# PINETIME smartwatch configuration

# Copyright (c) 2018 makerdiary.com.
# SPDX-License-Identifier: Apache-2.0

if BOARD_PINETIME     

config BOARD_ENABLE_DCDC
	bool "Enable DCDC mode"
	select SOC_DCDC_NRF52X
	default y

endif # BOARD_PINETIME
```

## boards/arm/pinetime/Kconfig.defconfig
```kconfig
# nRF52832-MDK board configuration

# Copyright (c) 2018 makerdiary.com.
# SPDX-License-Identifier: Apache-2.0

if BOARD_PINETIME     

config BOARD
	default "pinetime"

if I2C

config I2C_1
	default y

endif # I2C

if SPI

config SPI_0
        default y

endif # SPI



if PWM

config PWM_0
	default y

endif # PWM

config BT_CTLR
	default BT

endif # PINETIME            
```

## boards/ds_d6/Kconfig.board
```kconfig
# nRF52832-MDK board configuration

# Copyright (c) 2018 makerdiary.com.
# SPDX-License-Identifier: Apache-2.0

config BOARD_DS_D6
        bool "DS-D6"
	depends on SOC_NRF52832_QFAA
```
