## prj.conf
```kconfig
CONFIG_HEAP_MEM_POOL_SIZE=16384
CONFIG_MAIN_STACK_SIZE=2048

CONFIG_DISPLAY=y
CONFIG_DISPLAY_LOG_LEVEL_ERR=y
CONFIG_LOG=y
CONFIG_LVGL=y
CONFIG_NEWLIB_LIBC=y





CONFIG_BT=y
CONFIG_BT_DEBUG_LOG=y
CONFIG_BT_SMP=y
CONFIG_BT_SIGNING=y
CONFIG_BT_PERIPHERAL=y
CONFIG_BT_DIS=y
CONFIG_BT_ATT_PREPARE_COUNT=5
CONFIG_BT_BAS=y
CONFIG_BT_HRS=y
CONFIG_BT_PRIVACY=y
CONFIG_BT_DEVICE_APPEARANCE=833
CONFIG_BT_DEVICE_NAME_DYNAMIC=n
CONFIG_BT_DEVICE_NAME_MAX=65

CONFIG_BT_KEYS_OVERWRITE_OLDEST=y
CONFIG_BT_SETTINGS=y
CONFIG_FLASH=y
CONFIG_FLASH_PAGE_LAYOUT=y
CONFIG_FLASH_MAP=y
CONFIG_NVS=y
CONFIG_SETTINGS=y
CONFIG_BT_GATT_CLIENT=y

CONFIG_SETTINGS_RUNTIME=y
CONFIG_SETTINGS=y
CONFIG_SETTINGS_NONE=y

CONFIG_DEVICE_POWER_MANAGEMENT=y
```

## boards/ds_d6.conf
```kconfig
CONFIG_HEAP_MEM_POOL_SIZE=16384
CONFIG_MAIN_STACK_SIZE=2048

CONFIG_LVGL_FONT_MONTSERRAT_28=n
CONFIG_LVGL_FONT_MONTSERRAT_14=y
#CONFIG_LVGL_DISPLAY_DEV_NAME="SSD1306"

CONFIG_LVGL_USE_LABEL=y
CONFIG_LVGL_USE_CONT=y
CONFIG_LVGL_USE_THEME_MATERIAL=n
CONFIG_LVGL_TXT_ENC_UTF8=y
CONFIG_LVGL_FONT_UNSCII_8=n
CONFIG_LVGL_VDB_SIZE=64
#CONFIG_LVGL_VDB_SIZE=2
CONFIG_USE_SEGGER_RTT=y
CONFIG_LVGL_USE_THEME_MONO=y
CONFIG_LVGL_THEME_DEFAULT_COLOR_PRIMARY_WHITE=y
CONFIG_LVGL_THEME_DEFAULT_COLOR_SECONDARY_BLACK=y
# Time functions
CONFIG_NEWLIB_LIBC=y
#CONFIG_LVGL_POINTER_KSCAN=y
CONFIG_BT_DEVICE_NAME="dsd6"
CONFIG_UART_CONSOLE=y
CONFIG_BT_CONN_TX_MAX=3
```

## boards/native_posix_64.conf
```kconfig
CONFIG_SDL_DISPLAY_DEV_NAME="DISPLAY"
CONFIG_SDL_DISPLAY_X_RES=300
CONFIG_SDL_DISPLAY_Y_RES=100
CONFIG_KSCAN=y
CONFIG_LVGL_POINTER_KSCAN=y
CONFIG_LVGL_POINTER_KSCAN_DEV_NAME="KSCAN"
CONFIG_SDL_POINTER_KSCAN_DEV_NAME="KSCAN"
CONFIG_CONSOLE=y
CONFIG_UART_CONSOLE=y
CONFIG_UART_CONSOLE_ON_DEV_NAME="UART_0"
#CONFIG_UART_NATIVE_POSIX_PORT_1_ENABLE=y
#CONFIG_UART_NATIVE_POSIX_PORT_1_NAME="UART_1"
CONFIG_SHELL=y
CONFIG_UART_SHELL_ON_DEV_NAME="UART_0"
CONFIG_LVGL_FONT_MONTSERRAT_28=y
CONFIG_LVGL_FONT_MONTSERRAT_14=n

CONFIG_LVGL_USE_LABEL=y
CONFIG_LVGL_USE_CONT=y
CONFIG_LVGL_USE_BTN=y
CONFIG_LVGL_USE_THEME_MATERIAL=n
CONFIG_LVGL_TXT_ENC_UTF8=y
CONFIG_LVGL_FONT_UNSCII_8=n
CONFIG_LVGL_VDB_SIZE=64
CONFIG_USE_SEGGER_RTT=y
CONFIG_LVGL_USE_THEME_MONO=y
CONFIG_LVGL_THEME_DEFAULT_COLOR_PRIMARY_WHITE=y
CONFIG_LVGL_THEME_DEFAULT_COLOR_SECONDARY_BLACK=y
# Time functions
#CONFIG_NEWLIB_LIBC=y
CONFIG_LVGL_POINTER_KSCAN=y

CONFIG_DISPLAY_LOG_LEVEL_INF=y
CONFIG_DEBUG_INFO=y
CONFIG_LVGL_LOG_LEVEL_DBG=y
CONFIG_SHELL_BACKEND_SERIAL_LOG_LEVEL_INF=y
CONFIG_DEBUG=y
CONFIG_LVGL_USE_DEBUG=y
```

## include/backlight.h
```c
/*
 * SPDX-License-Identifier: Apache-2.0
 */

#ifndef BACKLIGHT__H
#define BACKLIGHT__H

#include <stdbool.h>

//void backlight_init(void);
void backlight_switch(bool);
//bool backlight_is_enabled(void);

#endif /* BACKLIGHT__H */
```

## include/battery.h
```c
/*
 * Copyright (c) 2020 Endian Technologies AB
 *
 * SPDX-License-Identifier: Apache-2.0
 */

#ifndef BATTERY__H
#define BATTERY__H

void battery_init();
void battery_update_percentage();
void battery_update_charging_status(bool);
bool battery_get_charging_status();
uint32_t battery_raw_to_mv(int16_t raw);
uint32_t battery_mv_to_ppt(uint32_t mv);
void battery_show_status();
void battery_gfx_init();

#endif /* BATTERY__H */
```

## include/clock.h
```c
/*
 * Copyright (c) 2020 Endian Technologies AB
 *
 * SPDX-License-Identifier: Apache-2.0
 */

#ifndef CLOCK__H
#define CLOCK__H

#include <cts_sync.h>

void clock_init(void);
void clock_increment_local_time(void);
void clock_sync_time(cts_datetime_t *cts);
void clock_show_time(void);
void clock_set_alarm(int);
void clock_stop_alarm();
bool clock_check_alarm();
#endif /* CLOCK__H */
```

## include/display.h
```c
/*
 *   display.h
 */
#ifndef __DISPLAY_H
#define __DISPLAY_H
#include "buttons.h"
/*---------------------------------------------------------------------------*/
/*                                                                           */
/*---------------------------------------------------------------------------*/
int  display_init(void);
void display_time_set_label(char *str);
void display_date_set_label(char *str);
void display_btn_event(buttons_id_t btn_id);
void display_sleep();
void display_wake_up();
void display_clock_update();
void display_connect_event(void);
void display_disconnect_event(void);
void backlight_switch(bool enable);
#define PARAM_TOTAL 6 //total number of parameters
void display_parameters_update(uint8_t *elementary);
#endif  /* __DISPLAY_H */
```

## include/event_handler.h
```c
/*
 * Copyright (c) 2021 Jan Jansen 
 *
 * SPDX-License-Identifier: Apache-2.0
 */

#ifndef EVENT_HANDLER__H
#define EVENT_HANDLER__H

#include <drivers/gpio.h>
#include <drivers/sensor.h>
#include <lvgl.h>

void event_handler_init(void);
void display_off_isr(struct k_timer *);
#ifdef CONFIG_BOOTLOADER_MCUBOOT
void watchdog_refresh_isr(struct k_timer *);
#endif
void battery_percentage_isr(struct k_timer *);
void battery_charging_isr(const struct device*, struct gpio_callback *, uint32_t);
void button_pressed_isr(const struct device *, struct gpio_callback *, uint32_t);
int handle_button_event(void);
void handle_clock_update(struct k_timer *); //jj struct k_timer *clock_update
void button_event_cb(lv_obj_t * , lv_event_t );
//void button_event_cb(void);
void low_power_off();
//#if defined(CONFIG_BOARD_DS_D6)  //this watch has a button on the front (touch sensitive)
void init_button(void);
//#endif
#endif /* EVENT_HANDLER */
```

## include/gfx.h
```c
/*
 * Copyright (c) 2020 Endian Technologies AB
 *
 * SPDX-License-Identifier: Apache-2.0
 */

#ifndef GFX__H
#define GFX__H

enum bt_symbol {
	BT_CONNECTED,
	BT_ADVERTISING_ON,
	BT_ADVERTISING_OFF,
};

enum battery_symbol {
	BAT_CHARGE,
	BAT_FULL,
	BAT_3,
	BAT_2,
	BAT_1,
	BAT_EMPTY
};

void gfx_init(void);
void gfx_battery_set_label(enum battery_symbol);
void gfx_bt_set_label(enum bt_symbol);
void gfx_time_set_label(char *);
void gfx_date_set_label(char *);
void gfx_update(void);
void gfx_show_info(void);
void gfx_show_watch(void);

#endif /* GFX__H */
```

## src/clock.c
```c
/*
 * Copyright (c) 2021 najnesnaj@yahoo.com
 *
 * SPDX-License-Identifier: Apache-2.0
 */

#include <zephyr.h>
#include <time.h>
#include <stdio.h>
#include <stdlib.h>
#include <zephyr/types.h>
#include "battery.h"
#include "bt.h"
#include "version.h"
#include "cts_sync.h"
#include "log.h"
#include "event_handler.h"
#include "display.h"

/* ********** ********** VARIABLES ********** ********** */
static char time_label_str[32];
static char date_label_str[32];
typedef unsigned long long  u64_t;

static u64_t uptime_ms;
static u64_t last_uptime_ms;
static u64_t elapsed_ms;
//static u64_t alarm_ms=0;

static bool alarm_on = false;

static struct tm ti,alarm1 = {
	.tm_sec = 0,
	.tm_min = 0,
	.tm_hour = 0,
	.tm_mday = 0,
	.tm_mon = 0,
	.tm_year = 0,
	.tm_wday = 0,
	.tm_isdst = 1,
};

/* ********** ********** FUNCTIONS *********** ********** */
void clock_str_to_local_time(const char *str)
{
	if (sscanf(str, "%d-%d-%dT%d:%d:%d", &ti.tm_year, &ti.tm_mon,
				&ti.tm_mday, &ti.tm_hour, &ti.tm_min, &ti.tm_sec) != 6) {
		LOG_ERR("Failed to parse time of build.");
	}
	ti.tm_year-=1900;
	ti.tm_isdst=1; //daylight savings
	ti.tm_mon-=1;
	mktime(&ti);
}

void clock_init()
{
	/* Set time to time of build */
	clock_str_to_local_time(TIME_OF_BUILD);
	LOG_DBG("Time set to time of build");
	LOG_DBG("Clock init: Done");
}

void clock_update_elapsed_ms()
{
	uptime_ms = k_uptime_get();
	elapsed_ms = uptime_ms - last_uptime_ms;
	last_uptime_ms = uptime_ms;
	LOG_INF("Clock updated: "); //jj
}

void clock_set_alarm(int minut)
{
	time_t atime;
	alarm1.tm_year = ti.tm_year ;
	alarm1.tm_mon = ti.tm_mon  ;
	alarm1.tm_mday = ti.tm_mday ;
	//alarm1.tm_hour = ti.tm_hour -1 ; //todo jj dunno why substract 1 works
	alarm1.tm_hour = ti.tm_hour  ; //todo jj dunno why substract 1 works
	alarm1.tm_min = ti.tm_min  ;
	alarm1.tm_sec = ti.tm_sec + minut*60 ;
	alarm1.tm_isdst = 1;
	atime=mktime(&alarm1);
	printk("%d month", alarm1.tm_mon);
	printk("%d year", alarm1.tm_year);
	printk("%d hour", alarm1.tm_hour);
//	atime=atime+minut*60;
	alarm_on = true;
}

void clock_stop_alarm()
{ //alarm is set to the current time - so is expired
	alarm1.tm_year = ti.tm_year ;
	alarm1.tm_mon = ti.tm_mon  ;
	alarm1.tm_mday = ti.tm_mday ;
	alarm1.tm_hour = ti.tm_hour ;
	alarm1.tm_min = ti.tm_min  ;
	alarm1.tm_sec = ti.tm_sec  ;
	alarm1.tm_isdst = 1;
	//       mktime(&alarm1);
	alarm_on = false;
}



/* Called by cts sync */
void clock_sync_time(cts_datetime_t *cts)
{
	ti.tm_year = cts->year -1900;
	ti.tm_mon = cts->month -1;
	ti.tm_mday = cts->day;
	ti.tm_hour = cts->hours;
	ti.tm_min = cts->minutes;
	ti.tm_sec = cts->seconds;
	mktime(&ti);
	clock_update_elapsed_ms();
}

/* Called by event handler */
void clock_increment_local_time()
{      
	time_t atime,now;
	double seconds_left; 
	clock_update_elapsed_ms();
	ti.tm_sec += elapsed_ms / 1000;
	now=mktime(&ti);
	if (alarm_on)  {
	//	now = mktime(&ti);
		atime=mktime(&alarm1);
		seconds_left=difftime(atime,now);
		if (seconds_left < 60)
		{
			printk("ALARM ALARM -- DO SOMETHING!!!!\n");
			alarm_on=false; //switch off alarm once alarmevent is due
		}

	}
}

bool clock_check_alarm()
{
	return(alarm_on);
}


void clock_show_time()
{       
	strftime(time_label_str, 32, "%H:%M", &ti);
	display_time_set_label(time_label_str);
	if (alarm_on)
	{
		strftime(date_label_str, 32, "Alarm %H:%M", &alarm1);
		display_date_set_label(date_label_str);
	}
	else
	{
		strftime(date_label_str, 32, "%a %d %b", &ti);
		display_date_set_label(date_label_str);
	}
}
```

## src/display.c
```c
/*
 * Copyright (c) 2021 <najnesnaj@yahoo.com>
 *
 * SPDX-License-Identifier: Apache-2.0
 */

#include <device.h>
#include <drivers/display.h>
#include <drivers/gpio.h>
#include <pm/pm.h>
#include <pm/device.h>
#include <lvgl.h>
#include <stdio.h>
#include <string.h>
#include <zephyr.h>

#include "display.h"
#include "buttons.h"
#include "clock.h"
#include "event_handler.h"
#include <logging/log.h>
LOG_MODULE_REGISTER(display, 3);

const static struct device * display_dev;

#define SCREEN_ID_0    0
#define SCREEN_ID_1    1
#define SCREEN_ID_2    2
#define SCREEN_ID_3    3
#define SCREEN_COUNT   4 //last screen reserved for sleep event posix
//#define SCREEN_COUNT   3


//#define PARAM_TOTAL 6 //total number of parameters


char * param_label[] = {
	"temp1",
	"timer1",
	"temp2",
	"timer2",
	"temp3",
	"timer3"
};

int parameters[PARAM_TOTAL]={10,45,30,40,50,60};





enum battery_symbol {
	BAT_CHARGE,
	BAT_FULL,
	BAT_3,
	BAT_2,
	BAT_1,
	BAT_EMPTY
};

typedef struct {
	lv_obj_t * screen;
	int        count;
} screens_t;

/*---------------------------------------------------------------------------*/

static lv_obj_t   * button_obj;
static lv_obj_t   * screen0_label0_obj;
static lv_obj_t *time_label;
static lv_obj_t *date_label;
static lv_obj_t *title_label;
static lv_obj_t *battery_label;
static lv_obj_t *date_label;




static lv_obj_t   * screen1_label0_obj; 
static lv_obj_t   * screen1_label1_obj; 

//static lv_obj_t   * screen2_label0_obj; 
static lv_obj_t   * screen2_label1_obj; 
static lv_obj_t   * screen2_label2_obj; 

static screens_t screens [] = {
	{ .screen = NULL, .count = 1 },
	{ .screen = NULL, .count = 2 },
	{ .screen = NULL, .count = 3 },
	{ .screen = NULL, .count = 4 },
	{ .screen = NULL, .count = 0 },
};
#define SCREENS_COUNT (sizeof(screens)/sizeof(screens[0]))

/*---------------------------------------------------------------------------*/
/*                                                                           */
/*---------------------------------------------------------------------------*/
void display_time_set_label(char *str)
{
	lv_label_set_text(time_label, str);
}
void display_date_set_label(char *str)
{
	lv_label_set_text(date_label, str);
}

void display_parameters_update(uint8_t *elementary)
{ //these parameters are updated via bluetooth called from disconnected
	//it is an array of 12 bytes which gives some flexibility
	//suppose you want 33.33 you have to combine 2 bytes
	//suppose you want 3344 you have to combine in another way ...
	//in this examples type casting 1 byte to integer (6 bytes are left unused)
	uint8_t paramdata[PARAM_TOTAL*2];
	for (int i=0; i<(PARAM_TOTAL*2); i++) paramdata[i]=0; 
	memcpy(paramdata, elementary,  PARAM_TOTAL*2); 
	//   for (int i=0; i<(PARAM_TOTAL*2); i++) 
	//		 printk("number %d value %d\n", i, paramdata[i]);
	parameters[0]=paramdata[0] ; //todo loop
	parameters[1]=paramdata[2] ; 
	parameters[2]=paramdata[4] ; 
	parameters[3]=paramdata[6] ; 
	parameters[4]=paramdata[8] ; 
	parameters[5]=paramdata[10] ; 
}



//parameters are displayed on screen2
void display_label()
{
	screen2_label1_obj=lv_label_create(lv_scr_act(), NULL);
	lv_obj_align(screen2_label1_obj, lv_scr_act(), LV_ALIGN_IN_TOP_LEFT, 0, 0);
	screen2_label2_obj=lv_label_create(lv_scr_act(), NULL);
	lv_obj_align(screen2_label2_obj, lv_scr_act(), LV_ALIGN_IN_TOP_RIGHT, 0, 0);
}
void show_status(int parnr)
{
	if (parnr==1){
		lv_label_set_text(screen1_label0_obj, "to start: click");
		//clock_set_alarm(parameters[1]);
	}

	if (parnr==2){
		lv_label_set_text(screen1_label0_obj, "running");
		clock_set_alarm(parameters[1]);
		//timer_handler_init();
	}
	if (parnr==3){
		lv_label_set_text(screen1_label0_obj, "to stop: click");
	}
	if (parnr==4){ //and extra click is needed to stop to avoid confusion with long press
		lv_label_set_text(screen1_label0_obj, "halted");
		clock_stop_alarm();
	}
}

void show_label(int parnr)
{
	char snum[5];
	sprintf(snum, "%d",parameters[parnr]);
	lv_label_set_text(screen2_label1_obj, param_label[parnr]);
	lv_label_set_text(screen2_label2_obj, snum);
}







void display_clock_update() // jj the clock apears in the first screen only 
{
	//                                   lv_scr_load(screens[0].screen);



}

/*---------------------------------------------------------------------------*/
/*        todo                                                               */
/*        kscan_touch works for pinetime                                     */
/*        have not found a way to do this out of tree                        */
/*        some minor modification of the focaltech driver is needed          */
/*---------------------------------------------------------------------------*/
/*
#if defined(CONFIG_LVGL_POINTER_KSCAN) 


static void button_event_cb(lv_obj_t * obj, lv_event_t event)
{
static int screen_id = 0;  // init to first screen id
static int param_id  = 0;  // init to first parameter index

switch(event) {
case LV_EVENT_PRESSED:
break; 
case LV_EVENT_SHORT_CLICKED:
LOG_INF("Short clicked\n");
break;

case LV_EVENT_CLICKED:
clock_increment_local_time();

LOG_INF("Clicked\n");
break;

case LV_EVENT_LONG_PRESSED:
clock_increment_local_time();
clock_show_time();
LOG_INF("Long press\n");
break;

case LV_EVENT_LONG_PRESSED_REPEAT:

//this can be configured in menuconfig 
//standard value < long_pressed
screen_id++;
if (screen_id >= SCREEN_COUNT)
screen_id = 0;
lv_scr_load(screens[screen_id].screen);
param_id = 0;
LOG_INF("BTN1: screen_id(%d)", screen_id);
//   handle_button_event();



LOG_INF("Long press repeat\n");
break;

case LV_EVENT_RELEASED:
LOG_INF("Released\n");
break;
}

}
#endif
 */

/*---------------------------------------------------------------------------*/
/*                                                                           */
/*---------------------------------------------------------------------------*/
//todo if no touch screen define real button ds_d6




void display_battery(enum battery_symbol s)
{
	switch (s) {
		case BAT_CHARGE:
			lv_label_set_text(battery_label, LV_SYMBOL_CHARGE);
			break;
		case BAT_FULL:
			lv_label_set_text(battery_label, LV_SYMBOL_BATTERY_FULL);
			break;
		case BAT_3:
			lv_label_set_text(battery_label, LV_SYMBOL_BATTERY_3);
			break;
		case BAT_2:
			lv_label_set_text(battery_label, LV_SYMBOL_BATTERY_2);
			break;
		case BAT_1:
			lv_label_set_text(battery_label, LV_SYMBOL_BATTERY_1);
			break;
		default:
			lv_label_set_text(battery_label, LV_SYMBOL_BATTERY_EMPTY);
	}
}






void display_button()
{
	/* the ds_d6 has a real button and no touchscreen, so no need for lvgl-button */
#if defined(CONFIG_LVGL_POINTER_KSCAN)
	//#if defined(CONFIG_BOARD_NATIVE_POSIX_64BIT)
	button_obj = lv_btn_create(lv_scr_act(), NULL);
	lv_obj_set_width(button_obj, 5);
	lv_obj_set_height(button_obj, 5);
	//lv_obj_align(button_obj, NULL, LV_ALIGN_CENTER, 128, 0);
	lv_obj_align(button_obj, NULL, LV_ALIGN_IN_RIGHT_MID, 0, 0);
	lv_btn_set_fit(button_obj, LV_FIT_TIGHT);
	screen0_label0_obj = lv_label_create(button_obj, NULL);
	lv_label_set_text(screen0_label0_obj, "O"); //substitute for real switch on physical watch
	lv_obj_set_event_cb(button_obj, button_event_cb);
#endif

}

void display_connect_event()
{
	//      LOG_INF("display_connect_event");
	lv_scr_load(screens[3].screen); //display the CTS screen
	//      lv_task_handler();//jj

}

void display_disconnect_event()
{
	lv_scr_load(screens[0].screen); //display the first screen
}





void display_btn_event(buttons_id_t btn_id)
{
	//static int screen_id = 0;  // init to first screen id
	static int screen_id ;  // init to first screen id
	static int param_id  = 0;  // init to first parameter index

	//LOG_INF("%s: BTN%d", __func__, btn_id);

	switch (btn_id) {

		case BTN1_LONG:
			screen_id++;
			if (screen_id >= (SCREEN_COUNT-1))
				screen_id = 0;
			if (screen_id==1) {
				//todo check alarm does not work
				if (clock_check_alarm()) param_id =  2; //alarm is already active show status running
				else
					param_id = 1;
				show_status(param_id);
			}

			lv_scr_load(screens[screen_id].screen);
			param_id = 0;
			LOG_INF("BTN1_LONG: screen_id(%d)", screen_id);
			break;

		case BTN1_SHORT:
			param_id++;
			if (param_id >= PARAM_TOTAL)  param_id = 0;
			if (screen_id==1) show_status(param_id);
			if (screen_id==2) show_label(param_id);
			//		if (param_id < 0)                          param_id = 0;
			LOG_INF("BTN1_SHORT: screen_id(%d) param_id(%d)", screen_id, param_id);
			break;


		default:
			break;
	}
}

/*---------------------------------------------------------------------------*/
/*                                                                           */
/*---------------------------------------------------------------------------*/
void display_screens_init(void)
{
	screens[0].screen = lv_obj_create(NULL, NULL);
	screens[1].screen = lv_obj_create(NULL, NULL);
	screens[2].screen = lv_obj_create(NULL, NULL);
	screens[3].screen = lv_obj_create(NULL, NULL);
	screens[4].screen = lv_obj_create(NULL, NULL);

	// lv_theme_t * mono = lv_theme_mono_init(0, NULL);
	// lv_theme_set_current(mono);

	/*
	 *  build basic screen0
	 */
	lv_scr_load(screens[0].screen);
	//	lv_obj_t * screen0_label = lv_label_create(lv_scr_act(), NULL);
	//	lv_label_set_text(screen0_label, "Pg1");
	//	lv_obj_align(screen0_label, screens[0].screen, LV_ALIGN_IN_TOP_RIGHT, 0, 0);
	/* the ds_d6 has a real button and no touchscreen, so no need for lvgl-button */
	display_button();

	/* Time label */
	time_label = lv_label_create(lv_scr_act(), NULL);
	lv_obj_align(time_label, NULL, LV_ALIGN_IN_TOP_MID, 0, 0); //jj
	lv_label_set_text(time_label, "00:00");
	/* Date label */
	date_label = lv_label_create(lv_scr_act(), NULL);
	lv_obj_align(date_label, NULL, LV_ALIGN_IN_BOTTOM_MID, 0, 0);
	lv_label_set_text(date_label, "Mon 10 Jan");

	/* title label */
	title_label = lv_label_create(lv_scr_act(), NULL);
	lv_obj_align(title_label, NULL, LV_ALIGN_IN_TOP_LEFT, 0, 0);
	//lv_label_set_text(title_label, LV_SYMBOL_BLUETOOTH"symb");
	//lv_label_set_text(title_label, LV_SYMBOL_BLUETOOTH);
	lv_label_set_text(title_label, LV_SYMBOL_WIFI);

	/* Battery label */
	//display_battery(3);
	battery_label = lv_label_create(lv_scr_act(), NULL);
	display_battery(BAT_3); //todo just demo value -- need real level
	//lv_label_set_text(battery_label, LV_SYMBOL_BATTERY_2);
	lv_obj_align(battery_label, NULL, LV_ALIGN_IN_BOTTOM_LEFT, 0, 0);

	//battery_label = lv_label_create(lv_scr_act(), NULL);
	//lv_obj_align(battery_label, NULL, LV_ALIGN_IN_TOP_MID, 0, 0);
	//lv_label_set_text(battery_label, LV_SYMBOL_BATTERY_EMPTY);


	//	lv_obj_t * mask = lv_img_create(lv_scr_act(), NULL);
	//	lv_img_set_src(mask, &mask);
	//	lv_obj_align(mask, NULL, LV_ALIGN_CENTER, 0, 0);


	//  hello_world_label = lv_label_create(hello_world_button, NULL);
	// printf("pointer enabled\n");
	// lv_label_set_text(hello_world_label, "O"); //substitute for real switch on physical watch
	//screen0_slider_obj = lv_slider_create(lv_scr_act(), NULL);
	//lv_obj_set_height(screen0_slider_obj, 10);
	//lv_obj_set_width(screen0_slider_obj, 110);
	//lv_obj_align(screen0_slider_obj, NULL, LV_ALIGN_CENTER, 0, 0);
	//lv_slider_set_value(screen0_slider_obj, 15, LV_ANIM_ON);
	//screen0_slider_value = 15;

	/*
	 *  build basic screen1
	 */
	lv_scr_load(screens[1].screen);
	lv_obj_t * screen1_page = lv_label_create(lv_scr_act(), NULL);
	//lv_label_set_text(screen1_page, "Start Timer");
	lv_label_set_text(screen1_page, param_label[1]); //this is timer1
	lv_obj_align(screen1_page, screens[1].screen, LV_ALIGN_IN_TOP_RIGHT, 0, 0);

	// to avoid creating the same button all over again jj
	display_button();

	screen1_label0_obj = lv_label_create(lv_scr_act(), NULL);
	lv_label_set_text(screen1_label0_obj, "Start");
	lv_obj_align(screen1_label0_obj, screens[1].screen, LV_ALIGN_IN_BOTTOM_LEFT, 5, -5);

	screen1_label1_obj = lv_label_create(lv_scr_act(), NULL);
	lv_label_set_text_fmt(screen1_label1_obj,"%d", parameters[1]); //this is value of timer1
	lv_obj_align(screen1_label1_obj, screens[1].screen, LV_ALIGN_IN_BOTTOM_RIGHT, -15, -5);

	//	lv_obj_t * icon_1 = lv_img_create(lv_scr_act(), NULL);
	//	lv_img_set_src(icon_1, &icon1);
	//	lv_obj_align(icon_1, NULL, LV_ALIGN_CENTER, 0, 0);

	/*
	 *  build basic screen2
	 */
	lv_scr_load(screens[2].screen);
	lv_obj_t * screen2_page = lv_label_create(lv_scr_act(), NULL);
	lv_label_set_text(screen2_page, "Pg3");
	lv_obj_align(screen2_page, screens[2].screen, LV_ALIGN_IN_BOTTOM_LEFT, 0, 0);
	// why define the same button all over again? jj
	display_button();
	display_label(); //parameters on screen 2
	show_label(1); //show first parameters on list --short click to scroll
	//
	//	lv_obj_t * screen2_label0_tag = lv_label_create(lv_scr_act(), NULL);
	//	lv_label_set_text(screen2_label0_tag, "value-0");
	//	lv_obj_align(screen2_label0_tag, screens[2].screen, LV_ALIGN_IN_TOP_RIGHT, -70, 2);

	//	screen2_label0_obj = lv_label_create(lv_scr_act(), NULL);
	//	lv_label_set_text(screen2_label0_obj, "0");
	//	lv_obj_align(screen2_label0_obj, screens[2].screen, LV_ALIGN_IN_TOP_RIGHT, -45, 2);

	//
	//	lv_obj_t * screen2_label1_tag = lv_label_create(lv_scr_act(), NULL);
	//	lv_label_set_text(screen2_label1_tag, "value-1");
	//	lv_obj_align(screen2_label1_tag, screens[2].screen, LV_ALIGN_IN_RIGHT_MID, -70, 0);

	//	screen2_label1_obj = lv_label_create(lv_scr_act(), NULL);
	//	lv_label_set_text(screen2_label1_obj, "0");
	//	lv_obj_align(screen2_label1_obj, screens[2].screen, LV_ALIGN_IN_RIGHT_MID, -45, 0);

	//
	//	lv_obj_t * screen2_value2_tag = lv_label_create(lv_scr_act(), NULL);
	//	lv_label_set_text(screen2_value2_tag, "value-2");
	//	lv_obj_align(screen2_value2_tag, screens[2].screen, LV_ALIGN_IN_BOTTOM_RIGHT, -70, -2);

	//	screen2_label2_obj = lv_label_create(lv_scr_act(), NULL);
	//	lv_label_set_text(screen2_label2_obj, "0");
	//	lv_obj_align(screen2_label2_obj, screens[2].screen, LV_ALIGN_IN_BOTTOM_RIGHT, -45, -2);

	//#if 0
	//	lv_obj_t * icon_2 = lv_img_create(lv_scr_act(), NULL);
	//	lv_img_set_src(icon_2, &icon2);
	//#endif

	/*
	 *  build basic screen3
	 */
	lv_scr_load(screens[3].screen);
	lv_obj_t * screen3_page = lv_label_create(lv_scr_act(), NULL);
	lv_label_set_text(screen3_page, "BT");
	lv_obj_align(screen3_page, screens[3].screen, LV_ALIGN_IN_TOP_RIGHT, 0, 0);
	/* Bluetooth label */
	title_label = lv_label_create(lv_scr_act(), NULL);
	lv_obj_align(title_label, NULL, LV_ALIGN_IN_TOP_LEFT, 0, 0);
	lv_label_set_text(title_label, LV_SYMBOL_BLUETOOTH);

	// why define the same button all over again? jj
	display_button();
	/*
	 * screen 4 is displayed on the native_posix board to simulate sleeping mode
	 */
	lv_scr_load(screens[4].screen); //this screen is used only by native_posix_64
	lv_obj_t * screen4_page = lv_label_create(lv_scr_act(), NULL);
	lv_label_set_text(screen4_page, "long click wake");
	lv_obj_align(screen4_page, screens[4].screen, LV_ALIGN_IN_TOP_RIGHT, 0, 0);
	display_button();
	//	lv_obj_t * icon_3 = lv_img_create(lv_scr_act(), NULL);
	//	lv_img_set_src(icon_3, &icon3);
	//	lv_obj_align(icon_3, NULL, LV_ALIGN_CENTER, 0, 0);
}

/*---------------------------------------------------------------------------*/
/*                                                                           */
/*---------------------------------------------------------------------------*/
#if defined(CONFIG_BOARD_PINETIME_DEVKIT1)


#define LED0_NODE DT_ALIAS(led1)

#if DT_NODE_HAS_STATUS(LED0_NODE, okay)
#define LED0    DT_GPIO_LABEL(LED0_NODE, gpios)
#define PIN     DT_GPIO_PIN(LED0_NODE, gpios)
#define FLAGS   DT_GPIO_FLAGS(LED0_NODE, gpios)
#endif
#endif

void backlight_switch(bool enable)
{
#if defined(CONFIG_BOARD_PINETIME_DEVKIT1)

	const struct device *dev;

	dev = device_get_binding(LED0);
	/* If you have a backlight, set it up and turn it on here */
	gpio_pin_configure(dev, PIN, GPIO_OUTPUT_ACTIVE | FLAGS);
	//   gpio_pin_configure(dev, LED, GPIO_DIR_OUT);
	if (enable==true) 
		gpio_pin_set(dev, PIN, 1);
	else
		gpio_pin_set(dev, PIN, 0);
	//gpio_pin_write(dev, LED, 0);
#endif
}

void display_sleep(void)
{
	display_dev = device_get_binding(CONFIG_LVGL_DISPLAY_DEV_NAME);

#if defined(CONFIG_BOARD_NATIVE_POSIX_64BIT) //to simulate sleeping screen on posix
	LOG_INF("display sleep\n");
	lv_scr_load(screens[4].screen);
#else
	display_blanking_on(display_dev);

#endif

	pm_device_state_set(display_dev, PM_DEVICE_STATE_LOW_POWER);

}

void display_wake_up(void)
{
	uint32_t state_of_watch;
	//pm_device_state_get(display_dev, uint32_t *device_power_state)
	display_dev = device_get_binding(CONFIG_LVGL_DISPLAY_DEV_NAME);
	pm_device_state_get(display_dev, &state_of_watch);
#if defined(CONFIG_BOARD_NATIVE_POSIX_64BIT) //to simulate sleeping screen on posix
	if (state_of_watch == PM_DEVICE_STATE_LOW_POWER) 
	{
		lv_scr_load(screens[0].screen); //display always first screen after waking up 
		pm_device_state_set(display_dev, PM_DEVICE_STATE_ACTIVE);
	}
#else
	if (state_of_watch == PM_DEVICE_STATE_ACTIVE) 
		printk("already ACTIVE\n");
	else
	{
		printk("\n");
		printk("not ACTIVE\n");
		printk("%d\n", state_of_watch);
		display_blanking_off(display_dev);
		lv_scr_load(screens[0].screen); //display always first screen after waking up 
		pm_device_state_set(display_dev, PM_DEVICE_STATE_ACTIVE);
	}
#endif
}


int display_init(void)
{
	backlight_switch(true); //jj check which board has backlight is done in procedure
	display_dev = device_get_binding(CONFIG_LVGL_DISPLAY_DEV_NAME);

	if (display_dev == NULL) {
		LOG_ERR("device not found. %s", CONFIG_LVGL_DISPLAY_DEV_NAME);
		return -1;
	}

	//lv_init();

	display_screens_init();

	/*
	 *  First screen will be screen1
	 */
	lv_scr_load(screens[0].screen);

	/*
	 *  Turn on display
	 */
	lv_task_handler();//jj
	display_blanking_off(display_dev);

	/* 
	 * Register for button press notifications.
	 */
	//buttons_register_notify_handler(display_btn_event);

	/*
	 *  Start task handler timer loop
	 */
	//	k_timer_start(&display_timer, K_MSEC(TICK_PERIOD), K_MSEC(TICK_PERIOD));
	//set powerstatus to active
		pm_device_state_set(display_dev, PM_DEVICE_STATE_ACTIVE);

	return 0;
};
```

## src/event_handler.c
```c
/*
 * Copyright (c) 2021 najnesnaj@yahoo.com
 *
 * SPDX-License-Identifier: Apache-2.0
 */

#include <zephyr.h>
#include <drivers/gpio.h>
#include <drivers/sensor.h>
#include <stdbool.h>
//#include <pm/pm.h>
#include "battery.h"
#include "bt.h"
#include "clock.h"
#include "display.h"
#include "event_handler.h"
#include "log.h"
#include "buttons.h"

/* ********** defines ********** */
#define BAT_CHA 2 //jj
#define BTN_PORT DT_GPIO_LABEL(DT_ALIAS(sw0), gpios)
#define BTN_IN  DT_GPIO_PIN(DT_ALIAS(sw0), gpios)
#define BTN_OUT 3 //jj 
#define EDGE    (GPIO_INT_EDGE | GPIO_INT_DOUBLE_EDGE)
#define PULL_UP DT_GPIO_FLAGS(DT_ALIAS(sw0), gpios)
#define LOW_POWER_TIMEOUT K_SECONDS(50) //switch to low power after 50 seconds
#define CLOCK_UPDATE K_SECONDS(20) //jj every minute clock should get update 
/* ********** ******* ********** */

/* ********** variables ********** */
static struct k_timer low_power_timer; //jj
static struct k_timer clock_update_timer; //jj

/* ********** ******* ********** */
/* setup buttons **** ********** */
/* ********** ******* ********** */

//when used with the native_posix_64 virtual device there are no buttons ...
//#if !(defined(CONFIG_BOARD_NATIVE_POSIX_64BIT))

#define SW0_NODE        DT_ALIAS(sw0)

#if DT_NODE_HAS_STATUS(SW0_NODE, okay)
#define SW0_GPIO_LABEL  DT_GPIO_LABEL(SW0_NODE, gpios)
#define SW0_GPIO_PIN    DT_GPIO_PIN(SW0_NODE, gpios)
#define SW0_GPIO_FLAGS  (GPIO_INPUT | DT_GPIO_FLAGS(SW0_NODE, gpios))
#else
//#error "Unsupported board: sw0 devicetree alias is not defined"
#define SW0_GPIO_LABEL  ""
#define SW0_GPIO_PIN    0
#define SW0_GPIO_FLAGS  0
#endif

#if defined(CONFIG_BOARD_PINETIME_DEVKIT1) //pinetime needs port 15 high for switch to work
#define SW1_NODE        DT_ALIAS(sw1)
#define SW1_GPIO_PIN    DT_GPIO_PIN(SW1_NODE, gpios)
#define SW1_GPIO_FLAGS  (GPIO_OUTPUT | DT_GPIO_FLAGS(SW1_NODE, gpios))
#define BUTTON_THRESH 4 //threshold to distinguish between short and long press
#define BUTTON_DOUBLE_THRESH 2 //double click
#endif

#if defined(CONFIG_BOARD_NATIVE_POSIX_64BIT)
#define BUTTON_THRESH 8 //threshold to distinguish between short and long press
//when used in a real watch it will probable have to be less
#define BUTTON_DOUBLE_THRESH 12 //double click
#endif

#if defined(CONFIG_BOARD_DS_D6)
#define BUTTON_THRESH 3 //threshold to distinguish between short and long press
#define BUTTON_DOUBLE_THRESH 2 //double click
#endif



static uint8_t button_press_cnt;
//struct k_timer button_timer;




//when the timer expires the number of presses is analysed
void button_timer_handler(struct k_timer *dummy)
{
	LOG_INF("timer expired\n");
	LOG_INF("press count %d\n", button_press_cnt);
	//if (button_press_cnt >= BUTTON_DOUBLE_THRESH){
	if (button_press_cnt > BUTTON_THRESH){
		LOG_INF("long press\n");
		display_btn_event(BTN1_LONG);
	}
	if (button_press_cnt <= BUTTON_THRESH){ //short press is used to scroll trough the labels with their value
		LOG_INF("short press\n");
		display_btn_event(BTN1_SHORT);
	}
//	if ((button_press_cnt > BUTTON_THRESH) && (button_press_cnt < BUTTON_DOUBLE_THRESH)){
//		LOG_INF("double click\n");

		//todo no function linked to double click
//	}
	button_press_cnt=0;


}

/*timer used to detect lenght of pushing*/
struct k_timer button_timer;
K_TIMER_DEFINE(button_timer, button_timer_handler,NULL);





void button_pressed(const struct device *dev, struct gpio_callback *cb,
		uint32_t pins)
{
	buttons_id_t btn_id;
        low_power_off();
	LOG_INF("Button pressed at %" PRIu32 "\n", k_cycle_get_32());

	if (button_press_cnt == 0U) {
		k_timer_start(&button_timer, K_SECONDS(1), K_NO_WAIT);
		btn_id=BTN1_SHORT;
	}

	if (k_timer_status_get(&button_timer) > 0) {
		/* timer has expired */
		//display_btn_event(BTN1_SHORT);
		button_press_cnt=0;
	} else  {
		/* timer still running */
		button_press_cnt++;
	}


}

//this is used in case of native_posix -- virtual button
void button_event_cb(lv_obj_t * obj, lv_event_t event)
{

        LOG_INF("Button pressed at %" PRIu32 "\n", k_cycle_get_32());
        if (button_press_cnt == 0U) {
                k_timer_start(&button_timer, K_SECONDS(1), K_NO_WAIT);
        low_power_off();
                printf("Buttontime started" );
        }

        if (k_timer_status_get(&button_timer) > 0) {
                button_press_cnt=0;
        } else  {
                /* timer still running */
                button_press_cnt++;
        }

}


static struct gpio_callback button_cb_data;

void init_button(void)
{
	const struct device *button;
	int ret;
	button = device_get_binding(SW0_GPIO_LABEL);
	if (button == NULL) {
		printk("Error: didn't find %s device\n", SW0_GPIO_LABEL);
		return;
	}

	ret = gpio_pin_configure(button, SW0_GPIO_PIN, SW0_GPIO_FLAGS);
	if (ret != 0) {
		printk("Error %d: failed to configure %s pin %d\n",
				ret, SW0_GPIO_LABEL, SW0_GPIO_PIN);
		return;
	}

	ret = gpio_pin_interrupt_configure(button,
			SW0_GPIO_PIN,
			GPIO_INT_EDGE_TO_ACTIVE);
	if (ret != 0) {
		printk("Error %d: failed to configure interrupt on %s pin %d\n",
				ret, SW0_GPIO_LABEL, SW0_GPIO_PIN);
		return;
	}
#if defined(CONFIG_BOARD_PINETIME_DEVKIT1)
	//port 15 has to be high in order for the button to work


	gpio_pin_configure(button, SW1_GPIO_PIN,SW1_GPIO_FLAGS); //push button out
	gpio_pin_set(button, SW1_GPIO_PIN, 1); //set port high



#endif



	gpio_init_callback(&button_cb_data, button_pressed, BIT(SW0_GPIO_PIN));
	gpio_add_callback(button, &button_cb_data);
	printk("Set up button at %s pin %d\n", SW0_GPIO_LABEL, SW0_GPIO_PIN);



}
//#endif

//static struct gpio_callback button_cb;

/* ********** ********* ********** */
void low_power_on()
{
	backlight_switch(false);
	LOG_INF("low power on\n");//jj
	display_sleep();
}

void low_power_off()
{
//	int pm_device_state_get(const struct device *dev, uint32_t *device_power_state)
	display_wake_up(); //switches power mode to active
#if !(defined(CONFIG_BOARD_NATIVE_POSIX_64BIT))
	display_init();
#endif
	k_timer_stop(&low_power_timer); //in case the timer was already running
        k_timer_init(&low_power_timer, low_power_on, NULL); //the timer for powersave is started agair
	k_timer_start(&low_power_timer, LOW_POWER_TIMEOUT, K_NO_WAIT);
	//k_timer_start(display_off,CLOCK_UPDATE, K_NO_WAIT);
}

/* ********** init function ********** */
void event_handler_init()
{

	/* Start timers */
	k_timer_init(&clock_update_timer, handle_clock_update, NULL); //jj
	k_timer_start(&clock_update_timer,CLOCK_UPDATE, K_NO_WAIT); //jj
	low_power_off();
//        k_timer_init(&low_power_timer, low_power_on, NULL);
//	k_timer_start(&low_power_timer, LOW_POWER_TIMEOUT, K_NO_WAIT);

	clock_show_time();

	LOG_DBG("Event handler init: Done");
}
/* ********** ************ ********** */

/* ********** interrupt handlers ********** */


void button_pressed_isr(const struct device *gpiobtn, struct gpio_callback *cb, uint32_t pins)
{
	//backlight_switch(true);

	printk("button_pressed_isr\n");
	handle_button_event();
}


void handle_clock_update(struct k_timer *clock_update) //jj if clock displayed, it should get the updated time
{
	printk("handle_clock_update\n");
	clock_increment_local_time();
	clock_show_time();
	display_clock_update(); //multiple screens but clock only appears in 1st
	k_timer_start(clock_update,CLOCK_UPDATE, K_NO_WAIT); //timer gets started again -- perpetuum mobile
}


/* ********** ************** ********** */
int handle_button_event(void)
{
//	k_timer_start(&display_off_timer, DISPLAY_TIMEOUT, K_NO_WAIT);
	clock_increment_local_time();
	clock_show_time();
//	display_on_isr();//switch to actice state wake up display
	return 1;
}
```
