## CMakeLists.txt
```
# SPDX-License-Identifier: Apache-2.0
#list(APPEND ZEPHYR_EXTRA_MODULES /root/zephyrproject/app/drivers/kscan2)
cmake_minimum_required(VERSION 3.13.1)
list(APPEND ZEPHYR_EXTRA_MODULES
  ${CMAKE_CURRENT_SOURCE_DIR}/oswatch_drivers
  )


# Add the board
list(APPEND BOARD_ROOT ${CMAKE_CURRENT_LIST_DIR})
#list(APPEND DTS_ROOT ${CMAKE_CURRENT_LIST_DIR}/..)
#add_subdirectory(drivers/kscan2)
# Enable configurations through environment variables
#set(CONF_FILE ${CMAKE_CURRENT_LIST_DIR}/config/prj.conf ${CMAKE_CURRENT_LIST_DIR}/config/bootloader.conf)
#IF("$ENV{BOOTLOADER}" STREQUAL "off")
#  set(CONF_FILE ${CMAKE_CURRENT_LIST_DIR}/config/prj.conf)
#ENDIF()
#IF("$ENV{LOGGING}" STREQUAL "on")
#  set(CONF_FILE ${CONF_FILE} ${CMAKE_CURRENT_LIST_DIR}/config/logging_rtt.conf)
#ENDIF()

find_package(Zephyr REQUIRED HINTS $ENV{ZEPHYR_BASE})
include_directories(include)
project(oswatch)

FILE(GLOB app_sources src/*.c)
target_sources(app PRIVATE ${app_sources})

# Get current time
string(TIMESTAMP CURRENT_TIME %Y-%m-%dT%H:%M:%S)

# Get short commit hash
execute_process(
  COMMAND ${GIT_EXECUTABLE} describe --tags
  WORKING_DIRECTORY ${CMAKE_CURRENT_LIST_DIR}
  OUTPUT_VARIABLE FW_BUILD_GIT
  OUTPUT_STRIP_TRAILING_WHITESPACE
)
set(CMAKE_C_FLAGS "${CMAKE_C_FLAGS} -DCURRENT_TIME_OF_BUILD=\"${CURRENT_TIME}\" -DFW_BUILD=\"${FW_BUILD_GIT}\"")
set(ZEPHYR_BOARD_FLASH_RUNNER jlink)
```

## prj.conf
```kconfig
CONFIG_HEAP_MEM_POOL_SIZE=16384
CONFIG_MAIN_STACK_SIZE=2048

CONFIG_DISPLAY=y
CONFIG_DISPLAY_LOG_LEVEL_ERR=y
#CONFIG_KSCAN=y
CONFIG_LOG=y
CONFIG_LVGL=y
CONFIG_LVGL_USE_LABEL=y
CONFIG_LVGL_USE_CONT=y
CONFIG_LVGL_USE_BTN=y
#CONFIG_LVGL_USE_SLIDER=y
CONFIG_LVGL_USE_IMG=y
CONFIG_LVGL_USE_THEME_MATERIAL=n
#CONFIG_ST7789V=y
CONFIG_LVGL_TXT_ENC_UTF8=y
CONFIG_LVGL_FONT_MONTSERRAT_14=y
CONFIG_LVGL_FONT_UNSCII_8=n
#CONFIG_LVGL_VDB_SIZE=64 
CONFIG_LVGL_VDB_SIZE=2 
CONFIG_USE_SEGGER_RTT=y
CONFIG_LVGL_USE_THEME_MONO=y
CONFIG_LVGL_THEME_DEFAULT_COLOR_PRIMARY_WHITE=y
CONFIG_LVGL_THEME_DEFAULT_COLOR_SECONDARY_BLACK=y
# Time functions
CONFIG_NEWLIB_LIBC=y
CONFIG_LVGL_POINTER_KSCAN=y
```

## src/main.c
```c
/*

 * Copyright (c) 2021 <najnesnaj@yahoo.com>
 *
 * SPDX-License-Identifier: Apache-2.0
 */

#include <device.h>
#include <drivers/display.h>
#include <drivers/gpio.h>
#include <lvgl.h>
#include <stdio.h>
#include <string.h>
#include <zephyr.h>
#include "clock.h"
#include "log.h"
#include "display.h"
#include "event_handler.h"


void main(void)
{
#if !(defined(CONFIG_BOARD_NATIVE_POSIX_64BIT)) //both the pinetime & ds_d6 have a real button 
	{
		init_button();
	}
#endif
	display_init();
	clock_init();
	event_handler_init();

	while (1) {
		lv_task_handler();
		k_sleep(K_MSEC(100));
	}
}
```

## src/clock.c
```c
/*
 * Copyright (c) 2021 najnesnaj@yahoo.com
 *
 * SPDX-License-Identifier: Apache-2.0
 */

#include <zephyr.h>
#include <time.h>
#include <stdio.h>
#include <stdlib.h>
#include <zephyr/types.h>
#include "battery.h"
#include "bt.h"
#include "version.h"
#include "cts_sync.h"
#include "log.h"
#include "event_handler.h"
//#include "gfx.h"
#include "display.h"

/* ********** ********** VARIABLES ********** ********** */
static char time_label_str[32];
static char date_label_str[32];
typedef unsigned long long  u64_t;

static u64_t uptime_ms;
static u64_t last_uptime_ms;
static u64_t elapsed_ms;

static struct tm ti = {
	.tm_sec = 0,
	.tm_min = 0,
	.tm_hour = 0,
	.tm_mday = 0,
	.tm_mon = 0,
	.tm_year = 0,
	.tm_wday = 0,
};

/* ********** ********** FUNCTIONS *********** ********** */
void clock_str_to_local_time(const char *str)
{
	if (sscanf(str, "%d-%d-%dT%d:%d:%d", &ti.tm_year, &ti.tm_mon,
		   &ti.tm_mday, &ti.tm_hour, &ti.tm_min, &ti.tm_sec) != 6) {
		LOG_ERR("Failed to parse time of build.");
	}
	ti.tm_year-=1900;
	ti.tm_mon-=1;
	mktime(&ti);
}

void clock_init()
{
	/* Set time to time of build */
	clock_str_to_local_time(TIME_OF_BUILD);
	LOG_DBG("Time set to time of build");
	LOG_DBG("Clock init: Done");
}

void clock_update_elapsed_ms()
{
	uptime_ms = k_uptime_get();
	elapsed_ms = uptime_ms - last_uptime_ms;
	last_uptime_ms = uptime_ms;
	LOG_INF("Clock updated: "); //jj
}

/* Called by cts sync */
void clock_sync_time(cts_datetime_t *cts)
{
	ti.tm_year = cts->year -1900;
	ti.tm_mon = cts->month -1;
	ti.tm_mday = cts->day;
	ti.tm_hour = cts->hours;
	ti.tm_min = cts->minutes;
	ti.tm_sec = cts->seconds;
	mktime(&ti);
	clock_update_elapsed_ms();
}

/* Called by event handler */
void clock_increment_local_time()
{
	clock_update_elapsed_ms();
	ti.tm_sec += elapsed_ms / 1000;
	mktime(&ti);
}

void clock_show_time()
{
	strftime(time_label_str, 32, "%H:%M", &ti);
	strftime(date_label_str, 32, "%a %d %b", &ti);
	display_time_set_label(time_label_str);
	display_date_set_label(date_label_str);
}
```

## src/display.c
```c
/*
 * Copyright (c) 2021 <najnesnaj@yahoo.com>
 *
 * SPDX-License-Identifier: Apache-2.0
 */

#include <device.h>
#include <drivers/display.h>
#include <drivers/gpio.h>
#include <lvgl.h>
#include <stdio.h>
#include <string.h>
#include <zephyr.h>

#include "display.h"
#include "buttons.h"
#include "clock.h"
#include <logging/log.h>
LOG_MODULE_REGISTER(display, 3);

const static struct device * display_dev;

#define SCREEN_ID_0    0
#define SCREEN_ID_1    1
#define SCREEN_ID_2    2
#define SCREEN_ID_3    3
#define SCREEN_COUNT   4

#define PARAM_ID_0      0
#define PARAM_ID_1      1
#define PARAM_ID_2      2
#define PARAM_ID_3      3
#define PARAM_COUNT     3  //4

enum battery_symbol {
        BAT_CHARGE,
        BAT_FULL,
        BAT_3,
        BAT_2,
        BAT_1,
        BAT_EMPTY
};



void display_timer_handler(struct k_timer * timer);
void display_task_handler(struct k_work * work);

K_TIMER_DEFINE(display_timer, display_timer_handler, NULL);

K_WORK_DEFINE(display_work, display_task_handler);

#define TICK_PERIOD   (10)

//LV_IMG_DECLARE(icon1);
//LV_IMG_DECLARE(icon2);
//LV_IMG_DECLARE(icon3);
//LV_IMG_DECLARE(mask);

/*---------------------------------------------------------------------------*/
/*                                                                           */
/*---------------------------------------------------------------------------*/
void display_task_handler(struct k_work * work)
{
	lv_tick_inc(TICK_PERIOD);
	lv_task_handler();
}

void display_sleep(void)
{
//      (void)device_set_power_state(display_dev, DEVICE_PM_LOW_POWER_STATE, NULL,
//                                   NULL);
display_blanking_on(display_dev);

}



/*---------------------------------------------------------------------------*/
/*                                                                           */
/*---------------------------------------------------------------------------*/
void display_timer_handler(struct k_timer * timer)
{
	k_work_submit(&display_work);
}

/*---------------------------------------------------------------------------*/
/*                                                                           */
/*---------------------------------------------------------------------------*/

typedef struct {
	lv_obj_t     ** object; 
	short         * value;
	short           step;
	short           max;
	short           min;
} param_t;

typedef struct {
	lv_obj_t * screen;
	int        count;
} screens_t;

/*---------------------------------------------------------------------------*/
/*                                                                           */
/*---------------------------------------------------------------------------*/

static lv_obj_t   * button_obj;
//static lv_obj_t   * screen0_slider_obj;
//static short        screen0_slider_value;
static lv_obj_t   * screen0_label0_obj;
static lv_obj_t *time_label;
static lv_obj_t *date_label;
static lv_obj_t *title_label;
static lv_obj_t *battery_label;
static lv_obj_t *date_label;




static lv_obj_t   * screen1_label0_obj; 
static lv_obj_t   * screen1_label1_obj; 

static lv_obj_t   * screen2_label0_obj; 
static lv_obj_t   * screen2_label1_obj; 
static lv_obj_t   * screen2_label2_obj; 

static screens_t screens [] = {
	{ .screen = NULL, .count = 1 },
	{ .screen = NULL, .count = 2 },
	{ .screen = NULL, .count = 3 },
	{ .screen = NULL, .count = 0 },
};
#define SCREENS_COUNT (sizeof(screens)/sizeof(screens[0]))

/*---------------------------------------------------------------------------*/
/*                                                                           */
/*---------------------------------------------------------------------------*/
void display_time_set_label(char *str)
{
	lv_label_set_text(time_label, str);
	// lv_obj_align(time_label, NULL, LV_ALIGN_CENTER, 0, 0);
}
void display_date_set_label(char *str)
{
	lv_label_set_text(date_label, str);
	// lv_obj_align(date_label, NULL, LV_ALIGN_CENTER, 0, 8);
}







//#if defined(CONFIG_BOARD_NATIVE_POSIX_64BIT)
#if defined(CONFIG_LVGL_POINTER_KSCAN) //the pinetime has a pointer kscan as well ... todo .... cannot handle 2 same button events
//static uint8_t button_press_cnt;
//struct k_timer button_timer;

void display_clock_update() // jj
{
//update the clock, since clock appears only in first screen (0) 

                                               // if (screen_id == 0)
                                                //lv_scr_load(screens[screen_id].screen);
                                                lv_scr_load(screens[0].screen);



}




static void button_event_cb(lv_obj_t * obj, lv_event_t event)
{
	static int screen_id = 0;  // init to first screen id
	static int param_id  = 0;  // init to first parameter index
//	if (lv_btn_get_state(obj) == LV_BTN_STATE_PRESSED) {
//		LOG_INF("button state pressed button event\n");
//	}

	switch(event) {
		case LV_EVENT_PRESSED:
			//LOG_INF("Pressed\n");
			//LOG_INF("Button pressed at %" PRIu32 "\n", k_cycle_get_32());
			//this is to test timer event on real button - no real purpose in simulated board
			//LVGL event would be enough 
			//test the number of button is pressed within 3 seconds
/*			if (button_press_cnt == 0U) {
				k_timer_start(&button_timer, K_SECONDS(1), K_NO_WAIT);
			}


			if (k_timer_status_get(&button_timer) > 0) {
				// timer has expired 
				LOG_INF("SHORT PRESS EVENT %02x\n", button_press_cnt);
				if (button_press_cnt > 2){
					display_btn_event(BTN1_LONG);
				}
				else
				display_btn_event(BTN1_SHORT);
				button_press_cnt=0;
			} else  {
				// timer still running 
				button_press_cnt++;
				if (button_press_cnt > 2){
					LOG_INF("LONG PRESS EVENT %02x\n", button_press_cnt);
				//	display_btn_event(BTN1_LONG);
				}
			}*/ 
			break; 
		case LV_EVENT_SHORT_CLICKED:
			LOG_INF("Short clicked\n");
			break;

		case LV_EVENT_CLICKED:
			clock_increment_local_time();

			LOG_INF("Clicked\n");
			break;

		case LV_EVENT_LONG_PRESSED:
			clock_increment_local_time();
			clock_show_time();
			LOG_INF("Long press\n");
			break;

		case LV_EVENT_LONG_PRESSED_REPEAT:

			//this can be configured in menuconfig 
			//standard value < long_pressed
						screen_id++;
						if (screen_id >= SCREEN_COUNT)
						screen_id = 0;
						lv_scr_load(screens[screen_id].screen);
						param_id = 0;
						LOG_INF("BTN1: screen_id(%d)", screen_id);
			//   handle_button_event();



			LOG_INF("Long press repeat\n");
			break;

		case LV_EVENT_RELEASED:
			LOG_INF("Released\n");
			break;
	}

}
#endif
/*---------------------------------------------------------------------------*/
/*                                                                           */
/*---------------------------------------------------------------------------*/
//todo if no touch screen define real button ds_d6




void display_battery(enum battery_symbol s)
{
        switch (s) {
                case BAT_CHARGE:
                        lv_label_set_text(battery_label, LV_SYMBOL_CHARGE);
                        break;
                case BAT_FULL:
                        lv_label_set_text(battery_label, LV_SYMBOL_BATTERY_FULL);
                        break;
                case BAT_3:
                        lv_label_set_text(battery_label, LV_SYMBOL_BATTERY_3);
                        break;
                case BAT_2:
                        lv_label_set_text(battery_label, LV_SYMBOL_BATTERY_2);
                        break;
                case BAT_1:
                        lv_label_set_text(battery_label, LV_SYMBOL_BATTERY_1);
                        break;
                default:
                        lv_label_set_text(battery_label, LV_SYMBOL_BATTERY_EMPTY);
        }
}






void display_button()
{
	/* the ds_d6 has a real button and no touchscreen, so no need for lvgl-button */
#if defined(CONFIG_LVGL_POINTER_KSCAN)
//#if defined(CONFIG_BOARD_NATIVE_POSIX_64BIT)
	button_obj = lv_btn_create(lv_scr_act(), NULL);
	lv_obj_set_width(button_obj, 5);
	lv_obj_set_height(button_obj, 5);
	//lv_obj_align(button_obj, NULL, LV_ALIGN_CENTER, 128, 0);
	lv_obj_align(button_obj, NULL, LV_ALIGN_CENTER, 0, 0);
	lv_btn_set_fit(button_obj, LV_FIT_TIGHT);
	screen0_label0_obj = lv_label_create(button_obj, NULL);
	lv_label_set_text(screen0_label0_obj, "O"); //substitute for real switch on physical watch
	lv_obj_set_event_cb(button_obj, button_event_cb);
#endif

}


void display_btn_event(buttons_id_t btn_id)
{
	static int screen_id = 0;  // init to first screen id
	static int param_id  = 0;  // init to first parameter index

	//LOG_INF("%s: BTN%d", __func__, btn_id);

	switch (btn_id) {

		case BTN1_LONG:
			screen_id++;
			if (screen_id >= SCREEN_COUNT)
				screen_id = 0;
			lv_scr_load(screens[screen_id].screen);
			param_id = 0;
			LOG_INF("BTN1: screen_id(%d)", screen_id);
			break;

		case BTN1_SHORT:
			param_id++;
			if (param_id >= screens[screen_id].count)  param_id = 0;
			if (param_id < 0)                          param_id = 0;
			LOG_INF("BTN2: screen_id(%d) param_id(%d)", screen_id, param_id);
			break;


		default:
			break;
	}
}

/*---------------------------------------------------------------------------*/
/*                                                                           */
/*---------------------------------------------------------------------------*/
void display_screens_init(void)
{
	screens[0].screen = lv_obj_create(NULL, NULL);
	screens[1].screen = lv_obj_create(NULL, NULL);
	screens[2].screen = lv_obj_create(NULL, NULL);
	screens[3].screen = lv_obj_create(NULL, NULL);

	// lv_theme_t * mono = lv_theme_mono_init(0, NULL);
	// lv_theme_set_current(mono);

	/*
	 *  build basic screen0
	 */
	lv_scr_load(screens[0].screen);
	lv_obj_t * screen0_label = lv_label_create(lv_scr_act(), NULL);
	lv_label_set_text(screen0_label, "Pg1");
	lv_obj_align(screen0_label, screens[0].screen, LV_ALIGN_IN_TOP_RIGHT, 0, 0);
	/* the ds_d6 has a real button and no touchscreen, so no need for lvgl-button */
	display_button();

	/* Time label */
	time_label = lv_label_create(lv_scr_act(), NULL);
	lv_obj_align(time_label, NULL, LV_ALIGN_IN_TOP_MID, 0, 0); //jj
	lv_label_set_text(time_label, "00:00");
	/* Date label */
	date_label = lv_label_create(lv_scr_act(), NULL);
	lv_obj_align(date_label, NULL, LV_ALIGN_IN_BOTTOM_MID, 0, 0);
	lv_label_set_text(date_label, "Mon 10 Jan");

	/* title label */
	title_label = lv_label_create(lv_scr_act(), NULL);
	lv_obj_align(title_label, NULL, LV_ALIGN_IN_TOP_LEFT, 0, 0);
	//lv_label_set_text(title_label, LV_SYMBOL_BLUETOOTH"symb");
	//lv_label_set_text(title_label, LV_SYMBOL_BLUETOOTH);
	lv_label_set_text(title_label, LV_SYMBOL_WIFI);

	/* Battery label */
	//display_battery(3);
	battery_label = lv_label_create(lv_scr_act(), NULL);
	display_battery(BAT_3); //todo just demo value -- need real level
	//lv_label_set_text(battery_label, LV_SYMBOL_BATTERY_2);
        lv_obj_align(battery_label, NULL, LV_ALIGN_IN_BOTTOM_LEFT, 0, 0);

	//battery_label = lv_label_create(lv_scr_act(), NULL);
	//lv_obj_align(battery_label, NULL, LV_ALIGN_IN_TOP_MID, 0, 0);
	//lv_label_set_text(battery_label, LV_SYMBOL_BATTERY_EMPTY);


	//	lv_obj_t * mask = lv_img_create(lv_scr_act(), NULL);
	//	lv_img_set_src(mask, &mask);
	//	lv_obj_align(mask, NULL, LV_ALIGN_CENTER, 0, 0);


	//  hello_world_label = lv_label_create(hello_world_button, NULL);
	// printf("pointer enabled\n");
	// lv_label_set_text(hello_world_label, "O"); //substitute for real switch on physical watch
	//screen0_slider_obj = lv_slider_create(lv_scr_act(), NULL);
	//lv_obj_set_height(screen0_slider_obj, 10);
	//lv_obj_set_width(screen0_slider_obj, 110);
	//lv_obj_align(screen0_slider_obj, NULL, LV_ALIGN_CENTER, 0, 0);
	//lv_slider_set_value(screen0_slider_obj, 15, LV_ANIM_ON);
	//screen0_slider_value = 15;

	/*
	 *  build basic screen1
	 */
	lv_scr_load(screens[1].screen);
	lv_obj_t * screen1_page = lv_label_create(lv_scr_act(), NULL);
	lv_label_set_text(screen1_page, "Pg2");
	lv_obj_align(screen1_page, screens[1].screen, LV_ALIGN_IN_TOP_RIGHT, 0, 0);

	// to avoid creating the same button all over again jj
	display_button();

	screen1_label0_obj = lv_label_create(lv_scr_act(), NULL);
	lv_label_set_text(screen1_label0_obj, "0");
	lv_obj_align(screen1_label0_obj, screens[1].screen, LV_ALIGN_IN_BOTTOM_LEFT, 5, -5);

	screen1_label1_obj = lv_label_create(lv_scr_act(), NULL);
	lv_label_set_text(screen1_label1_obj, "0");
	lv_obj_align(screen1_label1_obj, screens[1].screen, LV_ALIGN_IN_BOTTOM_RIGHT, -15, -5);

	//	lv_obj_t * icon_1 = lv_img_create(lv_scr_act(), NULL);
	//	lv_img_set_src(icon_1, &icon1);
	//	lv_obj_align(icon_1, NULL, LV_ALIGN_CENTER, 0, 0);

	/*
	 *  build basic screen2
	 */
	lv_scr_load(screens[2].screen);
	lv_obj_t * screen2_page = lv_label_create(lv_scr_act(), NULL);
	lv_label_set_text(screen2_page, "Pg3");
	lv_obj_align(screen2_page, screens[2].screen, LV_ALIGN_IN_TOP_RIGHT, 0, 0);
	// why define the same button all over again? jj
	display_button();

	//
	lv_obj_t * screen2_label0_tag = lv_label_create(lv_scr_act(), NULL);
	lv_label_set_text(screen2_label0_tag, "value-0");
	lv_obj_align(screen2_label0_tag, screens[2].screen, LV_ALIGN_IN_TOP_RIGHT, -70, 2);

	screen2_label0_obj = lv_label_create(lv_scr_act(), NULL);
	lv_label_set_text(screen2_label0_obj, "0");
	lv_obj_align(screen2_label0_obj, screens[2].screen, LV_ALIGN_IN_TOP_RIGHT, -45, 2);

	//
	lv_obj_t * screen2_label1_tag = lv_label_create(lv_scr_act(), NULL);
	lv_label_set_text(screen2_label1_tag, "value-1");
	lv_obj_align(screen2_label1_tag, screens[2].screen, LV_ALIGN_IN_RIGHT_MID, -70, 0);

	screen2_label1_obj = lv_label_create(lv_scr_act(), NULL);
	lv_label_set_text(screen2_label1_obj, "0");
	lv_obj_align(screen2_label1_obj, screens[2].screen, LV_ALIGN_IN_RIGHT_MID, -45, 0);

	//
	lv_obj_t * screen2_value2_tag = lv_label_create(lv_scr_act(), NULL);
	lv_label_set_text(screen2_value2_tag, "value-2");
	lv_obj_align(screen2_value2_tag, screens[2].screen, LV_ALIGN_IN_BOTTOM_RIGHT, -70, -2);

	screen2_label2_obj = lv_label_create(lv_scr_act(), NULL);
	lv_label_set_text(screen2_label2_obj, "0");
	lv_obj_align(screen2_label2_obj, screens[2].screen, LV_ALIGN_IN_BOTTOM_RIGHT, -45, -2);

	//#if 0
	//	lv_obj_t * icon_2 = lv_img_create(lv_scr_act(), NULL);
	//	lv_img_set_src(icon_2, &icon2);
	//#endif

	/*
	 *  build basic screen3
	 */
	lv_scr_load(screens[3].screen);
	lv_obj_t * screen3_page = lv_label_create(lv_scr_act(), NULL);
	lv_label_set_text(screen3_page, "Sc4");
	lv_obj_align(screen3_page, screens[3].screen, LV_ALIGN_IN_TOP_RIGHT, 0, 0);

	// why define the same button all over again? jj
	display_button();

	//	lv_obj_t * icon_3 = lv_img_create(lv_scr_act(), NULL);
	//	lv_img_set_src(icon_3, &icon3);
	//	lv_obj_align(icon_3, NULL, LV_ALIGN_CENTER, 0, 0);
}

/*---------------------------------------------------------------------------*/
/*                                                                           */
/*---------------------------------------------------------------------------*/
#if defined(CONFIG_BOARD_PINETIME_DEVKIT1)


#define LED0_NODE DT_ALIAS(led1)

#if DT_NODE_HAS_STATUS(LED0_NODE, okay)
#define LED0    DT_GPIO_LABEL(LED0_NODE, gpios)
#define PIN     DT_GPIO_PIN(LED0_NODE, gpios)
#define FLAGS   DT_GPIO_FLAGS(LED0_NODE, gpios)
#endif
#endif

static void backlight_switch(bool enable)
{
#if defined(CONFIG_BOARD_PINETIME_DEVKIT1)

	const struct device *dev;

	dev = device_get_binding(LED0);
	/* If you have a backlight, set it up and turn it on here */
	gpio_pin_configure(dev, PIN, GPIO_OUTPUT_ACTIVE | FLAGS);
	//   gpio_pin_configure(dev, LED, GPIO_DIR_OUT);
	if (enable==true) 
	gpio_pin_set(dev, PIN, 1);
	else
	gpio_pin_set(dev, PIN, 0);
	//gpio_pin_write(dev, LED, 0);
#endif
}




int display_init(void)
{
//#if defined(CONFIG_BOARD_PINETIME_DEVKIT1)
	backlight_switch(true); //jj check which board has backlight is done in procedure
//#endif
	display_dev = device_get_binding(CONFIG_LVGL_DISPLAY_DEV_NAME);

	if (display_dev == NULL) {
		LOG_ERR("device not found. %s", CONFIG_LVGL_DISPLAY_DEV_NAME);
		return -1;
	}

	//lv_init();

	display_screens_init();

	/*
	 *  First screen will be screen1
	 */
	lv_scr_load(screens[0].screen);

	/*
	 *  Turn on display
	 */
	lv_task_handler();//jj
	display_blanking_off(display_dev);

	/* 
	 * Register for button press notifications.
	 */
	//buttons_register_notify_handler(display_btn_event);

	/*
	 *  Start task handler timer loop
	 */
	k_timer_start(&display_timer, K_MSEC(TICK_PERIOD), K_MSEC(TICK_PERIOD));

	return 0;
};
```

## src/event_handler.c
```c
/*
 * Copyright (c) 2021 najnesnaj@yahoo.com
 *
 * SPDX-License-Identifier: Apache-2.0
 */

#include <zephyr.h>
#include <drivers/gpio.h>
#include <drivers/sensor.h>
//#include <drivers/sensor/cst816s.h>
#include <stdbool.h>
#include "battery.h"
#include "bt.h"
#include "clock.h"
#include "display.h"
#include "event_handler.h"
#include "log.h"
#include "buttons.h"

/* ********** defines ********** */
#define BAT_CHA 2 //jj
#define BTN_PORT DT_GPIO_LABEL(DT_ALIAS(sw0), gpios)
#define BTN_IN  DT_GPIO_PIN(DT_ALIAS(sw0), gpios)
#define BTN_OUT 3 //jj 
#define EDGE    (GPIO_INT_EDGE | GPIO_INT_DOUBLE_EDGE)
#define PULL_UP DT_GPIO_FLAGS(DT_ALIAS(sw0), gpios)
#define DISPLAY_TIMEOUT K_SECONDS(500) //jj suppose you leave display on -- time should be updated
#define CLOCK_UPDATE K_SECONDS(20) //jj every minute clock should get update 
#ifdef CONFIG_BOOTLOADER_MCUBOOT
/* The watchdog released by the PineTime bootloader v5.0.0-rc1
 * will try to bite every 7 seconds.
 */
#define WDT_REFRESH 6
#endif
/* ********** ******* ********** */

/* ********** variables ********** */
#ifdef CONFIG_BOOTLOADER_MCUBOOT
static struct k_timer watchdog_refresh_timer;
#endif
static struct k_timer clock_update_timer; //jj
static struct k_timer display_off_timer;
static const struct device *charging_dev;
//static struct gpio_callback charging_cb;
//static const struct device *button_dev;
//static struct gpio_callback button_cb;


//when used with the native_posix_64 virtual device there are no buttons ...
#if !(defined(CONFIG_BOARD_NATIVE_POSIX_64BIT))
//#if (defined(CONFIG_BOARD_DS_D6) || defined(CONFIG_BOARD_PINETIME_DEVKIT1))

#define SW0_NODE        DT_ALIAS(sw0)

#if DT_NODE_HAS_STATUS(SW0_NODE, okay)
#define SW0_GPIO_LABEL  DT_GPIO_LABEL(SW0_NODE, gpios)
#define SW0_GPIO_PIN    DT_GPIO_PIN(SW0_NODE, gpios)
#define SW0_GPIO_FLAGS  (GPIO_INPUT | DT_GPIO_FLAGS(SW0_NODE, gpios))
#else
#error "Unsupported board: sw0 devicetree alias is not defined"
#define SW0_GPIO_LABEL  ""
#define SW0_GPIO_PIN    0
#define SW0_GPIO_FLAGS  0
#endif

#if defined(CONFIG_BOARD_PINETIME_DEVKIT1) //pinetime needs port 15 high for switch to work
#define SW1_NODE        DT_ALIAS(sw1)
#define SW1_GPIO_PIN    DT_GPIO_PIN(SW1_NODE, gpios)
#define SW1_GPIO_FLAGS  (GPIO_OUTPUT | DT_GPIO_FLAGS(SW1_NODE, gpios))
#endif



static uint8_t button_press_cnt;
struct k_timer button_timer;
void button_pressed(const struct device *dev, struct gpio_callback *cb,
		uint32_t pins)
{
	buttons_id_t btn_id;

	LOG_INF("Button pressed at %" PRIu32 "\n", k_cycle_get_32());

	if (button_press_cnt == 0U) {
		k_timer_start(&button_timer, K_SECONDS(1), K_NO_WAIT);
		btn_id=BTN1_SHORT;
	}

	if (k_timer_status_get(&button_timer) > 0) {
		/* timer has expired */
		LOG_INF("SHORT PRESS EVENT %02x\n", button_press_cnt);
		if (button_press_cnt > 2){
			display_btn_event(BTN1_LONG);
		}
		else
			display_btn_event(BTN1_SHORT);
		button_press_cnt=0;
	} else  {
		/* timer still running */
		button_press_cnt++;
		if (button_press_cnt > 2){
			LOG_INF("LONG PRESS EVENT %02x\n", button_press_cnt);
			//      display_btn_event(BTN1_LONG);
		}
	}



	//	printk("button_press_cnt 0x%02x\n", button_press_cnt);
	//	button_press_cnt++;



	// 	LOG_INF("Button time %d\n", button_time);
	//      sensor_attr_set(dev, SENSOR_CHAN_LIGHT, SENSOR_ATTR_SAMPLING_FREQUENCY,0x22);
	//	button_time_previous = k_cycle_get32();
}


static struct gpio_callback button_cb_data;

void init_button(void)
{
	const struct device *button;
	int ret;
	button = device_get_binding(SW0_GPIO_LABEL);
	if (button == NULL) {
		printk("Error: didn't find %s device\n", SW0_GPIO_LABEL);
		return;
	}

	ret = gpio_pin_configure(button, SW0_GPIO_PIN, SW0_GPIO_FLAGS);
	if (ret != 0) {
		printk("Error %d: failed to configure %s pin %d\n",
				ret, SW0_GPIO_LABEL, SW0_GPIO_PIN);
		return;
	}

	ret = gpio_pin_interrupt_configure(button,
			SW0_GPIO_PIN,
			GPIO_INT_EDGE_TO_ACTIVE);
	if (ret != 0) {
		printk("Error %d: failed to configure interrupt on %s pin %d\n",
				ret, SW0_GPIO_LABEL, SW0_GPIO_PIN);
		return;
	}
#if defined(CONFIG_BOARD_PINETIME_DEVKIT1)
//port 15 has to be high in order for the button to work


        gpio_pin_configure(button, SW1_GPIO_PIN,SW1_GPIO_FLAGS); //push button out
        gpio_pin_set(button, SW1_GPIO_PIN, 1); //set port high



#endif



	gpio_init_callback(&button_cb_data, button_pressed, BIT(SW0_GPIO_PIN));
	gpio_add_callback(button, &button_cb_data);
	printk("Set up button at %s pin %d\n", SW0_GPIO_LABEL, SW0_GPIO_PIN);



}
#endif

//static struct gpio_callback button_cb;

/* ********** ********* ********** */


/* ********** init function ********** */
void event_handler_init()
{
	/*
#if !(defined(CONFIG_BOARD_NATIVE_POSIX_64BIT))
	//	charging_dev = device_get_binding("GPIO_0");
	gpio_pin_configure(charging_dev, BAT_CHA, GPIO_INPUT | GPIO_INT_EDGE_BOTH);
	//	gpio_init_callback(&charging_cb, battery_charging_isr, BIT(BAT_CHA));
	button_dev = device_get_binding(BTN_PORT);
	gpio_pin_configure(button_dev, BTN_IN, GPIO_INPUT | GPIO_INT_EDGE_FALLING | PULL_UP);
	gpio_init_callback(&button_cb, button_pressed_isr, BIT(BTN_IN));

	gpio_add_callback(charging_dev, &charging_cb);
	gpio_add_callback(button_dev, &button_cb);

	uint32_t button_out = 1U;
	gpio_pin_configure(button_dev, BTN_OUT, GPIO_OUTPUT);
	gpio_pin_set_raw(button_dev, BTN_OUT, button_out);

#endif
	 */

	/* Start timers */
#ifdef CONFIG_BOOTLOADER_MCUBOOT
	if (NRF_WDT->RUNSTATUS) {
		LOG_INF("Watchdog detected. Let's kick it every %d seconds.",
				WDT_REFRESH);
		k_timer_init(&watchdog_refresh_timer, watchdog_refresh_isr,
				NULL);
		k_timer_start(&watchdog_refresh_timer, K_NO_WAIT,
				K_SECONDS(WDT_REFRESH));
	} else {
		LOG_INF("No watchdog detected.");
	}
#endif
	k_timer_init(&clock_update_timer, handle_clock_update, NULL); //jj
	k_timer_start(&clock_update_timer,CLOCK_UPDATE, K_NO_WAIT); //jj
	k_timer_init(&display_off_timer, display_off_isr, NULL);
	k_timer_start(&display_off_timer, DISPLAY_TIMEOUT, K_NO_WAIT);

	/* Special cases */
	/* Get battery charging status */
	//	k_sleep(K_MSEC(10));
	//	uint32_t res =  gpio_pin_get(charging_dev, BAT_CHA);
	//	battery_update_charging_status(res != 1U);

	/* Show time, date and battery status */
	clock_show_time();
	//	battery_show_status();

	LOG_DBG("Event handler init: Done");
}
/* ********** ************ ********** */

/* ********** interrupt handlers ********** */
#ifdef CONFIG_BOOTLOADER_MCUBOOT
void watchdog_refresh_isr(struct k_timer *wdt_refresh)
{
	NRF_WDT->RR[0] = WDT_RR_RR_Reload;
}
#endif

void display_off_isr(struct k_timer *light_off)
{
	//backlight_switch(false);
	printk("display_sleep in display_off_isr\n");
	display_sleep();
}

void battery_charging_isr(const struct device *gpiobat, struct gpio_callback *cb, uint32_t pins)
{
	uint32_t res = gpio_pin_get(charging_dev, BAT_CHA);
	battery_update_charging_status(res != 1U);
}

void button_pressed_isr(const struct device *gpiobtn, struct gpio_callback *cb, uint32_t pins)
{
	//display_wake_up();
	//backlight_switch(true);
	k_timer_start(&display_off_timer, DISPLAY_TIMEOUT, K_NO_WAIT);

	handle_button_event();
}

void handle_clock_update(struct k_timer *clock_update) //jj if clock displayed, it should get the updated time
{
printk("handle_clock_update\n");
	clock_increment_local_time();
	clock_show_time();
	display_clock_update(); //multiple screens but clock only appears in 1st
	k_timer_start(clock_update,CLOCK_UPDATE, K_NO_WAIT); //timer gets started again -- perpetuum mobile
}


/* ********** ************** ********** */
int handle_button_event(void)
{
	clock_increment_local_time();
	clock_show_time();
	//      battery_show_status();
	//gfx_update();
	return 1;
}
```
