## CMakeLists.txt
```
# SPDX-License-Identifier: Apache-2.0
#list(APPEND ZEPHYR_EXTRA_MODULES /root/zephyrproject/app/drivers/kscan2)
cmake_minimum_required(VERSION 3.13.1)
#list(APPEND ZEPHYR_EXTRA_MODULES
#  ${CMAKE_CURRENT_SOURCE_DIR}/oswatch_drivers
#  ${CMAKE_CURRENT_SOURCE_DIR}/lvgl
#  )


# Add the board
list(APPEND BOARD_ROOT ${CMAKE_CURRENT_LIST_DIR})
#list(APPEND DTS_ROOT ${CMAKE_CURRENT_LIST_DIR}/..)
#add_subdirectory(drivers/kscan2)
# Enable configurations through environment variables
#set(CONF_FILE ${CMAKE_CURRENT_LIST_DIR}/config/prj.conf ${CMAKE_CURRENT_LIST_DIR}/config/bootloader.conf)
#IF("$ENV{BOOTLOADER}" STREQUAL "off")
#  set(CONF_FILE ${CMAKE_CURRENT_LIST_DIR}/config/prj.conf)
#ENDIF()
#IF("$ENV{LOGGING}" STREQUAL "on")
#  set(CONF_FILE ${CONF_FILE} ${CMAKE_CURRENT_LIST_DIR}/config/logging_rtt.conf)
#ENDIF()

find_package(Zephyr REQUIRED HINTS $ENV{ZEPHYR_BASE})
include_directories(include)
project(sdlbutton)

FILE(GLOB app_sources src/*.c)
target_sources(app PRIVATE ${app_sources})

# Get current time
string(TIMESTAMP CURRENT_TIME %Y-%m-%dT%H:%M:%S)

# Get short commit hash
execute_process(
  COMMAND ${GIT_EXECUTABLE} describe --tags
  WORKING_DIRECTORY ${CMAKE_CURRENT_LIST_DIR}
  OUTPUT_VARIABLE FW_BUILD_GIT
  OUTPUT_STRIP_TRAILING_WHITESPACE
)
set(CMAKE_C_FLAGS "${CMAKE_C_FLAGS} -DCURRENT_TIME_OF_BUILD=\"${CURRENT_TIME}\" -DFW_BUILD=\"${FW_BUILD_GIT}\"")
set(ZEPHYR_BOARD_FLASH_RUNNER jlink)
```

## prj.conf
```kconfig
#CONFIG_HEAP_MEM_POOL_SIZE=16384
#CONFIG_MAIN_STACK_SIZE=2048

CONFIG_DISPLAY=y
CONFIG_DISPLAY_LOG_LEVEL_ERR=y
#CONFIG_LOG=y
#CONFIG_ST7789V=y
CONFIG_LVGL=y
CONFIG_LVGL_USE_LABEL=y
CONFIG_LVGL_USE_CONT=y
CONFIG_LVGL_USE_BTN=y
CONFIG_LVGL_USE_LED=y
CONFIG_LVGL_USE_THEME_MATERIAL=n
#CONFIG_ST7789V=y
CONFIG_LVGL_VDB_SIZE=15
CONFIG_USE_SEGGER_RTT=y
CONFIG_LVGL_USE_API_EXTENSION_V7=y
CONFIG_LVGL_POINTER_KSCAN=y
#CONFIG_LVGL_FONT_MONTSERRAT_28_COMPRESSED=y
CONFIG_LVGL_FONT_UNSCII_8=n
CONFIG_LVGL_USE_THEME_MONO=y
CONFIG_LVGL_THEME_DEFAULT_COLOR_PRIMARY_WHITE=y
CONFIG_LVGL_FONT_MONTSERRAT_28=y
```

## boards/native_posix_64.conf
```kconfig
CONFIG_SDL_DISPLAY_DEV_NAME="DISPLAY"
CONFIG_SDL_DISPLAY_X_RES=300
CONFIG_SDL_DISPLAY_Y_RES=64
CONFIG_KSCAN=y
CONFIG_LVGL_POINTER_KSCAN=y
CONFIG_LVGL_POINTER_KSCAN_DEV_NAME="KSCAN"
CONFIG_SDL_POINTER_KSCAN_DEV_NAME="KSCAN"
```

## src/main.c
```c
/*
 * Copyright (c) 2021  <najnesnaj@yahoo.com>
 *
 * SPDX-License-Identifier: Apache-2.0
 */

#include <device.h>
#include <drivers/display.h>
#include <lvgl.h>
#include <stdio.h>
#include <string.h>
#include <zephyr.h>
#include <drivers/gpio.h>
#define LOG_LEVEL CONFIG_LOG_DEFAULT_LEVEL
#include <logging/log.h>

#define LED_TIMEOUT K_SECONDS(2)


LOG_MODULE_REGISTER(app);

static struct k_timer led_timer;

static lv_obj_t * led2;

int toggle_state=0;

void toggle_led(struct k_timer *led_off)
{
	if (toggle_state==0){
		lv_led_off(led2);
		printk("led off triggered\n");
		toggle_state=1;
	}
	else
	{ 
		lv_led_on(led2);
		printk("led on triggered\n");
		toggle_state=0;
	}
	k_timer_start(led_off, LED_TIMEOUT, K_NO_WAIT);
	lv_task_handler();
}





void display_led()
{
	led2  = lv_led_create(lv_scr_act(), NULL);
	lv_obj_align(led2, NULL,  LV_ALIGN_CENTER, 0, 0);
	lv_led_on(led2);
	lv_led_set_bright(led2, 255);
	lv_obj_set_width(led2, 10);
	lv_obj_set_height(led2, 10);

}


void main(void)
{
	const struct device *display_dev;
	k_timer_init(&led_timer, toggle_led, NULL);
	k_timer_start(&led_timer, LED_TIMEOUT, K_NO_WAIT);

	display_dev = device_get_binding(CONFIG_LVGL_DISPLAY_DEV_NAME);

	if (display_dev == NULL) {
		LOG_ERR("device not found.  Aborting test.");
		return;
	}


	display_blanking_off(display_dev);
	display_led();
	while (1) {
		printf("while loop\n");
		k_sleep(K_MSEC(100));
		//	lv_task_handler();
	}
}
```
