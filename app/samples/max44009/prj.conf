## CMakeLists.txt
```
# SPDX-License-Identifier: Apache-2.0
#list(APPEND ZEPHYR_EXTRA_MODULES /root/zephyrproject/app/drivers/kscan2)
cmake_minimum_required(VERSION 3.13.1)
list(APPEND ZEPHYR_EXTRA_MODULES
  ${CMAKE_CURRENT_SOURCE_DIR}/drivers
  )


# Add the board
list(APPEND BOARD_ROOT ${CMAKE_CURRENT_LIST_DIR})
#list(APPEND DTS_ROOT ${CMAKE_CURRENT_LIST_DIR}/..)
#add_subdirectory(drivers/kscan2)
# Enable configurations through environment variables
#set(CONF_FILE ${CMAKE_CURRENT_LIST_DIR}/config/prj.conf ${CMAKE_CURRENT_LIST_DIR}/config/bootloader.conf)
#IF("$ENV{BOOTLOADER}" STREQUAL "off")
#  set(CONF_FILE ${CMAKE_CURRENT_LIST_DIR}/config/prj.conf)
#ENDIF()
#IF("$ENV{LOGGING}" STREQUAL "on")
#  set(CONF_FILE ${CONF_FILE} ${CMAKE_CURRENT_LIST_DIR}/config/logging_rtt.conf)
#ENDIF()

find_package(Zephyr REQUIRED HINTS $ENV{ZEPHYR_BASE})
include_directories(include)
project(lightsensor)

FILE(GLOB app_sources src/*.c)
target_sources(app PRIVATE ${app_sources})

# Get current time
string(TIMESTAMP CURRENT_TIME %Y-%m-%dT%H:%M:%S)

# Get short commit hash
execute_process(
  COMMAND ${GIT_EXECUTABLE} describe --tags
  WORKING_DIRECTORY ${CMAKE_CURRENT_LIST_DIR}
  OUTPUT_VARIABLE FW_BUILD_GIT
  OUTPUT_STRIP_TRAILING_WHITESPACE
)
set(CMAKE_C_FLAGS "${CMAKE_C_FLAGS} -DCURRENT_TIME_OF_BUILD=\"${CURRENT_TIME}\" -DFW_BUILD=\"${FW_BUILD_GIT}\"")
set(ZEPHYR_BOARD_FLASH_RUNNER jlink)
```

## prj.conf
```kconfig
CONFIG_PRINTK=y
CONFIG_I2C=y
#CONFIG_SENSOR=y
#CONFIG_MAX44009=y
```

## src/main.c
```c
/*
 * Copyright (c) 2016 Intel Corporation
 *
 * SPDX-License-Identifier: Apache-2.0
 * Copyright (c) 2021 <najnesnaj@yahoo.com>
 */

#include <zephyr.h>
#include <sys/printk.h>
#include <drivers/sensor.h>

#include <device.h>

/**
 * @file Sample app using the MAX44009 light sensor through ARC I2C.
 *
 * This app will read the sensor reading via I2C interface and show
 * the result every 4 seconds.
 */



/* The devicetree node identifier for the "led0" alias. */
/*#define LED0_NODE DT_ALIAS(led0)

//#if DT_NODE_HAS_STATUS(LED0_NODE, okay)
#define LED0    DT_GPIO_LABEL(LED0_NODE, gpios)
#define PIN     DT_GPIO_PIN(LED0_NODE, gpios)
#define FLAGS   DT_GPIO_FLAGS(LED0_NODE, gpios)
*/
//#else
/* A build error here means your board isn't set up to blink an LED. */
/*#error "Unsupported board: led0 devicetree alias is not defined"
#define LED0    ""
#define PIN     0
#define FLAGS   0
#endif
*/





void main(void)
{
	const struct device *dev;
	printk("MAX44009 light sensor application\n");


	struct sensor_value val;
	uint32_t lum = 0U;
	dev = device_get_binding("MAX44009");
	if (!dev) {
		printk("sensor: device not found.\n");
		return;
	}

	while (1) {
		if (sensor_sample_fetch_chan(dev, SENSOR_CHAN_LIGHT) != 0) {
			printk("sensor: sample fetch fail.\n");
			return;
		}

		if (sensor_channel_get(dev, SENSOR_CHAN_LIGHT, &val) != 0) {
			printk("sensor: channel get fail.\n");
			return;
		}

		lum = val.val1;
		printk("sensor: lum reading: %d\n", lum);

		k_sleep(K_MSEC(10));
	}
}
```
