## prj.conf
```kconfig
CONFIG_BATTERY=y

#CONFIG_LOG=y
#CONFIG_ADC_LOG_LEVEL_INF=y

#enable shell over RTT
CONFIG_USE_SEGGER_RTT=y
CONFIG_SHELL=y
CONFIG_SHELL_BACKEND_SERIAL=n
CONFIG_SHELL_BACKEND_RTT=y
CONFIG_CONSOLE=y
CONFIG_RTT_CONSOLE=y
```

## src/main.c
```c
/*
 *
 * SPDX-License-Identifier: Apache-2.0
 */

/* measure battery power on pin 31 of the Pinetime
 */

#include <zephyr.h>
#include <battery.h>

void main(void)
{
	int err;

	err = battery_init(NULL);
	if (err < 0) {
		printk("init failed (%d)\n", err);
		return;
	}

	k_sleep(K_FOREVER);
}
```
