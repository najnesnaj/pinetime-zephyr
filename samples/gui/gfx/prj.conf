## CMakeLists.txt
```
# SPDX-License-Identifier: Apache-2.0

cmake_minimum_required(VERSION 3.13.1)
include($ENV{ZEPHYR_BASE}/../pinetime/cmake/boilerplate.cmake)
include($ENV{ZEPHYR_BASE}/cmake/app/boilerplate.cmake NO_POLICY_SCOPE)
project(st7789v)

include_directories(include)
FILE(GLOB_RECURSE app_sources include/*.cpp src/*.cpp)
target_sources(app PRIVATE ${app_sources} src/main.cpp)
```

## prj.conf
```kconfig
CONFIG_PRINTK=y

CONFIG_HEAP_MEM_POOL_SIZE=16384

CONFIG_GPIO=y
CONFIG_SPI=y

CONFIG_DISPLAY=y
CONFIG_ST7789V=y
#CONFIG_ST7789V_LCD_TL019FQV01=n
CONFIG_ST7789V_RGB565=y

CONFIG_DISPLAY_LOG_LEVEL_DBG=y

CONFIG_LOG=y



CONFIG_CPLUSPLUS=y
CONFIG_MINIMAL_LIBC_MALLOC_ARENA_SIZE=128

CONFIG_NEWLIB_LIBC=y
```

## src/main.cpp
```c
#include <logging/log.h>
LOG_MODULE_REGISTER(app, LOG_LEVEL_INF);

#include <zephyr.h>
#include <device.h>
#include <display.h>
#include <drivers/gpio.h>

#include "GFX.h"
GFX* tft;

#define LED_PORT        DT_ALIAS_LED1_GPIOS_CONTROLLER
#define LED             DT_ALIAS_LED1_GPIOS_PIN

struct device *display_dev;

static void backlight_init(void)
{
	struct device *dev;

	dev = device_get_binding(LED_PORT);
    /* If you have a backlight, set it up and turn it on here */
	gpio_pin_configure(dev, LED, GPIO_DIR_OUT);
	gpio_pin_write(dev, LED, 0);
}

void delay(int ms) {
	k_sleep(K_MSEC(ms));
}

uint16_t millis() { return 0; }

float p = 3.1415926;

void testlines(uint16_t color) {
  tft->fillScreen(ST77XX_BLACK);
  for (int16_t x=0; x < tft->width(); x+=6) {
    tft->drawLine(0, 0, x, tft->height()-1, color);
    delay(0);
  }
  for (int16_t y=0; y < tft->height(); y+=6) {
    tft->drawLine(0, 0, tft->width()-1, y, color);
    delay(0);
  }

  tft->fillScreen(ST77XX_BLACK);
  for (int16_t x=0; x < tft->width(); x+=6) {
    tft->drawLine(tft->width()-1, 0, x, tft->height()-1, color);
    delay(0);
  }
  for (int16_t y=0; y < tft->height(); y+=6) {
    tft->drawLine(tft->width()-1, 0, 0, y, color);
    delay(0);
  }

  tft->fillScreen(ST77XX_BLACK);
  for (int16_t x=0; x < tft->width(); x+=6) {
    tft->drawLine(0, tft->height()-1, x, 0, color);
    delay(0);
  }
  for (int16_t y=0; y < tft->height(); y+=6) {
    tft->drawLine(0, tft->height()-1, tft->width()-1, y, color);
    delay(0);
  }

  tft->fillScreen(ST77XX_BLACK);
  for (int16_t x=0; x < tft->width(); x+=6) {
    tft->drawLine(tft->width()-1, tft->height()-1, x, 0, color);
    delay(0);
  }
  for (int16_t y=0; y < tft->height(); y+=6) {
    tft->drawLine(tft->width()-1, tft->height()-1, 0, y, color);
    delay(0);
  }
}

void testdrawtext(char *text, uint16_t color) {
  tft->setCursor(0, 0);
  tft->setTextColor(color);
  tft->setTextWrap(true);
  tft->print(text);
}

void testfastlines(uint16_t color1, uint16_t color2) {
  tft->fillScreen(ST77XX_BLACK);
  for (int16_t y=0; y < tft->height(); y+=5) {
    tft->drawFastHLine(0, y, tft->width(), color1);
  }
  for (int16_t x=0; x < tft->width(); x+=5) {
    tft->drawFastVLine(x, 0, tft->height(), color2);
  }
}

void testdrawrects(uint16_t color) {
  tft->fillScreen(ST77XX_BLACK);
  for (int16_t x=0; x < tft->width(); x+=6) {
    tft->drawRect(tft->width()/2 -x/2, tft->height()/2 -x/2 , x, x, color);
  }
}

void testfillrects(uint16_t color1, uint16_t color2) {
  tft->fillScreen(ST77XX_BLACK);
  for (int16_t x=tft->width()-1; x > 6; x-=6) {
    tft->fillRect(tft->width()/2 -x/2, tft->height()/2 -x/2 , x, x, color1);
    tft->drawRect(tft->width()/2 -x/2, tft->height()/2 -x/2 , x, x, color2);
  }
}

void testfillcircles(uint8_t radius, uint16_t color) {
  for (int16_t x=radius; x < tft->width(); x+=radius*2) {
    for (int16_t y=radius; y < tft->height(); y+=radius*2) {
      tft->fillCircle(x, y, radius, color);
    }
  }
}

void testdrawcircles(uint8_t radius, uint16_t color) {
  for (int16_t x=0; x < tft->width()+radius; x+=radius*2) {
    for (int16_t y=0; y < tft->height()+radius; y+=radius*2) {
      tft->drawCircle(x, y, radius, color);
    }
  }
}

void testtriangles() {
  tft->fillScreen(ST77XX_BLACK);
  uint16_t color = 0xF800;
  int t;
  int w = tft->width()/2;
  int x = tft->height()-1;
  int y = 0;
  int z = tft->width();
  for(t = 0 ; t <= 15; t++) {
    tft->drawTriangle(w, y, y, x, z, x, color);
    x-=4;
    y+=4;
    z-=4;
    color+=100;
  }
}

void testroundrects() {
  tft->fillScreen(ST77XX_BLACK);
  uint16_t color = 100;
  int i;
  int t;
  for(t = 0 ; t <= 4; t+=1) {
    int x = 0;
    int y = 0;
    int w = tft->width()-2;
    int h = tft->height()-2;
    for(i = 0 ; i <= 16; i+=1) {
      tft->drawRoundRect(x, y, w, h, 5, color);
      x+=2;
      y+=3;
      w-=4;
      h-=6;
      color+=1100;
    }
    color+=100;
  }
}

void tftPrintTest() {
  tft->setTextWrap(false);
  tft->fillScreen(ST77XX_BLACK);
  tft->setCursor(0, 30);
  tft->setTextColor(ST77XX_RED);
  tft->setTextSize(1);
  tft->println("Hello World!");
  tft->setTextColor(ST77XX_YELLOW);
  tft->setTextSize(2);
  tft->println("Hello World!");
  tft->setTextColor(ST77XX_GREEN);
  tft->setTextSize(3);
  tft->println("Hello World!");
  tft->setTextColor(ST77XX_BLUE);
  tft->setTextSize(4);
  tft->print(1234.567);
  delay(1500);
  tft->setCursor(0, 0);
  tft->fillScreen(ST77XX_BLACK);
  tft->setTextColor(ST77XX_WHITE);
  tft->setTextSize(0);
  tft->println("Hello World!");
  tft->setTextSize(1);
  tft->setTextColor(ST77XX_GREEN);
  tft->print(p, 6);
  tft->println(" Want pi?");
  tft->println(" ");
  tft->print(8675309, HEX); // print 8,675,309 out in HEX!
  tft->println(" Print HEX!");
  tft->println(" ");
  tft->setTextColor(ST77XX_WHITE);
  tft->println("Sketch has been");
  tft->println("running for: ");
  tft->setTextColor(ST77XX_MAGENTA);
  tft->print(millis() / 1000);
  tft->setTextColor(ST77XX_WHITE);
  tft->print(" seconds.");
}

void mediabuttons() {
  // play
  tft->fillScreen(ST77XX_BLACK);
  tft->fillRoundRect(25, 10, 78, 60, 8, ST77XX_WHITE);
  tft->fillTriangle(42, 20, 42, 60, 90, 40, ST77XX_RED);
  delay(500);
  // pause
  tft->fillRoundRect(25, 90, 78, 60, 8, ST77XX_WHITE);
  tft->fillRoundRect(39, 98, 20, 45, 5, ST77XX_GREEN);
  tft->fillRoundRect(69, 98, 20, 45, 5, ST77XX_GREEN);
  delay(500);
  // play color
  tft->fillTriangle(42, 20, 42, 60, 90, 40, ST77XX_BLUE);
  delay(50);
  // pause color
  tft->fillRoundRect(39, 98, 20, 45, 5, ST77XX_RED);
  tft->fillRoundRect(69, 98, 20, 45, 5, ST77XX_RED);
  // play color
  tft->fillTriangle(42, 20, 42, 60, 90, 40, ST77XX_GREEN);
}

void setup(void) {
  tft->fillScreen(ST77XX_BLACK);

  delay(500);

  // large block of text
  tft->fillScreen(ST77XX_BLACK);
  testdrawtext("Lorem ipsum dolor sit amet, consectetur adipiscing elit. Curabitur adipiscing ante sed nibh tincidunt feugiat. Maecenas enim massa, fringilla sed malesuada et, malesuada sit amet turpis. Sed porttitor neque ut ante pretium vitae malesuada nunc bibendum. Nullam aliquet ultrices massa eu hendrerit. Ut sed nisi lorem. In vestibulum purus a tortor imperdiet posuere. ", ST77XX_WHITE);
  delay(1000);

  // tft print function!
  tftPrintTest();
  delay(4000);

  // a single pixel
  tft->drawPixel(tft->width()/2, tft->height()/2, ST77XX_GREEN);
  delay(500);

  // line draw test
  testlines(ST77XX_YELLOW);
  delay(500);

  // optimized lines
  testfastlines(ST77XX_RED, ST77XX_BLUE);
  delay(500);

  testdrawrects(ST77XX_GREEN);
  delay(500);

  testfillrects(ST77XX_YELLOW, ST77XX_MAGENTA);
  delay(500);

  tft->fillScreen(ST77XX_BLACK);
  testfillcircles(10, ST77XX_BLUE);
  testdrawcircles(10, ST77XX_WHITE);
  delay(500);

  testroundrects();
  delay(500);

  testtriangles();
  delay(500);

  mediabuttons();
  delay(500);

  delay(1000);
}

void loop() {
  for (int i = 0; i < 10; i++) {
    tft->invertDisplay(true);
    delay(500);
    tft->invertDisplay(false);
    delay(500);
  }
}

void main(void)
{
	LOG_INF("GFX library sample");
	
	backlight_init();

#ifdef CONFIG_ST7789V_RGB565
	//const size_t rgb_size = 2;
#else
	//const size_t rgb_size = 3;
	LOG_ERR("RGB888 mode not supported. Aborting test.");
	return;
#endif

	display_dev = device_get_binding(DT_INST_0_SITRONIX_ST7789V_LABEL);

	if (display_dev == NULL) {
		LOG_ERR("Device not found. Aborting test.");
		return;
	}

	display_blanking_off(display_dev);

	tft = createGFX(display_dev);

	while (1) {
		setup();
		loop();
	}
}
```

## include/Arduino.h
```c
//
// Arduino-specific definitions
//

// data types
#define boolean bool

// functions
#define memmove_P memmove
#define memcpy_P memcpy
```

## include/Printable.h
```c
/*
 Printable.h - Interface class that allows printing of complex types
 Copyright (c) 2011 Adrian McEwen.  All right reserved.

 This library is free software; you can redistribute it and/or
 modify it under the terms of the GNU Lesser General Public
 License as published by the Free Software Foundation; either
 version 2.1 of the License, or (at your option) any later version.

 This library is distributed in the hope that it will be useful,
 but WITHOUT ANY WARRANTY; without even the implied warranty of
 MERCHANTABILITY or FITNESS FOR A PARTICULAR PURPOSE.  See the GNU
 Lesser General Public License for more details.

 You should have received a copy of the GNU Lesser General Public
 License along with this library; if not, write to the Free Software
 Foundation, Inc., 51 Franklin St, Fifth Floor, Boston, MA  02110-1301  USA
 */

#ifndef Printable_h
#define Printable_h

#include <stdlib.h>

class Print;

/** The Printable class provides a way for new classes to allow themselves to be printed.
 By deriving from Printable and implementing the printTo method, it will then be possible
 for users to print out instances of this class by passing them into the usual
 Print::print and Print::println methods.
 */

class Printable {
    public:
        virtual size_t printTo(Print& p) const = 0;
};

#endif
```

## include/common.cpp
```c
#include "common.h"

// >>> [1] Source: https://www.techiedelight.com/implement-itoa-function-in-c/
// inline function to swap two numbers
inline void swap(char *x, char *y) {
	char t = *x; *x = *y; *y = t;
}

// function to reverse buffer[i..j]
char* reverse(char *buffer, int i, int j)
{
	while (i < j)
		swap(&buffer[i++], &buffer[j--]);

	return buffer;
}

// Iterative function to implement itoa() function in C
char* itoa(int value, char* buffer, int base)
{
	// invalid input
	if (base < 2 || base > 32)
		return buffer;

	// consider absolute value of number
	int n = abs(value);

	int i = 0;
	while (n)
	{
		int r = n % base;

		if (r >= 10) 
			buffer[i++] = 65 + (r - 10);
		else
			buffer[i++] = 48 + r;

		n = n / base;
	}

	// if number is 0
	if (i == 0)
		buffer[i++] = '0';

	// If base is 10 and value is negative, the resulting string 
	// is preceded with a minus sign (-)
	// With any other base, value is always considered unsigned
	if (value < 0 && base == 10)
		buffer[i++] = '-';

	buffer[i] = '\0'; // null terminate string

	// reverse the string and return it
	return reverse(buffer, 0, i - 1);
}
// <<< [1]

// lame reuse of the above for different data types
// TODO: improve
char* utoa(unsigned int val, char * s, int radix) { return itoa(val, s, radix); }
char* ultoa(unsigned int val, char * s, int radix) { return utoa(val, s, radix); }
char* ltoa(unsigned int val, char * s, int radix) { return ltoa(val, s, radix); }
```

## src/GFX.cpp
```c
#include "GFX.h"
#include "Adafruit-GFX-Library/Adafruit_GFX.h"

GFX::GFX(struct device* display_dev, int16_t w, int16_t h) : Adafruit_GFX(w,h) {
	this->display_dev = display_dev;
        this->pixelBufferDesc.pitch = 1;
        this->pixelBufferDesc.width = 1;
        this->pixelBufferDesc.height = 1;
};

void GFX::drawPixel(int16_t x, int16_t y, uint16_t color)
{
	u8_t b[2];
	b[0] = (color >> 8);
	b[1] = (color >> 0);
	display_write(display_dev, x, y, &this->pixelBufferDesc, &b);
}

void GFX::startWrite() {}

void GFX::writePixel(int16_t x, int16_t y, uint16_t color) {
  drawPixel(x, y, color);
}

void GFX::writeFastVLine(int16_t x, int16_t y, int16_t h,
                                  uint16_t color) {
  writeFillRect(x, y, 1, h, color);
}

void GFX::writeFastHLine(int16_t x, int16_t y, int16_t w,
                                  uint16_t color) {
  writeFillRect(x, y, w, 1, color);
}

void GFX::writeFillRect(int16_t x, int16_t y, int16_t w, int16_t h,
                                 uint16_t color) {
  u8_t b[2 * w * h];
  struct display_buffer_descriptor d;
  d.pitch = w;
  d.width = w;
  d.height = h;
  // TODO: optimize
  for (int i = 0; i < w * h; i++) {
    b[i * 2 + 0] = color >> 8;
    b[i * 2 + 1] = color >> 0;
  }
  display_write(display_dev, x, y, &d, &b);
}

void GFX::endWrite() {}

/**
 * GFX Factory
 */
GFX* createGFX(struct device* display_dev)
{
	struct display_capabilities capabilities;
	display_get_capabilities(display_dev, &capabilities);

	int sw = capabilities.x_resolution; 
	int sh = capabilities.y_resolution; 

	return new GFX(display_dev, sw, sh);
}
```

## src/GFX.h
```c
#include <zephyr.h>
#include <device.h>
#include <display.h>

#define ST77XX_BLACK 0x0000
#define ST77XX_WHITE 0xFFFF
#define ST77XX_RED 0xF800
#define ST77XX_GREEN 0x07E0
#define ST77XX_BLUE 0x001F
#define ST77XX_CYAN 0x07FF
#define ST77XX_MAGENTA 0xF81F
#define ST77XX_YELLOW 0xFFE0
#define ST77XX_ORANGE 0xFC00

#include "Adafruit-GFX-Library/Adafruit_GFX.h"

/**
 * Implementation of Adafruit_GFX graphics library for ST7789V display on Zephyr.
 */
class GFX : public Adafruit_GFX {

public:
  GFX(struct device* display_dev, int16_t w, int16_t h); // Constructor

  // This MUST be defined by the subclass:
  void drawPixel(
      int16_t x, int16_t y,
      uint16_t color); ///< Virtual drawPixel() function to draw to the
                           ///< screen/framebuffer/etc, must be overridden in
                           ///< subclass. @param x X coordinate.  @param y Y
                           ///< coordinate. @param color 16-bit pixel color.
  virtual void startWrite(void);
  virtual void writePixel(int16_t x, int16_t y, uint16_t color);
  virtual void writeFillRect(int16_t x, int16_t y, int16_t w, int16_t h,
                             uint16_t color);
  virtual void writeFastVLine(int16_t x, int16_t y, int16_t h, uint16_t color);
  virtual void writeFastHLine(int16_t x, int16_t y, int16_t w, uint16_t color);
  virtual void endWrite(void);


private:
	struct device *display_dev;
	struct display_buffer_descriptor pixelBufferDesc;
        
};

/**
 * GFX Factory
 */
GFX* createGFX(struct device* display_dev);
```
