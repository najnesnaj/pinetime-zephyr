## Kconfig
```
# Config for counter alarm sample

# Copyright (c) 2019 Nordic Semiconductor ASA
# SPDX-License-Identifier: Apache-2.0

#config COUNTER_RTC0
#	bool
#	default y if SOC_FAMILY_NRF

source "Kconfig.zephyr"
```

## prj.conf
```kconfig
CONFIG_HEAP_MEM_POOL_SIZE=16384
CONFIG_DISPLAY=y
CONFIG_DISPLAY_LOG_LEVEL_ERR=y

CONFIG_LOG=y

CONFIG_GPIO=y

CONFIG_SPI=y
CONFIG_DISPLAY=y
CONFIG_ST7789V=y
CONFIG_LVGL=y
CONFIG_ST7789V_RGB565=y
CONFIG_LVGL_BITS_PER_PIXEL=24
CONFIG_LVGL_HOR_RES=240
CONFIG_LVGL_VER_RES=240
CONFIG_LVGL_DISPLAY_DEV_NAME="DISPLAY"
CONFIG_LVGL_BUILD_IN_FONT_ROBOTO_28=y
CONFIG_LVGL_DEFAULT_FONT_BUILD_IN_ROBOTO_28=y
CONFIG_LVGL_OBJ_LABEL=y


CONFIG_PRINTK=y
CONFIG_COUNTER=y
CONFIG_COUNTER_RTC2=y




#CONFIG_COUNTER_RTC_CUSTOM_TOP_SUPPORT=y

CONFIG_BT=y
CONFIG_BT_PERIPHERAL=y
CONFIG_BT_GATT_DIS=y
CONFIG_BT_ATT_PREPARE_COUNT=5
CONFIG_BT_DEVICE_NAME="cts client test"
CONFIG_BT_DEVICE_APPEARANCE=833
CONFIG_BT_DEVICE_NAME_DYNAMIC=y
CONFIG_BT_DEVICE_NAME_MAX=65
CONFIG_BT_GATT_CLIENT=y
```

## src/main.c
```c
/*
 *
 * SPDX-License-Identifier: Apache-2.0
 *
 *
 *
 * demonstrates setting the time and displays (hopefully) an exact time
 *
 *
 */
#include <device.h>
#include <drivers/display.h>
#include <lvgl.h>
#include <stdio.h>
#include <string.h>
#include <zephyr.h>
#include <drivers/gpio.h>
#include <sys/byteorder.h>
#include <stdlib.h>
#include <sys/printk.h> //tod have to remove this later on, since makes no sense
#include <drivers/counter.h>

#define DELAY 1000000 //should be 1 second
#define ALARM_CHANNEL_ID 0


#define LOG_LEVEL CONFIG_LOG_DEFAULT_LEVEL
#include <logging/log.h>
LOG_MODULE_REGISTER(app);


#define LED_PORT        DT_ALIAS_LED1_GPIOS_CONTROLLER
#define LED             DT_ALIAS_LED1_GPIOS_PIN
#define LV_IMG_DECLARE(var_name) extern const lv_img_dsc_t var_name;


#include <zephyr/types.h>
#include <stddef.h>
#include <string.h>
#include <errno.h>
#include <sys/printk.h>
#include <sys/byteorder.h>
#include <zephyr.h>

#include <settings/settings.h>

#include <bluetooth/bluetooth.h>
#include <bluetooth/hci.h>
#include <bluetooth/conn.h>
#include <bluetooth/uuid.h>
#include <bluetooth/gatt.h>

#include "cts_sync.h"
static const struct bt_data ad[] = {
	BT_DATA_BYTES(BT_DATA_FLAGS, (BT_LE_AD_GENERAL | BT_LE_AD_NO_BREDR)),
	BT_DATA_BYTES(BT_DATA_UUID16_ALL,
			0x0d, 0x18, 0x0f, 0x18, 0x05, 0x18),
	BT_DATA_BYTES(BT_DATA_UUID128_ALL,
			0xf0, 0xde, 0xbc, 0x9a, 0x78, 0x56, 0x34, 0x12,
			0x78, 0x56, 0x34, 0x12, 0x78, 0x56, 0x34, 0x12),
};


static void bt_ready(void)
{
	int err;

	printk("Bluetooth initialized\n");

	if (IS_ENABLED(CONFIG_SETTINGS)) {
		settings_load();
	}
	printk("bt_le_adv_start\n");
	err = bt_le_adv_start(BT_LE_ADV_CONN_NAME, ad, ARRAY_SIZE(ad), NULL, 0);
	if (err) {
		printk("Advertising failed to start (err %d)\n", err);
		return;
	}

	printk("Advertising successfully started\n");
}







struct counter_alarm_cfg alarm_cfg;
cts_datetime_t pinetime_datetime;

void init_clock(cts_datetime_t* datetime)
{
	pinetime_datetime.hours=datetime->hours;
	pinetime_datetime.minutes=datetime->minutes;
	pinetime_datetime.seconds=datetime->seconds;
	pinetime_datetime.day=datetime->day;
	pinetime_datetime.month=datetime->month;
	pinetime_datetime.year=datetime->year;

}




static void test_counter_interrupt_fn(struct device *counter_dev,
		u8_t chan_id, u32_t ticks,
		void *user_data)
{
	int err;
	//todo replace this with proper internal time system, that keeps track of date
	pinetime_datetime.seconds++;
	if (pinetime_datetime.seconds > 59) {
		pinetime_datetime.seconds=0;
		pinetime_datetime.minutes++;
		if (pinetime_datetime.minutes > 59){
			pinetime_datetime.minutes=0;
			pinetime_datetime.hours++;
			if (pinetime_datetime.hours > 23)
			{
				pinetime_datetime.hours=0;
			}
		}

	}



	// after expiring the alarm is set again
	err = counter_set_channel_alarm(counter_dev, ALARM_CHANNEL_ID,
			user_data);

	if (err != 0) {
		printk("Alarm could not be set\n");
	}
}



static void backlight_init(void)
{
	struct device *dev;
	dev = device_get_binding(LED_PORT);
	/* If you have a backlight, set it up and turn it on here */
	gpio_pin_configure(dev, LED, GPIO_DIR_OUT);
	gpio_pin_write(dev, LED, 0);
}



void main(void)
{
	int err;
	struct device *counter_dev;





	counter_dev = device_get_binding(DT_RTC_2_NAME);
	counter_start(counter_dev);
	if (counter_dev == NULL) {
		printk("Counter device not found\n");
		return;
	}
	alarm_cfg.flags = 0;
	alarm_cfg.ticks = counter_us_to_ticks(counter_dev, DELAY);
	alarm_cfg.callback = test_counter_interrupt_fn;
	alarm_cfg.user_data = &alarm_cfg;

	err=counter_set_channel_alarm(counter_dev, ALARM_CHANNEL_ID, &alarm_cfg);
	if (err) {
	}
	err = bt_enable(NULL);

	if (err) {
		printk("Bluetooth init failed (err %d)\n", err);
		return;
	}
	bt_ready();
	cts_sync_init();
	cts_get_datetime(&pinetime_datetime); //this already should get dummy value to show on screen

	cts_datetime_t localtime;
	init_clock(&localtime);
	//todo catch err




	char snum[3];
	u32_t count = 0U;
	char count_str[11] = {0};
	struct device *display_dev;
	lv_obj_t *hello_world_label;
	lv_obj_t *count_label; 
	lv_obj_t *clock_label; 
	display_dev = device_get_binding(CONFIG_LVGL_DISPLAY_DEV_NAME);




	if (display_dev == NULL) {
		LOG_ERR("device not found.  Aborting test.");
		return;
	}
	else
		backlight_init();

	lv_obj_t *scr = lv_scr_act();



	hello_world_label = lv_label_create(lv_scr_act(), NULL);
	lv_label_set_long_mode(hello_world_label, LV_LABEL_LONG_BREAK);     //Break the long lines
	lv_label_set_recolor(hello_world_label, true);                      //Enable re-coloring by commands in the text
	lv_obj_set_width(hello_world_label, 240);
	lv_label_set_text(hello_world_label, "#00ffff Open Source Watch"); //recoloring should be blue ...



	count_label = lv_label_create(lv_scr_act(), NULL);
	clock_label = lv_label_create(lv_scr_act(), NULL);
	lv_obj_align(count_label, NULL, LV_ALIGN_IN_BOTTOM_MID, 0, 0);
	lv_obj_align(clock_label, NULL, LV_ALIGN_CENTER, 0, 0);

	display_blanking_off(display_dev);

	while (1) {

		sprintf(snum, "%2d:%2d:%2d", pinetime_datetime.hours, pinetime_datetime.minutes,pinetime_datetime.seconds); 
		lv_label_set_text(clock_label, "#00ffff"); 
		lv_label_set_text(clock_label, snum); 

		if ((count % 100) == 0U) {
			sprintf(count_str, "%d", count/100U);
			lv_label_set_text(count_label, count_str);
		}
		lv_task_handler();
		k_sleep(K_MSEC(10));
		++count;
		cts_sync_loop();  //todo this should be activated by button or something - not looped
		cts_get_datetime(&pinetime_datetime);
	}
}
```

## src/cts_sync.c
```c
#include <sys/printk.h>
#include <bluetooth/bluetooth.h>
#include <bluetooth/hci.h>
#include <bluetooth/conn.h>
#include <bluetooth/uuid.h>
#include <bluetooth/gatt.h>
#include "cts_sync.h"

#define TIME_SYNC_WAIT 60 // TODO: tune
int time_sync_timeout = TIME_SYNC_WAIT;
#define MY_REGISTER1 (*(volatile uint8_t*)0x2000F000)
static struct bt_gatt_discover_params cts_discovery_params;
static struct bt_uuid_16 uuid = BT_UUID_INIT_16(0);
static struct bt_gatt_read_params read_params;

cts_datetime_t clock_datetime;

int found_time=0; //todo global variables is bad practice ...

static void sync_cts_to_clock(cts_datetime_t* cts_datetime)
{
	printk("CTS sync to clock started.\n Y%04d D%03d T%2d:%2d:%2d",
			cts_datetime->year, cts_datetime->day,
			cts_datetime->hours, cts_datetime->minutes, cts_datetime->seconds);

	memset(&clock_datetime, 0, sizeof(cts_datetime_t));
	clock_datetime.year = cts_datetime->year;
	clock_datetime.month = cts_datetime->month;
	clock_datetime.day = cts_datetime->day;
	clock_datetime.hours = cts_datetime->hours;
	clock_datetime.minutes = cts_datetime->minutes;
	clock_datetime.seconds = cts_datetime->seconds;

	//clock_set_datetime(&clock_datetime);

	printk("CTS sync to clock complete.");
	time_sync_timeout = TIME_SYNC_WAIT;
        found_time=1;
}


void cts_get_datetime(cts_datetime_t*  cts_time)
{

	if (found_time>0){
		cts_time->hours=clock_datetime.hours;
		cts_time->minutes=clock_datetime.minutes;
		cts_time->seconds=clock_datetime.seconds;
		found_time=0;
	}
      
}


static void sync_local_cts_to_clock()
{
	clock_datetime.hours=12;
	clock_datetime.minutes=13;
	clock_datetime.seconds=14;

	//    cts_datetime_t cts_datetime;
	//   cts_get_datetime(&cts_datetime);
	//  sync_cts_to_clock(&cts_datetime);
}

//static void cts_write_cb(int val)
//{
//    sync_local_cts_to_clock();
//}

int offset = 0;
cts_datetime_t datetime_buf;
u8_t cts_sync_read(struct bt_conn *conn, u8_t err,
		struct bt_gatt_read_params *params,
		const void *data, u16_t length)
{
	printk("Reading CCC data: err %d, %d bytes, offset %d.", err, length, offset);

	if (!data || length <= 0) {
		sync_cts_to_clock(&datetime_buf);
		return BT_GATT_ITER_STOP;
	}

	memcpy(&datetime_buf + offset, data, length);
	offset += length;

	return BT_GATT_ITER_CONTINUE;
}

u8_t cts_sync_service_discovered(struct bt_conn* conn, const struct bt_gatt_attr* attr,
		struct bt_gatt_discover_params* params)
{
	if (!attr) {
		printk("CTS Service Discovery completed");
		return BT_GATT_ITER_STOP;
	}
	printk("Discovered attribute, handle: %u\n", attr->handle);

	memset(&read_params, 0, sizeof(read_params));
	read_params.func = cts_sync_read;
	read_params.by_uuid.uuid = &uuid;
	read_params.by_uuid.start_handle = attr->handle;
	read_params.by_uuid.end_handle = 0xffff;
	offset = 0;
	if (bt_gatt_read(conn, &read_params) < 0) {
		printk("Could not initiate read of CCC data.");
	}

	return BT_GATT_ITER_STOP;
}

//#define BT_UUID_CTS                       BT_UUID_DECLARE_16(0x1805)
//#define BT_UUID_CTS_CURRENT_TIME          BT_UUID_DECLARE_16(0x2a2b)


static void cts_sync_processor(struct bt_conn *conn, void *data)
{
	memcpy(&uuid, BT_UUID_CTS_CURRENT_TIME, sizeof(uuid));
	cts_discovery_params.func = cts_sync_service_discovered;
	cts_discovery_params.start_handle = 0x0001;
	cts_discovery_params.end_handle = 0xFFFF;
	cts_discovery_params.type = BT_GATT_DISCOVER_CHARACTERISTIC;
	cts_discovery_params.uuid = &uuid;

	if (bt_gatt_discover(conn, &cts_discovery_params) != 0) {
		printk("CTS Sync > GATT discovery FAILED.\n");
	}
}

static void connected(struct bt_conn *conn, u8_t err)
{
	if (err) {
		return;
	}
	cts_sync_processor(conn, NULL);
}

static void disconnected(struct bt_conn *conn, u8_t reason)
{
}

static struct bt_conn_cb conn_callbacks = {
	.connected = connected,
	.disconnected = disconnected,
};

void cts_sync_init()
{
	bt_conn_cb_register(&conn_callbacks);
	//   cts_register_write_cb(cts_write_cb);
	sync_local_cts_to_clock();
}

void cts_sync_loop()
{
	if (time_sync_timeout > 0) {
		time_sync_timeout--;
	} else {
		bt_conn_foreach(BT_CONN_TYPE_ALL, cts_sync_processor, NULL);
		time_sync_timeout = TIME_SYNC_WAIT;
	}
}
```

## src/cts_sync.h
```c
/** @file
 *  @brief CTS Service sample
 */

/*
 * Copyright (c) 2016 Intel Corporation
 *
 * SPDX-License-Identifier: Apache-2.0
 */

#ifdef __cplusplus
extern "C" {
#endif
void cts_sync_init();
void cts_sync_loop();




	typedef struct {
		uint16_t year;
		uint8_t month;
		uint8_t day;
		uint8_t hours;
		uint8_t minutes;
		uint8_t seconds;
		uint8_t day_of_week;
		uint8_t exact_time_256;
		uint8_t adjust_reason;
	} cts_datetime_t;

void cts_get_datetime(cts_datetime_t*);




#ifdef __cplusplus
}
#endif
```
