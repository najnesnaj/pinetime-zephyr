## prj.conf
```kconfig
CONFIG_HEAP_MEM_POOL_SIZE=16384

CONFIG_DISPLAY=y
CONFIG_DISPLAY_LOG_LEVEL_ERR=y

CONFIG_LOG=y

CONFIG_LVGL_OBJ_LABEL=y
CONFIG_ST7789V=y
CONFIG_GPIO=y
CONFIG_LVGL=y
CONFIG_LVGL_OBJ_IMAGE=y
CONFIG_PRINTK=y



CONFIG_BT=y
CONFIG_BT_PERIPHERAL=y
CONFIG_BT_GATT_DIS=y
CONFIG_BT_ATT_PREPARE_COUNT=5
CONFIG_BT_DEVICE_NAME="cts client test"
CONFIG_BT_DEVICE_APPEARANCE=833
CONFIG_BT_DEVICE_NAME_DYNAMIC=y
CONFIG_BT_DEVICE_NAME_MAX=65
CONFIG_BT_GATT_CLIENT=y
```

## boards/pinetime.conf
```kconfig
CONFIG_SPI=y
CONFIG_DISPLAY=y
CONFIG_ST7789V=y
CONFIG_LVGL=y
CONFIG_ST7789V_RGB565=y
CONFIG_LVGL_BITS_PER_PIXEL=24
CONFIG_LVGL_HOR_RES=240
CONFIG_LVGL_VER_RES=240
CONFIG_LVGL_DISPLAY_DEV_NAME="DISPLAY"
# Fonts
#
# CONFIG_LVGL_BUILD_IN_FONT_ROBOTO_12 is not set
# CONFIG_LVGL_BUILD_IN_FONT_ROBOTO_16 is not set
# CONFIG_LVGL_BUILD_IN_FONT_ROBOTO_22 is not set
CONFIG_LVGL_BUILD_IN_FONT_ROBOTO_28=y
# CONFIG_LVGL_BUILD_IN_FONT_UNSCII_8 is not set
CONFIG_LVGL_DEFAULT_FONT_BUILD_IN_ROBOTO_28=y
# CONFIG_LVGL_DEFAULT_FONT_CUSTOM is not set
# end of Fonts
#
# Themes
#
#CONFIG_LVGL_THEMES=y
# CONFIG_LVGL_THEME_LIVE_UPDATE is not set
# CONFIG_LVGL_THEME_DEFAULT is not set
#CONFIG_LVGL_THEME_ALIEN=y
# CONFIG_LVGL_THEME_NIGHT is not set
# CONFIG_LVGL_THEME_MONO is not set
# CONFIG_LVGL_THEME_MATERIAL is not set
# CONFIG_LVGL_THEME_ZEN is not set
# CONFIG_LVGL_THEME_NEMO is not set
# end of Themes
```

## src/main.c
```c
/*
 *
 * SPDX-License-Identifier: Apache-2.0
 *
 *
 *
 * demonstrates setting the time and displays (hopefully) an exact time
 *
 *
 */
#define MY_REGISTER1 (*(volatile uint8_t*)0x2000F000)
#include <device.h>
#include <drivers/display.h>
#include <lvgl.h>
#include <stdio.h>
#include <string.h>
#include <zephyr.h>
#include <drivers/gpio.h>
#include <sys/byteorder.h>
#include <stdlib.h>
#include <sys/printk.h> //tod have to remove this later on, since makes no sense
#include <drivers/counter.h>

#define DELAY 1000000 //should be 1 second
#define ALARM_CHANNEL_ID 0



#define LOG_LEVEL CONFIG_LOG_DEFAULT_LEVEL
#include <logging/log.h>
LOG_MODULE_REGISTER(app);


#define LED_PORT        DT_ALIAS_LED1_GPIOS_CONTROLLER
#define LED             DT_ALIAS_LED1_GPIOS_PIN
#define LV_IMG_DECLARE(var_name) extern const lv_img_dsc_t var_name;
LV_IMG_DECLARE(klokje);


#include <zephyr/types.h>
#include <stddef.h>
#include <string.h>
#include <errno.h>
#include <sys/printk.h>
#include <sys/byteorder.h>
#include <zephyr.h>

#include <settings/settings.h>

#include <bluetooth/bluetooth.h>
#include <bluetooth/hci.h>
#include <bluetooth/conn.h>
#include <bluetooth/uuid.h>
#include <bluetooth/gatt.h>

#include "cts_sync.h"
static const struct bt_data ad[] = {
	BT_DATA_BYTES(BT_DATA_FLAGS, (BT_LE_AD_GENERAL | BT_LE_AD_NO_BREDR)),
	BT_DATA_BYTES(BT_DATA_UUID16_ALL,
			0x0d, 0x18, 0x0f, 0x18, 0x05, 0x18),
	BT_DATA_BYTES(BT_DATA_UUID128_ALL,
			0xf0, 0xde, 0xbc, 0x9a, 0x78, 0x56, 0x34, 0x12,
			0x78, 0x56, 0x34, 0x12, 0x78, 0x56, 0x34, 0x12),
};

	
static void bt_ready(void)
{
	int err;

	printk("Bluetooth initialized\n");

	MY_REGISTER1=0xb1;
	if (IS_ENABLED(CONFIG_SETTINGS)) {
		settings_load();
		MY_REGISTER1=0xb2;
	}
	printk("bt_le_adv_start\n");
	err = bt_le_adv_start(BT_LE_ADV_CONN_NAME, ad, ARRAY_SIZE(ad), NULL, 0);
	if (err) {
		MY_REGISTER1=0xb3;
		printk("Advertising failed to start (err %d)\n", err);
		return;
	}
	MY_REGISTER1=0xb4;

	printk("Advertising successfully started\n");
}







struct counter_alarm_cfg alarm_cfg;
//struct time* clock_get_datetime();
/*typedef struct {
  uint16_t year;
  uint8_t month;
  uint8_t day;
  uint8_t hours;
  uint8_t minutes;
  uint8_t seconds;
  uint8_t day_of_week;
  uint8_t exact_time_256;
  uint8_t adjust_reason;
  } cts_datetime_t;
  */
cts_datetime_t pinetime_datetime;

void init_clock(cts_datetime_t* datetime)
{
	pinetime_datetime.hours=datetime->hours;
	pinetime_datetime.minutes=datetime->minutes;
	pinetime_datetime.seconds=datetime->seconds;
	pinetime_datetime.day=datetime->day;
	pinetime_datetime.month=datetime->month;
	pinetime_datetime.year=datetime->year;

	//	LOG_INF("Local clock set to: %02d:%02d:%02d, %04d-%02d-%02d\n",
	//			datetime->hours, datetime->minutes, datetime->seconds,
	//			datetime->year, datetime->month, datetime->day);
}


/*

   static void test_counter_interrupt_fn(struct device *counter_dev,
   u8_t chan_id, u32_t ticks,
   void *user_data)
   {
   int err;
//todo replace this with proper internal time system, that keeps track of date
pinetime_datetime.seconds++;
if (pinetime_datetime.seconds > 59) {
pinetime_datetime.seconds=0;
pinetime_datetime.minutes++;
if (pinetime_datetime.minutes > 59){
pinetime_datetime.minutes=0;
pinetime_datetime.hours++;
if (pinetime_datetime.hours > 23)
{
pinetime_datetime.hours=0;
}
}

}



// after expiring the alarm is set again
err = counter_set_channel_alarm(counter_dev, ALARM_CHANNEL_ID,
user_data);

if (err != 0) {
printk("Alarm could not be set\n");
}
}





*/





static void backlight_init(void)
{
	struct device *dev;
	dev = device_get_binding(LED_PORT);
	/* If you have a backlight, set it up and turn it on here */
	gpio_pin_configure(dev, LED, GPIO_DIR_OUT);
	gpio_pin_write(dev, LED, 0);
}



void main(void)
{
	int err;
	struct device *counter_dev;

	err = bt_enable(NULL);
	if (err) {
		printk("Bluetooth init failed (err %d)\n", err);
		MY_REGISTER1=0xb9;
		return;
	}

	bt_ready();
	cts_sync_init();
	cts_get_datetime(&pinetime_datetime); //this already should get dummy value to show on screen

	//	MY_REGISTER1=0x01;

	/*

	   counter_dev = device_get_binding(DT_RTC_0_NAME);
	   counter_start(counter_dev);
	   if (counter_dev == NULL) {
	   printk("Counter device not found\n");
	   return;
	   }
	   alarm_cfg.flags = 0;
	   alarm_cfg.ticks = counter_us_to_ticks(counter_dev, DELAY);
	   alarm_cfg.callback = test_counter_interrupt_fn;
	   alarm_cfg.user_data = &alarm_cfg;

	   err=counter_set_channel_alarm(counter_dev, ALARM_CHANNEL_ID, &alarm_cfg);
	   */

	cts_datetime_t localtime;
	init_clock(&localtime);
	//todo catch err
	//	MY_REGISTER1=0x02;




	char snum[3];
	u32_t count = 0U;
	char count_str[11] = {0};
	struct device *display_dev;
	lv_obj_t *hello_world_label;
	lv_obj_t *count_label; 
	lv_obj_t *clock_label; 
	display_dev = device_get_binding(CONFIG_LVGL_DISPLAY_DEV_NAME);


	//	MY_REGISTER1=0x03;


	if (display_dev == NULL) {
		LOG_ERR("device not found.  Aborting test.");
		return;
		MY_REGISTER1=0xe1;
	}
	else
		backlight_init();

	lv_obj_t *scr = lv_scr_act();
	//lv_obj_t * img_bin = lv_img_create(lv_scr_act(), NULL);
	//
	//                /*clock background*/
	//lv_img_set_src(img_bin, &klokje);
	//
	//

	//	MY_REGISTER1=0x04;


	hello_world_label = lv_label_create(lv_scr_act(), NULL);
	lv_label_set_long_mode(hello_world_label, LV_LABEL_LONG_BREAK);     //Break the long lines
	lv_label_set_recolor(hello_world_label, true);                      //Enable re-coloring by commands in the text
	lv_obj_set_width(hello_world_label, 240);
	lv_label_set_text(hello_world_label, "#00ffff Open Source Watch"); //recoloring should be blue ...



	count_label = lv_label_create(lv_scr_act(), NULL);
	clock_label = lv_label_create(lv_scr_act(), NULL);
	lv_obj_align(count_label, NULL, LV_ALIGN_IN_BOTTOM_MID, 0, 0);
	lv_obj_align(clock_label, NULL, LV_ALIGN_CENTER, 0, 0);

	display_blanking_off(display_dev);

	while (1) {

		sprintf(snum, "%2d:%2d:%2d", pinetime_datetime.hours, pinetime_datetime.minutes,pinetime_datetime.seconds); 
		lv_label_set_text(clock_label, "#00ffff"); 
		lv_label_set_text(clock_label, snum); 

		if ((count % 100) == 0U) {
			sprintf(count_str, "%d", count/100U);
			lv_label_set_text(count_label, count_str);
		}
		lv_task_handler();
		k_sleep(K_MSEC(10));
		++count;
		cts_sync_loop();  //todo this should be activated by button or something - not looped
		//		MY_REGISTER1=0x05;
		cts_get_datetime(&pinetime_datetime);
		//MY_REGISTER1=0x06;
	}
}
```

## src/bt.c
```c
/*
 * Copyright (c) 2015-2016 Intel Corporation
 *
 * SPDX-License-Identifier: Apache-2.0
 */

#include <zephyr/types.h>
#include <stddef.h>
#include <string.h>
#include <errno.h>
#include <sys/printk.h>
#include <sys/byteorder.h>
#include <zephyr.h>

#include <settings/settings.h>

#include <bluetooth/bluetooth.h>
#include <bluetooth/hci.h>
#include <bluetooth/conn.h>
#include <bluetooth/uuid.h>
#include <bluetooth/gatt.h>
#include <bluetooth/services/bas.h>
#include <bluetooth/services/hrs.h>

#include "log.h"
#include "bt.h"
#include "cts.h"

static uint8_t bt_connection_status = BT_STATUS_DISCONNECTED;

/* Custom Service Variables */
static struct bt_uuid_128 vnd_uuid = BT_UUID_INIT_128(
	0xf6, 0xde, 0xbc, 0x9a, 0x78, 0x56, 0x34, 0x12,
	0x78, 0x56, 0x34, 0x12, 0x78, 0x56, 0x34, 0x12);

static struct bt_uuid_128 vnd_enc_uuid = BT_UUID_INIT_128(
	0xf7, 0xde, 0xbc, 0x9a, 0x78, 0x56, 0x34, 0x12,
	0x78, 0x56, 0x34, 0x12, 0x78, 0x56, 0x34, 0x12);

static struct bt_uuid_128 vnd_auth_uuid = BT_UUID_INIT_128(
	0xf8, 0xde, 0xbc, 0x9a, 0x78, 0x56, 0x34, 0x12,
	0x78, 0x56, 0x34, 0x12, 0x78, 0x56, 0x34, 0x12);

static u8_t vnd_value[] = { 'V', 'e', 'n', 'd', 'o', 'r' };

static ssize_t read_vnd(struct bt_conn *conn, const struct bt_gatt_attr *attr,
			void *buf, u16_t len, u16_t offset)
{
	char *value = attr->user_data;

	return bt_gatt_attr_read(conn, attr, buf, len, offset, value,
				 strlen(value));
}

static ssize_t write_vnd(struct bt_conn *conn, const struct bt_gatt_attr *attr,
			 const void *buf, u16_t len, u16_t offset,
			 u8_t flags)
{
	u8_t *value = attr->user_data;

	if (offset + len > sizeof(vnd_value)) {
		return BT_GATT_ERR(BT_ATT_ERR_INVALID_OFFSET);
	}

	memcpy(value + offset, buf, len);

	return len;
}

static u8_t simulate_vnd;
static u8_t indicating;
static struct bt_gatt_indicate_params ind_params;

static void vnd_ccc_cfg_changed(const struct bt_gatt_attr *attr, u16_t value)
{
	simulate_vnd = (value == BT_GATT_CCC_INDICATE) ? 1 : 0;
}

static void indicate_cb(struct bt_conn *conn, const struct bt_gatt_attr *attr,
			u8_t err)
{
	printk("Indication %s\n", err != 0U ? "fail" : "success");
	indicating = 0U;
}

#define MAX_DATA 74
static u8_t vnd_long_value[] = {
		  'V', 'e', 'n', 'd', 'o', 'r', ' ', 'd', 'a', 't', 'a', '1',
		  'V', 'e', 'n', 'd', 'o', 'r', ' ', 'd', 'a', 't', 'a', '2',
		  'V', 'e', 'n', 'd', 'o', 'r', ' ', 'd', 'a', 't', 'a', '3',
		  'V', 'e', 'n', 'd', 'o', 'r', ' ', 'd', 'a', 't', 'a', '4',
		  'V', 'e', 'n', 'd', 'o', 'r', ' ', 'd', 'a', 't', 'a', '5',
		  'V', 'e', 'n', 'd', 'o', 'r', ' ', 'd', 'a', 't', 'a', '6',
		  '.', ' ' };

static ssize_t read_long_vnd(struct bt_conn *conn,
			     const struct bt_gatt_attr *attr, void *buf,
			     u16_t len, u16_t offset)
{
	const char *value = attr->user_data;

	return bt_gatt_attr_read(conn, attr, buf, len, offset, value,
				 sizeof(vnd_long_value));
}

static ssize_t write_long_vnd(struct bt_conn *conn,
			      const struct bt_gatt_attr *attr, const void *buf,
			      u16_t len, u16_t offset, u8_t flags)
{
	u8_t *value = attr->user_data;

	if (flags & BT_GATT_WRITE_FLAG_PREPARE) {
		return 0;
	}

	if (offset + len > sizeof(vnd_long_value)) {
		return BT_GATT_ERR(BT_ATT_ERR_INVALID_OFFSET);
	}

	memcpy(value + offset, buf, len);

	return len;
}

static const struct bt_uuid_128 vnd_long_uuid = BT_UUID_INIT_128(
	0xf3, 0xde, 0xbc, 0x9a, 0x78, 0x56, 0x34, 0x12,
	0x78, 0x56, 0x34, 0x12, 0x78, 0x56, 0x34, 0x12);

static struct bt_gatt_cep vnd_long_cep = {
	.properties = BT_GATT_CEP_RELIABLE_WRITE,
};

static int signed_value;

static ssize_t read_signed(struct bt_conn *conn, const struct bt_gatt_attr *attr,
			   void *buf, u16_t len, u16_t offset)
{
	const char *value = attr->user_data;

	return bt_gatt_attr_read(conn, attr, buf, len, offset, value,
				 sizeof(signed_value));
}

static ssize_t write_signed(struct bt_conn *conn, const struct bt_gatt_attr *attr,
			    const void *buf, u16_t len, u16_t offset,
			    u8_t flags)
{
	u8_t *value = attr->user_data;

	if (offset + len > sizeof(signed_value)) {
		return BT_GATT_ERR(BT_ATT_ERR_INVALID_OFFSET);
	}

	memcpy(value + offset, buf, len);

	return len;
}

static const struct bt_uuid_128 vnd_signed_uuid = BT_UUID_INIT_128(
	0xf3, 0xde, 0xbc, 0x9a, 0x78, 0x56, 0x34, 0x13,
	0x78, 0x56, 0x34, 0x12, 0x78, 0x56, 0x34, 0x13);

static const struct bt_uuid_128 vnd_write_cmd_uuid = BT_UUID_INIT_128(
	0xf4, 0xde, 0xbc, 0x9a, 0x78, 0x56, 0x34, 0x12,
	0x78, 0x56, 0x34, 0x12, 0x78, 0x56, 0x34, 0x12);

static ssize_t write_without_rsp_vnd(struct bt_conn *conn,
				     const struct bt_gatt_attr *attr,
				     const void *buf, u16_t len, u16_t offset,
				     u8_t flags)
{
	u8_t *value = attr->user_data;

	/* Write request received. Reject it since this char only accepts
	 * Write Commands.
	 */
	if (!(flags & BT_GATT_WRITE_FLAG_CMD)) {
		return BT_GATT_ERR(BT_ATT_ERR_WRITE_REQ_REJECTED);
	}

	if (offset + len > sizeof(vnd_value)) {
		return BT_GATT_ERR(BT_ATT_ERR_INVALID_OFFSET);
	}

	memcpy(value + offset, buf, len);

	return len;
}

/* Vendor Primary Service Declaration */
BT_GATT_SERVICE_DEFINE(vnd_svc,
	BT_GATT_PRIMARY_SERVICE(&vnd_uuid),
	BT_GATT_CHARACTERISTIC(&vnd_enc_uuid.uuid,
			       BT_GATT_CHRC_READ | BT_GATT_CHRC_WRITE |
			       BT_GATT_CHRC_INDICATE,
			       BT_GATT_PERM_READ_ENCRYPT |
			       BT_GATT_PERM_WRITE_ENCRYPT,
			       read_vnd, write_vnd, vnd_value),
	BT_GATT_CCC(vnd_ccc_cfg_changed,
		    BT_GATT_PERM_READ | BT_GATT_PERM_WRITE_ENCRYPT),
	BT_GATT_CHARACTERISTIC(&vnd_auth_uuid.uuid,
			       BT_GATT_CHRC_READ | BT_GATT_CHRC_WRITE,
			       BT_GATT_PERM_READ_AUTHEN |
			       BT_GATT_PERM_WRITE_AUTHEN,
			       read_vnd, write_vnd, vnd_value),
	BT_GATT_CHARACTERISTIC(&vnd_long_uuid.uuid, BT_GATT_CHRC_READ |
			       BT_GATT_CHRC_WRITE | BT_GATT_CHRC_EXT_PROP,
			       BT_GATT_PERM_READ | BT_GATT_PERM_WRITE |
			       BT_GATT_PERM_PREPARE_WRITE,
			       read_long_vnd, write_long_vnd, &vnd_long_value),
	BT_GATT_CEP(&vnd_long_cep),
	BT_GATT_CHARACTERISTIC(&vnd_signed_uuid.uuid, BT_GATT_CHRC_READ |
			       BT_GATT_CHRC_WRITE | BT_GATT_CHRC_AUTH,
			       BT_GATT_PERM_READ | BT_GATT_PERM_WRITE,
			       read_signed, write_signed, &signed_value),
	BT_GATT_CHARACTERISTIC(&vnd_write_cmd_uuid.uuid,
			       BT_GATT_CHRC_WRITE_WITHOUT_RESP,
			       BT_GATT_PERM_WRITE, NULL,
			       write_without_rsp_vnd, &vnd_value),
);

static const struct bt_data ad[] = {
	BT_DATA_BYTES(BT_DATA_FLAGS, (BT_LE_AD_GENERAL | BT_LE_AD_NO_BREDR)),
	BT_DATA_BYTES(BT_DATA_UUID16_ALL,
		      0x0d, 0x18, 0x0f, 0x18, 0x05, 0x18),
	BT_DATA_BYTES(BT_DATA_UUID128_ALL,
		      0xf0, 0xde, 0xbc, 0x9a, 0x78, 0x56, 0x34, 0x12,
		      0x78, 0x56, 0x34, 0x12, 0x78, 0x56, 0x34, 0x12),
};

static void connected(struct bt_conn *conn, u8_t err)
{
	if (err) {
		LOG_WRN("BT Connection failed (err 0x%02x).", err);
	} else {
		LOG_INF("BT Connected.");
		bt_connection_status = BT_STATUS_CONNECTED;
	}
}

static void disconnected(struct bt_conn *conn, u8_t reason)
{
	LOG_INF("BT Disconnected (reason 0x%02x).", reason);
	bt_connection_status = BT_STATUS_DISCONNECTED;
}

static struct bt_conn_cb conn_callbacks = {
	.connected = connected,
	.disconnected = disconnected,
};

static void bt_ready(void)
{
	int err;

	cts_init();

	err = bt_le_adv_start(BT_LE_ADV_CONN_NAME, ad, ARRAY_SIZE(ad), NULL, 0);
	if (err) {
		printk("Bluetooth advertising failed to start (err %d)\n", err);
		return;
	}

	printk("Bluetooth advertising successfully started\n");
}

static void auth_passkey_display(struct bt_conn *conn, unsigned int passkey)
{
	char addr[BT_ADDR_LE_STR_LEN];

	bt_addr_le_to_str(bt_conn_get_dst(conn), addr, sizeof(addr));

	printk("Passkey for %s: %06u\n", addr, passkey);
}

static void auth_cancel(struct bt_conn *conn)
{
	char addr[BT_ADDR_LE_STR_LEN];

	bt_addr_le_to_str(bt_conn_get_dst(conn), addr, sizeof(addr));

	printk("Pairing cancelled: %s\n", addr);
}

static struct bt_conn_auth_cb auth_cb_display = {
	.passkey_display = auth_passkey_display,
	.passkey_entry = NULL,
	.cancel = auth_cancel,
};

static void bas_notify(void)
{
	u8_t battery_level = bt_gatt_bas_get_battery_level();

	battery_level--;

	if (!battery_level) {
		battery_level = 100U;
	}

	bt_gatt_bas_set_battery_level(battery_level);
}

static void hrs_notify(void)
{
	static u8_t heartrate = 90U;

	/* Heartrate measurements simulation */
	heartrate++;
	if (heartrate == 160U) {
		heartrate = 90U;
	}

	bt_gatt_hrs_notify(heartrate);
}

void bt_setup(void)
{
	int err;

	err = bt_enable(NULL);
	if (err) {
		printk("Bluetooth init failed (err %d)\n", err);
		return;
	}

	bt_ready();

	bt_conn_cb_register(&conn_callbacks);
	bt_conn_auth_cb_register(&auth_cb_display);

	printk("Bluetooth inited.");
}

void bt_loop()
{
	/* Implement notification. At the moment there is no suitable way
	 * of starting delayed work so we do it here
	 */

	/* Current Time Service updates only when time is changed */
	cts_notify();

	/* Heartrate measurements simulation */
	hrs_notify();

	/* Battery level simulation */
	bas_notify();

	/* Vendor indication simulation */
	if (simulate_vnd) {
		if (indicating) {
			return;
		}

		ind_params.attr = &vnd_svc.attrs[2];
		ind_params.func = indicate_cb;
		ind_params.data = &indicating;
		ind_params.len = sizeof(indicating);

		if (bt_gatt_indicate(NULL, &ind_params) == 0) {
			indicating = 1U;
		}
	}
}

uint8_t bt_get_connection_status()
{
	return bt_connection_status;
}
```

## src/bt.h
```c
/*
 * Copyright (c) 2015-2016 Intel Corporation
 *
 * SPDX-License-Identifier: Apache-2.0
 */

#include <zephyr/types.h>
#include <stddef.h>
#include <string.h>
#include <errno.h>
#include <sys/printk.h>
#include <sys/byteorder.h>
#include <zephyr.h>

#include <settings/settings.h>

#include <bluetooth/bluetooth.h>
#include <bluetooth/hci.h>
#include <bluetooth/conn.h>
#include <bluetooth/uuid.h>
#include <bluetooth/gatt.h>
#include <bluetooth/services/bas.h>
#include <bluetooth/services/hrs.h>

#include "cts.h"

void bt_setup(void);
void bt_loop();

#define BT_STATUS_DISCONNECTED  0
#define BT_STATUS_CONNECTING    1
#define BT_STATUS_CONNECTED     2
uint8_t bt_get_connection_status();
```

## src/cts.h
```c
/** @file
 *  @brief CTS Service
 */

/*
 * Copyright (c) 2016 Intel Corporation
 *
 * SPDX-License-Identifier: Apache-2.0
 */

#ifndef CTS_H
#define CTS_H
#include <stddef.h>
#include <inttypes.h>

#ifdef __cplusplus
extern "C" {
#endif

void cts_init(void);
void cts_notify(void);

typedef void (*cts_write_cb_t)(int);
void cts_register_write_cb(cts_write_cb_t);

typedef struct {
	uint16_t year;
	uint8_t month;
	uint8_t day;
	uint8_t hours;
	uint8_t minutes;
	uint8_t seconds;
	uint8_t day_of_week;
	uint8_t exact_time_256;
	uint8_t adjust_reason;
} cts_datetime_t;

void cts_get_datetime(cts_datetime_t*);

#ifdef __cplusplus
}
#endif
#endif
```

## src/cts_sync.c
```c
#include <sys/printk.h>
#include <bluetooth/bluetooth.h>
#include <bluetooth/hci.h>
#include <bluetooth/conn.h>
#include <bluetooth/uuid.h>
#include <bluetooth/gatt.h>
#include "cts_sync.h"

#define TIME_SYNC_WAIT 60 // TODO: tune
int time_sync_timeout = TIME_SYNC_WAIT;
static struct bt_gatt_discover_params cts_discovery_params;
static struct bt_uuid_16 uuid = BT_UUID_INIT_16(0);
static struct bt_gatt_read_params read_params;

cts_datetime_t clock_datetime;

static void sync_cts_to_clock(cts_datetime_t* cts_datetime)
{
    printk("CTS sync to clock started.\n Y%04d D%03d T%2d:%2d:%2d",
        cts_datetime->year, cts_datetime->day,
        cts_datetime->hours, cts_datetime->minutes, cts_datetime->seconds);

    memset(&clock_datetime, 0, sizeof(cts_datetime_t));
    clock_datetime.year = cts_datetime->year;
    clock_datetime.month = cts_datetime->month;
    clock_datetime.day = cts_datetime->day;
    clock_datetime.hours = cts_datetime->hours;
    clock_datetime.minutes = cts_datetime->minutes;
    clock_datetime.seconds = cts_datetime->seconds;

    //clock_set_datetime(&clock_datetime);

    printk("CTS sync to clock complete.");

    time_sync_timeout = TIME_SYNC_WAIT;
}


void cts_get_datetime(cts_datetime_t*  cts_time)
{

	cts_time->hours=clock_datetime.hours;
	cts_time->minutes=clock_datetime.minutes;
	cts_time->seconds=clock_datetime.seconds;


}


static void sync_local_cts_to_clock()
{
	clock_datetime.hours=12;
	clock_datetime.minutes=13;
	clock_datetime.seconds=14;

//    cts_datetime_t cts_datetime;
//   cts_get_datetime(&cts_datetime);
//  sync_cts_to_clock(&cts_datetime);
}

//static void cts_write_cb(int val)
//{
//    sync_local_cts_to_clock();
//}

int offset = 0;
cts_datetime_t datetime_buf;
u8_t cts_sync_read(struct bt_conn *conn, u8_t err,
				    struct bt_gatt_read_params *params,
				    const void *data, u16_t length)
{
    printk("Reading CCC data: err %d, %d bytes, offset %d.", err, length, offset);

    if (!data || length <= 0) {
        sync_cts_to_clock(&datetime_buf);
        return BT_GATT_ITER_STOP;
    }

    memcpy(&datetime_buf + offset, data, length);
    offset += length;

    return BT_GATT_ITER_CONTINUE;
}

u8_t cts_sync_service_discovered(struct bt_conn* conn, const struct bt_gatt_attr* attr,
        struct bt_gatt_discover_params* params)
{
    if (!attr) {
        printk("CTS Service Discovery completed");
        return BT_GATT_ITER_STOP;
    }
    printk("Discovered attribute, handle: %u\n", attr->handle);

    memset(&read_params, 0, sizeof(read_params));
    read_params.func = cts_sync_read;
    read_params.by_uuid.uuid = &uuid;
    read_params.by_uuid.start_handle = attr->handle;
    read_params.by_uuid.end_handle = 0xffff;
    offset = 0;
    if (bt_gatt_read(conn, &read_params) < 0) {
        printk("Could not initiate read of CCC data.");
    }

    return BT_GATT_ITER_STOP;
}

 //#define BT_UUID_CTS                       BT_UUID_DECLARE_16(0x1805)
 //#define BT_UUID_CTS_CURRENT_TIME          BT_UUID_DECLARE_16(0x2a2b)


static void cts_sync_processor(struct bt_conn *conn, void *data)
{
    memcpy(&uuid, BT_UUID_CTS_CURRENT_TIME, sizeof(uuid));
    cts_discovery_params.func = cts_sync_service_discovered;
    cts_discovery_params.start_handle = 0x0001;
    cts_discovery_params.end_handle = 0xFFFF;
    cts_discovery_params.type = BT_GATT_DISCOVER_CHARACTERISTIC;
    cts_discovery_params.uuid = &uuid;

    if (bt_gatt_discover(conn, &cts_discovery_params) != 0) {
        printk("CTS Sync > GATT discovery FAILED.\n");
    }
}

static void connected(struct bt_conn *conn, u8_t err)
{
	if (err) {
		return;
	}
    cts_sync_processor(conn, NULL);
}

static void disconnected(struct bt_conn *conn, u8_t reason)
{
}

static struct bt_conn_cb conn_callbacks = {
	.connected = connected,
	.disconnected = disconnected,
};

void cts_sync_init()
{
    bt_conn_cb_register(&conn_callbacks);
 //   cts_register_write_cb(cts_write_cb);
   sync_local_cts_to_clock();
}

void cts_sync_loop()
{
    if (time_sync_timeout > 0) {
        time_sync_timeout--;
    } else {
        bt_conn_foreach(BT_CONN_TYPE_ALL, cts_sync_processor, NULL);
        time_sync_timeout = TIME_SYNC_WAIT;
    }
}
```

## src/cts_sync.h
```c
/** @file
 *  @brief CTS Service sample
 */

/*
 * Copyright (c) 2016 Intel Corporation
 *
 * SPDX-License-Identifier: Apache-2.0
 */

#ifdef __cplusplus
extern "C" {
#endif
void cts_sync_init();
void cts_sync_loop();





	typedef struct {
		uint16_t year;
		uint8_t month;
		uint8_t day;
		uint8_t hours;
		uint8_t minutes;
		uint8_t seconds;
		uint8_t day_of_week;
		uint8_t exact_time_256;
		uint8_t adjust_reason;
	} cts_datetime_t;

void cts_get_datetime(cts_datetime_t*);





#ifdef __cplusplus
}
#endif
```
