## CMakeLists.txt
```
# SPDX-License-Identifier: Apache-2.0

cmake_minimum_required(VERSION 3.13.1)
include($ENV{ZEPHYR_BASE}/../pinetime/cmake/boilerplate.cmake)
include($ENV{ZEPHYR_BASE}/cmake/app/boilerplate.cmake NO_POLICY_SCOPE)
project(clock)

FILE(GLOB app_sources src/*.c)
target_sources(app PRIVATE ${app_sources})
```

## prj.conf
```kconfig
CONFIG_HEAP_MEM_POOL_SIZE=16384

CONFIG_DISPLAY=y
CONFIG_DISPLAY_LOG_LEVEL_ERR=y

CONFIG_LOG=y

CONFIG_LVGL_OBJ_LABEL=y
CONFIG_ST7789V=y
CONFIG_GPIO=y
CONFIG_LVGL=y
CONFIG_LVGL_OBJ_IMAGE=y
CONFIG_PRINTK=y

CONFIG_SPI=y
CONFIG_ST7789V=y
CONFIG_ST7789V_RGB565=y
CONFIG_LVGL_BITS_PER_PIXEL=24
CONFIG_LVGL_HOR_RES=240
CONFIG_LVGL_VER_RES=240
CONFIG_LVGL_DISPLAY_DEV_NAME="DISPLAY"





CONFIG_COUNTER=y
# Incresed stack due to settings API usage
CONFIG_SYSTEM_WORKQUEUE_STACK_SIZE=2048

CONFIG_BT=y
CONFIG_BT_DEBUG_LOG=y
CONFIG_BT_SMP=y
CONFIG_BT_SIGNING=y
CONFIG_BT_PERIPHERAL=y
CONFIG_BT_GATT_DIS=y
CONFIG_BT_ATT_PREPARE_COUNT=5
CONFIG_BT_GATT_BAS=y
CONFIG_BT_GATT_HRS=y
CONFIG_BT_PRIVACY=y
CONFIG_BT_DEVICE_NAME="cts client test"
CONFIG_BT_DEVICE_APPEARANCE=833
CONFIG_BT_DEVICE_NAME_DYNAMIC=y
CONFIG_BT_DEVICE_NAME_MAX=65

CONFIG_BT_KEYS_OVERWRITE_OLDEST=y
CONFIG_BT_SETTINGS=y
CONFIG_FLASH=y
CONFIG_FLASH_PAGE_LAYOUT=y
CONFIG_FLASH_MAP=y
CONFIG_NVS=y
CONFIG_SETTINGS=y

#specific for CTS 
#CONFIG_BT_CENTRAL=y
CONFIG_BT_GATT_CLIENT=y
#CONFIG_BT_HCI_VS_EXT=y
#CONFIG_BT_HCI=y
##CONFIG_BT_HCI_RAW is not set
#CONFIG_BT_HAS_HCI_VS=y
#CONFIG_BT_HCI_VS=y
# # CONFIG_BT_DEBUG_HCI_DRIVER is not set
#CONFIG_BT_HCI_HOST=y
#CONFIG_BT_HCI_CMD_COUNT=2
#CONFIG_BT_HCI_TX_STACK_SIZE=1024
# # CONFIG_BT_HCI_TX_STACK_SIZE_WITH_PROMPT is not set
#CONFIG_BT_HCI_ECC_STACK_SIZE=1100
#CONFIG_BT_HCI_TX_PRIO=7
#CONFIG_BT_HCI_RESERVE=0
# # CONFIG_BT_DEBUG_HCI_CORE is not set
# # CONFIG_BT_HCI_VS_EVT_USER is not set
#CONFIG_BT_CTLR_DTM_HCI_SUPPORT=y
#CONFIG_BT_CTLR_HCI_VS_BUILD_INFO=""
```

## src/main.c
```c
/*
 * Copyright (c) 2018 Jan Van Winkel <jan.van_winkel@dxplore.eu>
 *
 * SPDX-License-Identifier: Apache-2.0
 */

#include <device.h>
#include <drivers/display.h>
#include <lvgl.h>
#include <stdio.h>
#include <string.h>
#include <zephyr.h>
#include <drivers/gpio.h>
#include <sys/byteorder.h>
#include <stdlib.h>
#include <sys/printk.h> //tod have to remove this later on, since makes no sense
#include <drivers/counter.h>

#define DELAY 1000000 //should be 1 second
#define ALARM_CHANNEL_ID 0



#define LOG_LEVEL CONFIG_LOG_DEFAULT_LEVEL
#include <logging/log.h>
LOG_MODULE_REGISTER(app);

//#include "lv_ex_conf.h"

#define LED_PORT        DT_ALIAS_LED1_GPIOS_CONTROLLER
#define LED             DT_ALIAS_LED1_GPIOS_PIN
#define LV_IMG_DECLARE(var_name) extern const lv_img_dsc_t var_name;
LV_IMG_DECLARE(klokje);

int seconden; //todo cannot be global
int minuten;
int uren;

struct counter_alarm_cfg alarm_cfg;

static void test_counter_interrupt_fn(struct device *counter_dev,
		u8_t chan_id, u32_t ticks,
		void *user_data)
{
	int err;

	seconden++;
	if (seconden > 59) {
		seconden=0;
		minuten++;
		if (minuten > 59){
			minuten=0;
			uren++;
			if (uren > 23)
			{
				uren=0;
			}
		}

	}



	// after expiring the alarm is set again
	err = counter_set_channel_alarm(counter_dev, ALARM_CHANNEL_ID,
			user_data);

	if (err != 0) {
		printk("Alarm could not be set\n");
	}
}











static void backlight_init(void)
{
	struct device *dev;

	dev = device_get_binding(LED_PORT);
	/* If you have a backlight, set it up and turn it on here */
	gpio_pin_configure(dev, LED, GPIO_DIR_OUT);
	gpio_pin_write(dev, LED, 0);
}



void main(void)
{
	int err;
	struct device *counter_dev;
	counter_dev = device_get_binding(DT_RTC_0_NAME);
	counter_start(counter_dev);
	if (counter_dev == NULL) {
		printk("Device not found\n");
		return;
	}
	alarm_cfg.flags = 0;
	alarm_cfg.ticks = counter_us_to_ticks(counter_dev, DELAY);
	alarm_cfg.callback = test_counter_interrupt_fn;
	alarm_cfg.user_data = &alarm_cfg;

	err=counter_set_channel_alarm(counter_dev, ALARM_CHANNEL_ID, &alarm_cfg);


	//todo catch err


	//lv_obj_t *scr = lv_scr_act();
	lv_obj_t * img_bin = lv_img_create(lv_scr_act(), NULL);

	/*clock background*/
	lv_img_set_src(img_bin, &klokje);



	//int year;
	//int buff[10];
	char snum[3];
	u32_t count = 0U;
	char count_str[11] = {0};
	struct device *display_dev;
	lv_obj_t *hello_world_label;
	lv_obj_t *count_label; 
	lv_obj_t *clock_label; 
	display_dev = device_get_binding(CONFIG_LVGL_DISPLAY_DEV_NAME);


	/*Create a style*/
	//	static lv_style_t style1;

	//	lv_style_copy(&style1, &lv_style_plain);        /*Copy a built-in style*/
	//	style1.body.main_color = LV_COLOR_RED;          /*Main color*/


	if (display_dev == NULL) {
		LOG_ERR("device not found.  Aborting test.");
		return;
	}
	else
		backlight_init();

	hello_world_label = lv_label_create(lv_scr_act(), NULL);
	lv_label_set_long_mode(hello_world_label, LV_LABEL_LONG_BREAK);     //Break the long lines
	lv_label_set_recolor(hello_world_label, true);                      //Enable re-coloring by commands in the text
	lv_obj_set_width(hello_world_label, 240);
	lv_label_set_text(hello_world_label, "#00ffff Open Source Watch"); //recoloring should be blue ...



	count_label = lv_label_create(lv_scr_act(), NULL);
	clock_label = lv_label_create(lv_scr_act(), NULL);
	lv_obj_align(count_label, NULL, LV_ALIGN_IN_BOTTOM_MID, 0, 0);
	lv_obj_align(clock_label, NULL, LV_ALIGN_CENTER, 0, 0);

	display_blanking_off(display_dev);

	while (1) {

		sprintf(snum, "%2d:%2d:%2d", uren, minuten,seconden); //seconden gets updated by interrupt
		lv_label_set_text(clock_label, "00ffff"); 
		lv_label_set_text(clock_label, snum); 

		if ((count % 100) == 0U) {
			sprintf(count_str, "%d", count/100U);
			lv_label_set_text(count_label, count_str);
		}
		lv_task_handler();
		k_sleep(K_MSEC(10));
		++count;
	}
}
```

## src/cts_sync.c
```c
#include <sys/printk.h>
#include <bluetooth/bluetooth.h>
#include <bluetooth/hci.h>
#include <bluetooth/conn.h>
#include <bluetooth/uuid.h>
#include <bluetooth/gatt.h>
#include "cts_sync.h"

#define TIME_SYNC_WAIT 60 // TODO: tune
int time_sync_timeout = TIME_SYNC_WAIT;
static struct bt_gatt_discover_params cts_discovery_params;
static struct bt_uuid_16 uuid = BT_UUID_INIT_16(0);
static struct bt_gatt_read_params read_params;

static void sync_cts_to_clock(cts_datetime_t* cts_datetime)
{
    printk("CTS sync to clock started.\n Y%04d D%03d T%2d:%2d:%2d",
        cts_datetime->year, cts_datetime->day,
        cts_datetime->hours, cts_datetime->minutes, cts_datetime->seconds);

    cts_datetime_t clock_datetime;
    memset(&clock_datetime, 0, sizeof(cts_datetime_t));
    clock_datetime.year = cts_datetime->year;
    clock_datetime.month = cts_datetime->month;
    clock_datetime.day = cts_datetime->day;
    clock_datetime.hours = cts_datetime->hours;
    clock_datetime.minutes = cts_datetime->minutes;
    clock_datetime.seconds = cts_datetime->seconds;

    //clock_set_datetime(&clock_datetime);

    printk("CTS sync to clock complete.");

    time_sync_timeout = TIME_SYNC_WAIT;
}

static void sync_local_cts_to_clock()
{
//    cts_datetime_t cts_datetime;
//   cts_get_datetime(&cts_datetime);
//  sync_cts_to_clock(&cts_datetime);
}

//static void cts_write_cb(int val)
//{
//    sync_local_cts_to_clock();
//}

int offset = 0;
cts_datetime_t datetime_buf;
u8_t cts_sync_read(struct bt_conn *conn, u8_t err,
				    struct bt_gatt_read_params *params,
				    const void *data, u16_t length)
{
    printk("Reading CCC data: err %d, %d bytes, offset %d.", err, length, offset);

    if (!data || length <= 0) {
        sync_cts_to_clock(&datetime_buf);
        return BT_GATT_ITER_STOP;
    }

    memcpy(&datetime_buf + offset, data, length);
    offset += length;

    return BT_GATT_ITER_CONTINUE;
}

u8_t cts_sync_service_discovered(struct bt_conn* conn, const struct bt_gatt_attr* attr,
        struct bt_gatt_discover_params* params)
{
    if (!attr) {
        printk("CTS Service Discovery completed");
        return BT_GATT_ITER_STOP;
    }
    printk("Discovered attribute, handle: %u\n", attr->handle);

    memset(&read_params, 0, sizeof(read_params));
    read_params.func = cts_sync_read;
    read_params.by_uuid.uuid = &uuid;
    read_params.by_uuid.start_handle = attr->handle;
    read_params.by_uuid.end_handle = 0xffff;
    offset = 0;
    if (bt_gatt_read(conn, &read_params) < 0) {
        printk("Could not initiate read of CCC data.");
    }

    return BT_GATT_ITER_STOP;
}

 //#define BT_UUID_CTS                       BT_UUID_DECLARE_16(0x1805)
 //#define BT_UUID_CTS_CURRENT_TIME          BT_UUID_DECLARE_16(0x2a2b)


static void cts_sync_processor(struct bt_conn *conn, void *data)
{
    memcpy(&uuid, BT_UUID_CTS_CURRENT_TIME, sizeof(uuid));
    cts_discovery_params.func = cts_sync_service_discovered;
    cts_discovery_params.start_handle = 0x0001;
    cts_discovery_params.end_handle = 0xFFFF;
    cts_discovery_params.type = BT_GATT_DISCOVER_CHARACTERISTIC;
    cts_discovery_params.uuid = &uuid;

    if (bt_gatt_discover(conn, &cts_discovery_params) != 0) {
        printk("CTS Sync > GATT discovery FAILED.\n");
    }
}

static void connected(struct bt_conn *conn, u8_t err)
{
	if (err) {
		return;
	}
    cts_sync_processor(conn, NULL);
}

static void disconnected(struct bt_conn *conn, u8_t reason)
{
}

static struct bt_conn_cb conn_callbacks = {
	.connected = connected,
	.disconnected = disconnected,
};

void cts_sync_init()
{
    bt_conn_cb_register(&conn_callbacks);
 //   cts_register_write_cb(cts_write_cb);
 //  sync_local_cts_to_clock();
}

void cts_sync_loop()
{
    if (time_sync_timeout > 0) {
        time_sync_timeout--;
    } else {
        bt_conn_foreach(BT_CONN_TYPE_ALL, cts_sync_processor, NULL);
        time_sync_timeout = TIME_SYNC_WAIT;
    }
}
```
