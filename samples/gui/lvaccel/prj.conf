## CMakeLists.txt
```
# SPDX-License-Identifier: Apache-2.0

cmake_minimum_required(VERSION 3.13.1)
include($ENV{ZEPHYR_BASE}/../pinetime/cmake/boilerplate.cmake)
include($ENV{ZEPHYR_BASE}/cmake/app/boilerplate.cmake NO_POLICY_SCOPE)
project(lvaccel)

FILE(GLOB app_sources src/*.c)
target_sources(app PRIVATE ${app_sources})
```

## prj.conf
```kconfig
CONFIG_HEAP_MEM_POOL_SIZE=16384

CONFIG_DISPLAY=y
CONFIG_DISPLAY_LOG_LEVEL_ERR=y

CONFIG_LOG=y

CONFIG_LVGL_OBJ_LABEL=y
CONFIG_ST7789V=y
CONFIG_GPIO=y
CONFIG_LVGL=y
#CONFIG_STDOUT_CONSOLE=y
#CONFIG_LOG=y
CONFIG_I2C=y
CONFIG_SENSOR=y
CONFIG_SENSOR_LOG_LEVEL_WRN=y
CONFIG_BMA421=y
#CONFIG_BMA421_CHIP_BMA421=y
## CONFIG_BMA421_CHIP_BMC150_ACCEL is not set
#CONFIG_BMA421_NAME="BMA421"
#CONFIG_BMA421_I2C_ADDR=0x18
#CONFIG_BMA421_I2C_MASTER_DEV_NAME="I2C_1"
## CONFIG_BMA421_TRIGGER_NONE is not set
#CONFIG_BMA421_TRIGGER_GLOBAL_THREAD=y
## CONFIG_BMA421_TRIGGER_OWN_THREAD is not set
#CONFIG_BMA421_TRIGGER=y
#CONFIG_BMA421_GPIO_DEV_NAME="GPIO_0"
#CONFIG_BMA421_GPIO_PIN_NUM=8
#CONFIG_BMA421_PMU_RANGE_2G=y
#
CONFIG_SPI=y
CONFIG_DISPLAY=y
#CONFIG_ST7789V=y
CONFIG_LVGL=y
CONFIG_ST7789V_RGB565=y
CONFIG_LVGL_BITS_PER_PIXEL=24
CONFIG_LVGL_HOR_RES=240
CONFIG_LVGL_VER_RES=240
CONFIG_LVGL_DISPLAY_DEV_NAME="DISPLAY"
CONFIG_LVGL_BUILD_IN_FONT_ROBOTO_22=y
CONFIG_LVGL_DEFAULT_FONT_BUILD_IN_ROBOTO_22=y
```

## src/main.c
```c
/*
 * Copyright (c) 2018 Jan Van Winkel <jan.van_winkel@dxplore.eu>
 *
 * SPDX-License-Identifier: Apache-2.0
 */


#include <device.h>
#include <drivers/display.h>
#include <lvgl.h>
#include <stdio.h>
#include <string.h>
#include <zephyr.h>
#include <drivers/gpio.h>
#include <drivers/sensor.h>

#define LOG_LEVEL CONFIG_LOG_DEFAULT_LEVEL
#include <logging/log.h>
LOG_MODULE_REGISTER(app);



#define LED_PORT        DT_ALIAS_LED1_GPIOS_CONTROLLER
#define LED             DT_ALIAS_LED1_GPIOS_PIN
#define MY_REGISTER1 (*(volatile uint8_t*)0x2000F000)
#define MY_REGISTER2 (*(volatile uint8_t*)0x2000F001)

static void backlight_init(void)
{
	struct device *dev;

	dev = device_get_binding(LED_PORT);
	/* If you have a backlight, set it up and turn it on here */
	gpio_pin_configure(dev, LED, GPIO_DIR_OUT);
	gpio_pin_write(dev, LED, 0);
}



void main(void)
{


	struct sensor_value accel[3];
//	struct sensor_value temp;
//	int temp=99;

	struct device *dev = device_get_binding(DT_INST_0_BOSCH_BMA421_LABEL);
		MY_REGISTER1=0x00;

	if (dev == NULL) {
		MY_REGISTER1=0x77;
		printf("Could not get %s device\n", DT_INST_0_BOSCH_BMA421_LABEL);
		return;
	}

	struct sensor_trigger trig = {
		.type = SENSOR_TRIG_DATA_READY,
		.chan = SENSOR_CHAN_ACCEL_XYZ,
	};
	lv_obj_t *hello_world_label;


	hello_world_label = lv_label_create(lv_scr_act(), NULL);

	if (sensor_sample_fetch(dev)) {
	lv_label_set_text(hello_world_label, "FAILED BMA");
		printf("sensor_sample_fetch failed\n");
	}
	else
	lv_label_set_text(hello_world_label, "BMA OK");
		//MY_REGISTER1=0xAA;

	sensor_channel_get(dev, SENSOR_CHAN_ACCEL_XYZ, accel);


	u32_t count = 0U;
	char count_str[11] = {0};
	char accel_str[11] = {0};
	char accel_str2[11] = {0};
	char accel_str3[11] = {0};
	char temp_str[11] = {0};
	struct device *display_dev;
	lv_obj_t *count_label;
	lv_obj_t *accel_label;
	lv_obj_t *accel_label2;
	lv_obj_t *accel_label3;
	lv_obj_t *temp_label;
	display_dev = device_get_binding(CONFIG_LVGL_DISPLAY_DEV_NAME);
	//lv_btn_set_style(obj, LV_BTN_STYLE_REL, &lv_style_plain_color); /*set other style for background*/
	if (display_dev == NULL) {
		LOG_ERR("device not found.  Aborting test.");
		MY_REGISTER1=0xEE;
		return;
	}
	else
		backlight_init();


//	lv_label_set_long_mode(hello_world_label, LV_LABEL_LONG_BREAK);     /*Break the long lines*/
//	lv_label_set_recolor(hello_world_label, true);                      /*Enable re-coloring by commands in the text*/
//	lv_label_set_text(hello_world_label, "Hello world!");
	//lv_label_set_text(hello_world_label, "#0000ff Hello world!");

	lv_obj_align(hello_world_label, NULL, LV_ALIGN_CENTER, 0, 0);


	lv_obj_t * label2 = lv_label_create(lv_scr_act(), NULL);
	lv_label_set_long_mode(label2, LV_LABEL_LONG_SROLL_CIRC);     /*Circular scroll*/
	lv_obj_set_width(label2, 150);
	lv_label_set_text(label2, "It is a circularly scrolling text. ");
	lv_obj_align(label2, NULL, LV_ALIGN_CENTER, 0, 30);


	count_label = lv_label_create(lv_scr_act(), NULL);
	lv_obj_align(count_label, NULL, LV_ALIGN_IN_BOTTOM_MID, 0, 0);
	accel_label = lv_label_create(lv_scr_act(), NULL);
	lv_obj_align(accel_label, NULL, LV_ALIGN_IN_TOP_MID, 0, 0);
	accel_label2 = lv_label_create(lv_scr_act(), NULL);
	lv_obj_align(accel_label2, NULL, LV_ALIGN_IN_TOP_MID, 0, 25);
	accel_label3 = lv_label_create(lv_scr_act(), NULL);
	lv_obj_align(accel_label3, NULL, LV_ALIGN_IN_TOP_MID, 0, 50);
	temp_label = lv_label_create(lv_scr_act(), NULL);
	lv_obj_align(temp_label, NULL, LV_ALIGN_IN_TOP_MID, 0, 75);

	display_blanking_off(display_dev);

	while (1) {
		if ((count % 100) == 0U) {
			sensor_channel_get(dev, SENSOR_CHAN_ACCEL_XYZ, accel);
		//	sensor_channel_get(dev, SENSOR_CHAN_DIE_TEMP, &temp);
			//MY_REGISTER2=temp;
			if (sensor_value_to_double(&accel[0]) != 0) MY_REGISTER1=0x99;
			sprintf(accel_str, "%.1f", sensor_value_to_double(&accel[0]));
			lv_label_set_text(accel_label, accel_str);
			
			sprintf(accel_str2, "%.1f", sensor_value_to_double(&accel[1]));
			lv_label_set_text(accel_label2, accel_str2);

			sprintf(accel_str3, "%.1f", sensor_value_to_double(&accel[2]));
			lv_label_set_text(accel_label3, accel_str3);

			//sprintf(accel_str3, "%.1f", sensor_value_to_double(&temp)); //temperature
			//lv_label_set_text(temp_label, temp_str);
			
			sprintf(count_str, "%d", count/100U);
			lv_label_set_text(count_label, count_str);
		}
		lv_task_handler();
		k_sleep(K_MSEC(10));
		++count;
	}
}
```
