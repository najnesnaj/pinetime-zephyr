## CMakeLists.txt
```
# SPDX-License-Identifier: Apache-2.0

cmake_minimum_required(VERSION 3.13.1)



include($ENV{ZEPHYR_BASE}/../pinetime/cmake/boilerplate.cmake)
include($ENV{ZEPHYR_BASE}/cmake/app/boilerplate.cmake NO_POLICY_SCOPE)
project(peripheral-cts)

target_sources(app PRIVATE
  src/main.c
  src/cts_sync.c
)

zephyr_library_include_directories($ENV{ZEPHYR_BASE}/samples/bluetooth)
```

## prj.conf
```kconfig
# Incresed stack due to settings API usage
CONFIG_SYSTEM_WORKQUEUE_STACK_SIZE=2048

CONFIG_BT=y
CONFIG_BT_DEBUG_LOG=y
CONFIG_BT_SMP=y
CONFIG_BT_SIGNING=y
CONFIG_BT_PERIPHERAL=y
CONFIG_BT_GATT_DIS=y
CONFIG_BT_ATT_PREPARE_COUNT=5
CONFIG_BT_GATT_BAS=y
CONFIG_BT_GATT_HRS=y
CONFIG_BT_PRIVACY=y
CONFIG_BT_DEVICE_NAME="cts client test"
CONFIG_BT_DEVICE_APPEARANCE=833
CONFIG_BT_DEVICE_NAME_DYNAMIC=y
CONFIG_BT_DEVICE_NAME_MAX=65

CONFIG_BT_KEYS_OVERWRITE_OLDEST=y
CONFIG_BT_SETTINGS=y
CONFIG_FLASH=y
CONFIG_FLASH_PAGE_LAYOUT=y
CONFIG_FLASH_MAP=y
CONFIG_NVS=y
CONFIG_SETTINGS=y

#specific for CTS 
#CONFIG_BT_CENTRAL=y
CONFIG_BT_GATT_CLIENT=y
#CONFIG_BT_HCI_VS_EXT=y
#CONFIG_BT_HCI=y
##CONFIG_BT_HCI_RAW is not set
#CONFIG_BT_HAS_HCI_VS=y
#CONFIG_BT_HCI_VS=y
# # CONFIG_BT_DEBUG_HCI_DRIVER is not set
#CONFIG_BT_HCI_HOST=y
#CONFIG_BT_HCI_CMD_COUNT=2
#CONFIG_BT_HCI_TX_STACK_SIZE=1024
# # CONFIG_BT_HCI_TX_STACK_SIZE_WITH_PROMPT is not set
#CONFIG_BT_HCI_ECC_STACK_SIZE=1100
#CONFIG_BT_HCI_TX_PRIO=7
#CONFIG_BT_HCI_RESERVE=0
# # CONFIG_BT_DEBUG_HCI_CORE is not set
# # CONFIG_BT_HCI_VS_EVT_USER is not set
#CONFIG_BT_CTLR_DTM_HCI_SUPPORT=y
#CONFIG_BT_CTLR_HCI_VS_BUILD_INFO=""
```

## boards/ds_d6.conf
```kconfig
CONFIG_CLOCK_CONTROL_NRF_K32SRC_SYNTH=y
CONFIG_CLOCK_CONTROL_NRF_K32SRC_30PPM=y
```

## src/main.c
```c
/* main.c - Application main entry point */

/*
 * Copyright (c) 2015-2016 Intel Corporation
 *
 * SPDX-License-Identifier: Apache-2.0
 */

#include <zephyr/types.h>
#include <stddef.h>
#include <string.h>
#include <errno.h>
#include <sys/printk.h>
#include <sys/byteorder.h>
#include <zephyr.h>

#include <settings/settings.h>

#include <bluetooth/bluetooth.h>
#include <bluetooth/hci.h>
#include <bluetooth/conn.h>
#include <bluetooth/uuid.h>
#include <bluetooth/gatt.h>

#include "cts_sync.h"



//struct time* clock_get_datetime();
/*

   static const struct bt_data ad[] = {
   BT_DATA_BYTES(BT_DATA_FLAGS, (BT_LE_AD_GENERAL | BT_LE_AD_NO_BREDR)),
   BT_DATA_BYTES(BT_DATA_UUID16_ALL,
   0x0d, 0x18, 0x0f, 0x18, 0x05, 0x18),
   BT_DATA_BYTES(BT_DATA_UUID128_ALL,
   0xf0, 0xde, 0xbc, 0x9a, 0x78, 0x56, 0x34, 0x12,
   0x78, 0x56, 0x34, 0x12, 0x78, 0x56, 0x34, 0x12),
   };
   */
static const struct bt_data ad[] = {
	BT_DATA_BYTES(BT_DATA_FLAGS, BT_LE_AD_NO_BREDR),
	BT_DATA_BYTES(BT_DATA_UUID16_ALL, 0xaa, 0xfe),
	BT_DATA_BYTES(BT_DATA_SVC_DATA16,
			0xaa, 0xfe, /* Eddystone UUID */
			0x10, /* Eddystone-URL frame type */
			0x00, /* Calibrated Tx power at 0m */
			0x00, /* URL Scheme Prefix http://www. */
			'P', 'i', 'n', 'e', 'T', 'i',
			'm', 'e', '-', '2', '0', '2', '0',
			0x08) /* .org */
};

static void bt_ready(void)
{
	int err;

	printk("Bluetooth initialized\n");


	if (IS_ENABLED(CONFIG_SETTINGS)) {
		settings_load();
	}
	printk("bt_le_adv_start\n");
	err = bt_le_adv_start(BT_LE_ADV_CONN_NAME, ad, ARRAY_SIZE(ad), NULL, 0);
	if (err) {
		printk("Advertising failed to start (err %d)\n", err);
		return;
	}

	printk("Advertising successfully started\n");
}



void main(void)
{
	cts_datetime_t internal_datetime;
	int err;

	//bt_ctlr_set_public_addr(addr);
	err = bt_enable(NULL);
	if (err) {
		printk("Bluetooth init failed (err %d)\n", err);
		return;
	}

	//todo is this necessary ?
	bt_ready();
	//bt_enable(bt_ready) should work ...
	//	bt_conn_cb_register(&conn_callbacks);
	//	bt_conn_auth_cb_register(&auth_cb_display);
	cts_sync_init(); 


	while (1) {
		k_sleep(MSEC_PER_SEC);
		cts_sync_loop();

	}
}
```

## src/clock.h
```c
#include <time.h>

void clock_init();
void clock_loop();

time_t clock_get_ticks();
struct tm* clock_get_datetime();
void clock_set_datetime(struct tm* datetime);
```

## src/cts.h
```c
/** @file
 *  @brief CTS Service sample
 */

/*
 * Copyright (c) 2016 Intel Corporation
 *
 * SPDX-License-Identifier: Apache-2.0
 */

#ifdef __cplusplus
extern "C" {
#endif

	void cts_init(void);
	void cts_notify(void);



	typedef void (*cts_write_cb_t)(int);
	void cts_register_write_cb(cts_write_cb_t);

	typedef struct {
		uint16_t year;
		uint8_t month;
		uint8_t day;
		uint8_t hours;
		uint8_t minutes;
		uint8_t seconds;
		uint8_t day_of_week;
		uint8_t exact_time_256;
		uint8_t adjust_reason;
	} cts_datetime_t;

	void cts_get_datetime(cts_datetime_t*);





#ifdef __cplusplus
}
#endif
```

## src/cts_sync.c
```c
#include <sys/printk.h>
#include <bluetooth/bluetooth.h>
#include <bluetooth/hci.h>
#include <bluetooth/conn.h>
#include <bluetooth/uuid.h>
#include <bluetooth/gatt.h>
//#include "log.h"
#include "cts_sync.h"
//#include "bt.h"
#include "cts.h"
#include "clock.h"

#define TIME_SYNC_WAIT 10 // TODO: tune
int time_sync_timeout = TIME_SYNC_WAIT;
static struct bt_gatt_discover_params cts_discovery_params;
static struct bt_uuid_16 uuid = BT_UUID_INIT_16(0);
static struct bt_gatt_read_params read_params;
int tijd;

int get_uur()
{
	return(tijd);
}

static void sync_cts_to_clock(cts_datetime_t* cts_datetime)
{
	printk("CTS sync to clock started.\n Y%04d D%03d T%2d:%2d:%2d",
			cts_datetime->year, cts_datetime->day,
			cts_datetime->hours, cts_datetime->minutes, cts_datetime->seconds);

	struct tm clock_datetime;
	memset(&clock_datetime, 0, sizeof(struct tm));
	//    clock_datetime.tm_year = cts_datetime->year;
	//    clock_datetime.tm_mon = cts_datetime->month;
	//    clock_datetime.tm_mday = cts_datetime->day;
	//clock_datetime.tm_hour = cts_datetime->hours;
	//tijd = cts_datetime->minutes;
	tijd = 32;
	//clock_datetime.tm_min = cts_datetime->minutes;
	//minuten = cts_datetime->minutes;
	//clock_datetime.tm_sec = cts_datetime->seconds;
	// seconden = cts_datetime->seconds;

	//clock_set_datetime(&clock_datetime);

	printk("CTS sync to clock complete.");

	time_sync_timeout = TIME_SYNC_WAIT;
}

static void sync_local_cts_to_clock()
{
	//cts_datetime_t cts_datetime;
	//cts_get_datetime(&cts_datetime);
	//sync_cts_to_clock(&cts_datetime);
}

static void cts_write_cb(int val)
{
	sync_local_cts_to_clock();
}

int offset = 0;
cts_datetime_t datetime_buf;
u8_t cts_sync_read(struct bt_conn *conn, u8_t err,
		struct bt_gatt_read_params *params,
		const void *data, u16_t length)
{
	printk("Reading CCC data: err %d, %d bytes, offset %d.", err, length, offset);

	if (!data || length <= 0) {
		sync_cts_to_clock(&datetime_buf);
		printk("BT_GATT_ITER_STOP\n");
		return BT_GATT_ITER_STOP;
	}

	//   memcpy(&datetime_buf + offset, data, length);
	offset += length;
	printk("BT_GATT_ITER_CONTINUE\n");

	return BT_GATT_ITER_CONTINUE;
}

u8_t cts_sync_service_discovered(struct bt_conn* conn, const struct bt_gatt_attr* attr,
		struct bt_gatt_discover_params* params)
{
	if (!attr) {
		printk("CTS Service Discovery completed");
		return BT_GATT_ITER_STOP;
	}
	printk("Discovered attribute, handle: %u\n", attr->handle);

	memset(&read_params, 0, sizeof(read_params));
	read_params.func = cts_sync_read;
	read_params.by_uuid.uuid = &uuid;
	read_params.by_uuid.start_handle = attr->handle;
	read_params.by_uuid.end_handle = 0xffff;
	offset = 0;
	if (bt_gatt_read(conn, &read_params) < 0) {
		printk("Could not initiate read of CCC data.");
	}

	return BT_GATT_ITER_STOP;
}

static void cts_sync_processor(struct bt_conn *conn, void *data)
{

	//#define BT_UUID_CTS                       BT_UUID_DECLARE_16(0x1805)
	//#define BT_UUID_CTS_CURRENT_TIME          BT_UUID_DECLARE_16(0x2a2b)
		printk("cts_sync_processor \n");
	memcpy(&uuid, BT_UUID_CTS_CURRENT_TIME, sizeof(uuid));
	cts_discovery_params.func = cts_sync_service_discovered;
	cts_discovery_params.start_handle = 0x0001;
	cts_discovery_params.end_handle = 0xFFFF;
	cts_discovery_params.type = BT_GATT_DISCOVER_CHARACTERISTIC;
	cts_discovery_params.uuid = &uuid;

	if (bt_gatt_discover(conn, &cts_discovery_params) != 0) {
		printk("CTS Sync > GATT discovery FAILED.\n");
	}
	else
		printk("CTS Sync  GATT discovery succeeded\n");
}

static void connected(struct bt_conn *conn, u8_t err)
{
	if (err) {
		return;
	}
	cts_sync_processor(conn, NULL);
}

static void disconnected(struct bt_conn *conn, u8_t reason)
{
}

static struct bt_conn_cb conn_callbacks = {
	.connected = connected,
	.disconnected = disconnected,
};

void cts_sync_init()
{
	printk("cts_sync_init \n");
	bt_conn_cb_register(&conn_callbacks);
	//cts_register_write_cb(cts_write_cb); //todo
	//    sync_local_cts_to_clock();
		printk("cts_sync_init finished\n");
}

void cts_sync_loop()
{
	if (time_sync_timeout > 0) {
		time_sync_timeout--;
		printk("time_sync_timeout-- \n");
	} else {
		printk("bt_conn_foreach \n");
		bt_conn_foreach(BT_CONN_TYPE_ALL, cts_sync_processor, NULL);
		time_sync_timeout = TIME_SYNC_WAIT;
	}
}
```

## src/cts_sync.h
```c
void cts_sync_init();
void cts_sync_loop();

int get_uur();
```

## src/log.h
```c
#include <logging/log.h>
LOG_MODULE_DECLARE(app, LOG_LEVEL_INF);
```
