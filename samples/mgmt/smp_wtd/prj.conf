## CMakeLists.txt
```
cmake_minimum_required(VERSION 3.13.1)
# Top-level CMakeLists.txt for the skeleton application.
#
# Copyright (c) 2017 Open Source Foundries Limited
#
# SPDX-License-Identifier: Apache-2.0
#
# This provides a basic application structure suitable for communication using
# mcumgr.  It can be used as a starting point for new applications.

# Standard Zephyr application boilerplate.
include($ENV{ZEPHYR_BASE}/../pinetime/cmake/boilerplate.cmake)
include($ENV{ZEPHYR_BASE}/cmake/app/boilerplate.cmake NO_POLICY_SCOPE)
project(smp_svr)

#FILE(GLOB app_sources src/*.c)
#target_sources(app PRIVATE
#    src/main.c
#)
FILE(GLOB app_sources src/*.c)
target_sources(app PRIVATE ${app_sources})

zephyr_link_libraries_ifdef(CONFIG_FILE_SYSTEM_NFFS NFFS)
```

## prj.conf
```kconfig
# Enable mcumgr.
CONFIG_MCUMGR=y

# Some command handlers require a large stack.
CONFIG_SYSTEM_WORKQUEUE_STACK_SIZE=2048

# Ensure an MCUboot-compatible binary is generated.
CONFIG_BOOTLOADER_MCUBOOT=y

# Allow for large Bluetooth data packets.
CONFIG_BT_L2CAP_TX_MTU=260
CONFIG_BT_RX_BUF_LEN=260

# Enable the Bluetooth (unauthenticated) and shell mcumgr transports.
CONFIG_MCUMGR_SMP_BT=y
CONFIG_MCUMGR_SMP_BT_AUTHEN=n
CONFIG_MCUMGR_SMP_SHELL=y
CONFIG_MCUMGR_SMP_UART=y

# Enable flash operations.
CONFIG_FLASH=y

# Enable the NFFS file system.
CONFIG_FILE_SYSTEM=y
CONFIG_FILE_SYSTEM_NFFS=y

# Required by the `taskstat` command.
CONFIG_THREAD_MONITOR=y

# Enable statistics and statistic names.
CONFIG_STATS=y
CONFIG_STATS_NAMES=y

# Enable all core commands.
CONFIG_MCUMGR_CMD_FS_MGMT=y
CONFIG_MCUMGR_CMD_IMG_MGMT=y
CONFIG_MCUMGR_CMD_OS_MGMT=y
CONFIG_MCUMGR_CMD_STAT_MGMT=y

### nRF5 specific settings
#CONFIG_SPI=y
#CONFIG_SPI_NRFX=y
#CONFIG_FLASH=y
#CONFIG_SPI_NOR=y

#CONFIG_SPI_NOR_FLASH_LAYOUT_PAGE_SIZE=4096



# Specify the location of the NFFS file system.
CONFIG_FS_NFFS_FLASH_DEV_NAME="NRF_FLASH_DRV_NAME"

#for the watchdog

CONFIG_LOG=y
CONFIG_WDT_LOG_LEVEL_DBG=y
CONFIG_WATCHDOG=y
```

## boards/ds_d6.conf
```kconfig
CONFIG_CLOCK_CONTROL_NRF_K32SRC_RC=y

#
# Management
#
CONFIG_MCUMGR_SMP_BT=y
# CONFIG_MCUMGR_SMP_BT_AUTHEN is not set
CONFIG_MCUMGR_SMP_SHELL=y
CONFIG_MCUMGR_SMP_SHELL_MTU=256
CONFIG_MCUMGR_SMP_UART=y
CONFIG_MCUMGR_SMP_UART_MTU=256
CONFIG_MCUMGR=y


CONFIG_SHELL=y
CONFIG_SHELL_BACKENDS=y
CONFIG_SHELL_BACKEND_SERIAL=y
CONFIG_SHELL_PROMPT_UART="uart:~$ "
CONFIG_UART_SHELL_ON_DEV_NAME="UART_0"
CONFIG_SHELL_BACKEND_SERIAL_INTERRUPT_DRIVEN=y
CONFIG_SHELL_BACKEND_SERIAL_TX_RING_BUFFER_SIZE=8
CONFIG_SHELL_BACKEND_SERIAL_RX_RING_BUFFER_SIZE=64
CONFIG_SHELL_BACKEND_SERIAL_LOG_MESSAGE_QUEUE_TIMEOUT=100
CONFIG_SHELL_BACKEND_SERIAL_LOG_MESSAGE_QUEUE_SIZE=10
# CONFIG_SHELL_BACKEND_SERIAL_LOG_LEVEL_DEFAULT is not set
CONFIG_SHELL_BACKEND_SERIAL_LOG_LEVEL_DBG=y
# CONFIG_SHELL_BACKEND_SERIAL_LOG_LEVEL_INF is not set
# CONFIG_SHELL_BACKEND_SERIAL_LOG_LEVEL_WRN is not set
# CONFIG_SHELL_BACKEND_SERIAL_LOG_LEVEL_ERR is not set
# CONFIG_SHELL_BACKEND_SERIAL_LOG_LEVEL_NONE is not set
CONFIG_SHELL_BACKEND_SERIAL_LOG_LEVEL=4
# CONFIG_SHELL_BACKEND_RTT is not set
# CONFIG_SHELL_BACKEND_DUMMY is not set
CONFIG_SHELL_STACK_SIZE=2048
CONFIG_SHELL_BACKSPACE_MODE_DELETE=y
CONFIG_SHELL_CMD_BUFF_SIZE=256
CONFIG_SHELL_PRINTF_BUFF_SIZE=30
CONFIG_SHELL_ARGC_MAX=12
CONFIG_SHELL_WILDCARD=y
CONFIG_SHELL_ECHO_STATUS=y
CONFIG_SHELL_VT100_COLORS=y
CONFIG_SHELL_METAKEYS=y
CONFIG_SHELL_HELP=y
CONFIG_SHELL_HELP_ON_WRONG_ARGUMENT_COUNT=y

CONFIG_SHELL_HISTORY_BUFFER=512
CONFIG_SHELL_STATS=y
CONFIG_SHELL_CMDS=y
CONFIG_SHELL_CMDS_RESIZE=y
# CONFIG_SHELL_CMDS_SELECT is not set
CONFIG_KERNEL_SHELL=y
CONFIG_DEVICE_SHELL=y
```

## boards/pinetime.conf
```kconfig
# enable console
CONFIG_CONSOLE=y
CONFIG_UART_CONSOLE=y
```

## src/main.c
```c
/*
 * Copyright (c) 2012-2014 Wind River Systems, Inc.
 *
 * SPDX-License-Identifier: Apache-2.0
 */
#include "watchdog.h"
#include "startapp.h"



#include <assert.h>
#include <zephyr.h>
#include <string.h>
#include <stdlib.h>
#include <stats/stats.h>
#include <mgmt/buf.h>

#ifdef CONFIG_MCUMGR_CMD_FS_MGMT
#include <device.h>
#include <fs/fs.h>
#include "fs_mgmt/fs_mgmt.h"
#include <nffs/nffs.h>
#endif
#ifdef CONFIG_MCUMGR_CMD_OS_MGMT
#include "os_mgmt/os_mgmt.h"
#endif
#ifdef CONFIG_MCUMGR_CMD_IMG_MGMT
#include "img_mgmt/img_mgmt.h"
#endif
#ifdef CONFIG_MCUMGR_CMD_STAT_MGMT
#include "stat_mgmt/stat_mgmt.h"
#endif

#ifdef CONFIG_MCUMGR_SMP_BT
#include <bluetooth/bluetooth.h>
#include <bluetooth/conn.h>
#include <bluetooth/gatt.h>
#include <mgmt/smp_bt.h>
#endif

/* Define an example stats group; approximates seconds since boot. */
	STATS_SECT_START(smp_svr_stats)
STATS_SECT_ENTRY(ticks)
	STATS_SECT_END;

	/* Assign a name to the `ticks` stat. */
	STATS_NAME_START(smp_svr_stats)
STATS_NAME(smp_svr_stats, ticks)
	STATS_NAME_END(smp_svr_stats);

	/* Define an instance of the stats group. */
	STATS_SECT_DECL(smp_svr_stats) smp_svr_stats;

#ifdef CONFIG_MCUMGR_CMD_FS_MGMT
	static struct nffs_flash_desc flash_desc;

	static struct fs_mount_t nffs_mnt = {
		.type = FS_NFFS,
		.mnt_point = "/nffs",
		.fs_data = &flash_desc
	};
#endif

#ifdef CONFIG_MCUMGR_SMP_BT
static struct k_work advertise_work;

static const struct bt_data ad[] = {
	BT_DATA_BYTES(BT_DATA_FLAGS, (BT_LE_AD_GENERAL | BT_LE_AD_NO_BREDR)),
	BT_DATA_BYTES(BT_DATA_UUID128_ALL,
			0x84, 0xaa, 0x60, 0x74, 0x52, 0x8a, 0x8b, 0x86,
			0xd3, 0x4c, 0xb7, 0x1d, 0x1d, 0xdc, 0x53, 0x8d),
};

//static void advertise(void)
static void advertise(struct k_work *work)
{
	int rc;

	bt_le_adv_stop();

	rc = bt_le_adv_start(BT_LE_ADV_CONN_NAME, ad, ARRAY_SIZE(ad), NULL, 0);
	if (rc) {
		printk("Advertising failed to start (rc %d)\n", rc);
		return;
	}

	printk("Advertising successfully started\n");
}

static void connected(struct bt_conn *conn, u8_t err)
{
	if (err) {
		printk("Connection failed (err 0x%02x)\n", err);
	} else {
		printk("Connected\n");
	}
}

static void disconnected(struct bt_conn *conn, u8_t reason)
{
	printk("Disconnected (reason 0x%02x)\n", reason);
	//	advertise();
	k_work_submit(&advertise_work);
}

static struct bt_conn_cb conn_callbacks = {
	.connected = connected,
	.disconnected = disconnected,
};

static void bt_ready(int err)
{
	if (err) {
		printk("Bluetooth init failed (err %d)\n", err);
		return;
	}

	printk("Bluetooth initialized\n");

	//advertise();
	k_work_submit(&advertise_work);
}
#endif

void main(void)
{
#ifdef CONFIG_MCUMGR_CMD_FS_MGMT
	struct device *flash_dev;
#endif
	int rc;
int watchdog_channel;
	rc = STATS_INIT_AND_REG(smp_svr_stats, STATS_SIZE_32, "smp_svr_stats");
	assert(rc == 0);

	/* Register the built-in mcumgr command handlers. */
#ifdef CONFIG_MCUMGR_CMD_FS_MGMT
	flash_dev = device_get_binding(CONFIG_FS_NFFS_FLASH_DEV_NAME);
	if (!flash_dev) {
		printk("Error getting NFFS flash device binding\n");
	} else {
		/* set backend storage dev */
		nffs_mnt.storage_dev = flash_dev;

		rc = fs_mount(&nffs_mnt);
		if (rc < 0) {
			printk("Error mounting nffs [%d]\n", rc);
		}
	}

	fs_mgmt_register_group();
#endif
#ifdef CONFIG_MCUMGR_CMD_OS_MGMT
	os_mgmt_register_group();
#endif
#ifdef CONFIG_MCUMGR_CMD_IMG_MGMT
	img_mgmt_register_group();
#endif
#ifdef CONFIG_MCUMGR_CMD_STAT_MGMT
	stat_mgmt_register_group();
#endif

#ifdef CONFIG_MCUMGR_SMP_BT
	/* Enable Bluetooth. */
	k_work_init(&advertise_work, advertise);
	rc = bt_enable(bt_ready);
	if (rc != 0) {
		printk("Bluetooth init failed (err %d)\n", rc);
		return;
	}
	bt_conn_cb_register(&conn_callbacks);

	/* Initialize the Bluetooth mcumgr transport. */
	smp_bt_register();
#endif
		k_sleep(K_MSEC(10000)); //wait 10 seconds before starting an application
		// this should be enough to upload a new application.

	/* The system work queue handles all incoming mcumgr requests.  Let the
	 * main thread idle while the mcumgr server runs.
	 */
	printk("the watchdog is started \n");
	watchdog_channel=watchdog(); //start the watchdog  
	start_application(&watchdog_channel); 
	//TODO here a reset procedure is in place
	while (1) {
		k_sleep(K_MSEC(1000));
		printk("the watchdog is dead \n");
	}
}
```

## src/startapp.c
```c
/*
 */

#include <zephyr.h>
#include <device.h>
#include <drivers/watchdog.h>
#include <sys/printk.h>
#include <stdbool.h>

#define WDT_FEED_TRIES 5


#ifdef DT_ALIAS_WATCHDOG0_LABEL
#define WDT_DEV_NAME DT_ALIAS_WATCHDOG0_LABEL
#else
#ifdef CONFIG_WWDG_STM32
#define WDT_DEV_NAME DT_WWDT_0_NAME
#else
#define WDT_DEV_NAME DT_WDT_0_NAME
#endif
#endif

/*
static void wdt_callback(struct device *wdt_dev, int channel_id)
{
	static bool handled_event;

	if (handled_event) {
		return;
	}

	wdt_feed(wdt_dev, channel_id);

	printk("Handled things..ready to reset\n");
	handled_event = true;
}
*/
void start_application(int * wdt_channel_id )
{
	int err;
	//int wdt_channel_id;
	struct device *wdt;
	struct wdt_timeout_cfg wdt_config;

	printk("Watchdog sample application\n");

	wdt = device_get_binding(WDT_DEV_NAME);
	if (!wdt) {
		printk("Cannot get WDT device\n");
		return;
	}

	/* Reset SoC when watchdog timer expires. */
	//wdt_config.flags = WDT_FLAG_RESET_SOC;

	/* Expire watchdog after 1000 milliseconds. */
	//wdt_config.window.min = 0U;
	//wdt_config.window.max = 1000U;

	/* Set up watchdog callback. Jump into it when watchdog expired. */
	//wdt_config.callback = wdt_callback;

	//wdt_channel_id = wdt_install_timeout(wdt, &wdt_config);
//	if (wdt_channel_id == -ENOTSUP) {
		/* IWDG driver for STM32 doesn't support callback */
/*		wdt_config.callback = NULL;
		wdt_channel_id = wdt_install_timeout(wdt, &wdt_config);
	}
	if (wdt_channel_id < 0) {
		printk("Watchdog install error\n");
		return;
	}

	err = wdt_setup(wdt, 0);
	if (err < 0) {
		printk("Watchdog setup error\n");
		return;
	}
*/
	/* Feeding watchdog. */
	printk("Feeding watchdog %d times\n", WDT_FEED_TRIES);
	for (int i = 0; i < WDT_FEED_TRIES; ++i) {
		printk("Feeding watchdog...\n");
		wdt_feed(wdt, wdt_channel_id);
		k_sleep(K_MSEC(50));
	}

	/* Waiting for the SoC reset. */
	printk("Waiting for reset...\n");
	while (1) {
	        printk("Waiting for reset loop...\n");
		k_yield();
	}
}
```

## src/startapp.h
```c
void start_application(int *);
```

## src/watchdog.c
```c
/*
 * Copyright (c) 2015 Intel Corporation
 * Copyright (c) 2018 Nordic Semiconductor
 * Copyright (c) 2019 Centaur Analytics, Inc
 *
 * SPDX-License-Identifier: Apache-2.0
 */

#include <zephyr.h>
#include <device.h>
#include <drivers/watchdog.h>
#include <sys/printk.h>
#include <stdbool.h>

#define WDT_FEED_TRIES 5


#ifdef DT_ALIAS_WATCHDOG0_LABEL
#define WDT_DEV_NAME DT_ALIAS_WATCHDOG0_LABEL
#else
#ifdef CONFIG_WWDG_STM32
#define WDT_DEV_NAME DT_WWDT_0_NAME
#else
#define WDT_DEV_NAME DT_WDT_0_NAME
#endif
#endif

static void wdt_callback(struct device *wdt_dev, int channel_id)
{
	static bool handled_event;

	if (handled_event) {
		return;
	}

	wdt_feed(wdt_dev, channel_id);

	printk("Handled things..ready to reset\n");
	handled_event = true;
}

int watchdog(void)
{
	int err;
	int wdt_channel_id;
	struct device *wdt;
	struct wdt_timeout_cfg wdt_config;

	printk("Watchdog sample application\n");

	wdt = device_get_binding(WDT_DEV_NAME);
	if (!wdt) {
		printk("Cannot get WDT device\n");
		return(-1);
	}

	/* Reset SoC when watchdog timer expires. */
	wdt_config.flags = WDT_FLAG_RESET_SOC;

	/* Expire watchdog after 1000 milliseconds. */
	wdt_config.window.min = 0U;
	wdt_config.window.max = 1000U;

	/* Set up watchdog callback. Jump into it when watchdog expired. */
	wdt_config.callback = wdt_callback;

	wdt_channel_id = wdt_install_timeout(wdt, &wdt_config);
	if (wdt_channel_id == -ENOTSUP) {
		/* IWDG driver for STM32 doesn't support callback */
		wdt_config.callback = NULL;
		wdt_channel_id = wdt_install_timeout(wdt, &wdt_config);
	}
	if (wdt_channel_id < 0) {
		printk("Watchdog install error\n");
		return(-1);
	}

	err = wdt_setup(wdt, 0);
	if (err < 0) {
		printk("Watchdog setup error\n");
		return (-1);
	}

	/* Feeding watchdog. */
//	printk("Feeding watchdog %d times\n", WDT_FEED_TRIES);
//	for (int i = 0; i < WDT_FEED_TRIES; ++i) {
//		printk("Feeding watchdog...\n");
//		wdt_feed(wdt, wdt_channel_id);
//		k_sleep(K_MSEC(50));
//	}

	/* Waiting for the SoC reset. */
//	printk("Waiting for reset...\n");
//	while (1) {
//		k_yield();
//	}
//
    return(wdt_channel_id);
}
```

## src/watchdog.h
```c
int watchdog(void);
```
