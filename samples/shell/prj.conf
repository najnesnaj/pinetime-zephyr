## CMakeLists.txt
```
# SPDX-License-Identifier: Apache-2.0

cmake_minimum_required(VERSION 3.13.1)
include($ENV{ZEPHYR_BASE}/../pinetime/cmake/boilerplate.cmake)
include($ENV{ZEPHYR_BASE}/cmake/app/boilerplate.cmake NO_POLICY_SCOPE)
project(battery)

FILE(GLOB app_sources src/*.c)
target_sources(app PRIVATE ${app_sources})
```

## prj.conf
```kconfig
CONFIG_BATTERY=y
CONFIG_HRS3300=y

CONFIG_LOG=y
#CONFIG_ADC_LOG_LEVEL_INF=y

#enable shell over RTT
CONFIG_USE_SEGGER_RTT=y
CONFIG_SHELL=y
CONFIG_SHELL_BACKEND_SERIAL=n
CONFIG_SHELL_BACKEND_RTT=y
CONFIG_CONSOLE=y
CONFIG_RTT_CONSOLE=y
CONFIG_MPU_STACK_GUARD=y
```

## src/main.c
```c
/*
 *
 * SPDX-License-Identifier: Apache-2.0
 */

#include <zephyr.h>
#include <battery.h>
#include <logging/log.h>
LOG_MODULE_REGISTER(app);

void main(void)
{
	int err;

	if (IS_ENABLED(CONFIG_BATTERY)){
		err = battery_init(NULL);
		if (err < 0) {
			LOG_ERR("init failed (%d)", err);
			return;
		}
	}
}
```
