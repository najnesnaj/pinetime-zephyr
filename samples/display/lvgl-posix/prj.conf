## prj.conf
```kconfig
CONFIG_HEAP_MEM_POOL_SIZE=16384
CONFIG_MAIN_STACK_SIZE=2048

CONFIG_DISPLAY=y
CONFIG_DISPLAY_LOG_LEVEL_ERR=y

CONFIG_LOG=y
#CONFIG_ST7789V=y
CONFIG_LVGL=y
CONFIG_LVGL_USE_LABEL=y
CONFIG_LVGL_USE_CONT=y
CONFIG_LVGL_USE_BTN=y
CONFIG_LVGL_USE_THEME_MATERIAL=n
#CONFIG_ST7789V=y
CONFIG_LVGL_VDB_SIZE=2 
CONFIG_USE_SEGGER_RTT=y
CONFIG_LVGL_POINTER_KSCAN=y
#CONFIG_LVGL_FONT_MONTSERRAT_28_COMPRESSED=y
CONFIG_LVGL_FONT_UNSCII_8=n
CONFIG_LVGL_USE_THEME_MATERIAL=y
CONFIG_LVGL_THEME_DEFAULT_COLOR_PRIMARY_BLACK=y
CONFIG_LVGL_FONT_MONTSERRAT_28=y
```

## boards/native_posix_64.conf
```kconfig
CONFIG_SDL_DISPLAY_DEV_NAME="DISPLAY"
CONFIG_SDL_DISPLAY_X_RES=250
CONFIG_SDL_DISPLAY_Y_RES=120
CONFIG_KSCAN=y
CONFIG_LVGL_POINTER_KSCAN=y
CONFIG_LVGL_POINTER_KSCAN_DEV_NAME="KSCAN"
CONFIG_SDL_POINTER_KSCAN_DEV_NAME="KSCAN"
```

## src/main.c
```c
/*
 * Copyright (c) 2018 Jan Van Winkel <jan.van_winkel@dxplore.eu>
 *
 * SPDX-License-Identifier: Apache-2.0
 */

#include <device.h>
#include <drivers/display.h>
#include <lvgl.h>
#include <stdio.h>
#include <string.h>
#include <zephyr.h>

#define LOG_LEVEL CONFIG_LOG_DEFAULT_LEVEL
#include <logging/log.h>
LOG_MODULE_REGISTER(app);

void main(void)
{
	uint32_t count = 0U;
	char count_str[11] = {0};
	const struct device *display_dev;
	lv_obj_t *hello_world_label;
	lv_obj_t *count_label;

	display_dev = device_get_binding(CONFIG_LVGL_DISPLAY_DEV_NAME);

	if (display_dev == NULL) {
		LOG_ERR("device not found.  Aborting test.");
		return;
	}
 printf("Pointer\n");
		lv_obj_t *hello_world_button;
		hello_world_button = lv_btn_create(lv_scr_act(), NULL);
	if (IS_ENABLED(CONFIG_LVGL_POINTER_KSCAN)) {

		lv_obj_align(hello_world_button, NULL, LV_ALIGN_IN_TOP_MID, 0, 0);
		lv_btn_set_fit(hello_world_button, LV_FIT_TIGHT);
		hello_world_label = lv_label_create(hello_world_button, NULL);
 printf("pointer enabled\n");
		lv_label_set_text(hello_world_label, "Butt!");
	} else {
		hello_world_label = lv_label_create(lv_scr_act(), NULL);

		lv_label_set_text(hello_world_label, "Hello world!");
	}
	lv_obj_align(hello_world_label, NULL, LV_ALIGN_CENTER, 0, 0);

	count_label = lv_label_create(lv_scr_act(), NULL);
	lv_obj_align(count_label, NULL, LV_ALIGN_IN_BOTTOM_MID, 0, 0);

	lv_task_handler();
	display_blanking_off(display_dev);

	while (1) {
		if ((count % 100) == 0U) {
			sprintf(count_str, "%d", count/100U);
			lv_label_set_text(count_label, count_str);
		}
 printf("status %d\n",lv_btn_get_state(hello_world_button));
		 if (lv_btn_get_state(hello_world_button) == LV_BTN_STATE_PRESSED) {
 printf("pressed\n");
 //                       sprintf(count_str2, "pressed ");
  //                      lv_label_set_text(count_label2, count_str2);
                }
                if (lv_btn_get_state(hello_world_button) == LV_BTN_STATE_RELEASED) {
// printf("released\n");
 //                       sprintf(count_str2, "released ");
  //                      lv_label_set_text(count_label2, count_str2);
                }

		lv_task_handler();
		k_sleep(K_MSEC(100));
		++count;
	}
}
```
