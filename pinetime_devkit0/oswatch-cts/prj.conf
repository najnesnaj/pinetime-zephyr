## CMakeLists.txt
```
# SPDX-License-Identifier: Apache-2.0
#list(APPEND ZEPHYR_EXTRA_MODULES /root/zephyrproject/app/drivers/kscan2)
# SPDX-License-Identifier: Apache-2.0

cmake_minimum_required(VERSION 3.20.0)

find_package(Zephyr REQUIRED HINTS $ENV{ZEPHYR_BASE})
project(oswatch_cts)

#target_sources(app PRIVATE src/main.c)
target_sources(app PRIVATE src/main.c src/event_handler.c src/display.c)

#cmake_minimum_required(VERSION 3.13.1)
#list(APPEND ZEPHYR_EXTRA_MODULES
#  ${CMAKE_CURRENT_SOURCE_DIR}/drivers
#  )


# Add the board
#list(APPEND BOARD_ROOT ${CMAKE_CURRENT_LIST_DIR})
#list(APPEND DTS_ROOT ${CMAKE_CURRENT_LIST_DIR}/..)
#add_subdirectory(drivers/kscan2)
# Enable configurations through environment variables
#set(CONF_FILE ${CMAKE_CURRENT_LIST_DIR}/config/prj.conf ${CMAKE_CURRENT_LIST_DIR}/config/bootloader.conf)
#IF("$ENV{BOOTLOADER}" STREQUAL "off")
#  set(CONF_FILE ${CMAKE_CURRENT_LIST_DIR}/config/prj.conf)
#ENDIF()
#IF("$ENV{LOGGING}" STREQUAL "on")
#  set(CONF_FILE ${CONF_FILE} ${CMAKE_CURRENT_LIST_DIR}/config/logging_rtt.conf)
#ENDIF()

#find_package(Zephyr REQUIRED HINTS $ENV{ZEPHYR_BASE})
include_directories(include)
#project(oswatch)

#FILE(GLOB app_sources src/*.c)
#target_sources(app PRIVATE ${app_sources})

# Get current time
string(TIMESTAMP CURRENT_TIME %Y-%m-%dT%H:%M:%S)

# Get short commit hash
#execute_process(
#  COMMAND ${GIT_EXECUTABLE} describe --tags
#  WORKING_DIRECTORY ${CMAKE_CURRENT_LIST_DIR}
#  OUTPUT_VARIABLE FW_BUILD_GIT
#  OUTPUT_STRIP_TRAILING_WHITESPACE
#)
#set(CMAKE_C_FLAGS "${CMAKE_C_FLAGS} -DCURRENT_TIME_OF_BUILD=\"${CURRENT_TIME}\" -DFW_BUILD=\"${FW_BUILD_GIT}\"")
#set(ZEPHYR_BOARD_FLASH_RUNNER jlink)
```

## prj.conf
```kconfig
#CONFIG_HEAP_MEM_POOL_SIZE=16384
#CONFIG_MAIN_STACK_SIZE=2048

CONFIG_DISPLAY=y
CONFIG_DISPLAY_LOG_LEVEL_ERR=y
CONFIG_LOG=y
CONFIG_LVGL=y
#CONFIG_NEWLIB_LIBC=y


# Bluetooth
#CONFIG_BT=y
#CONFIG_BT_PERIPHERAL=y
#CONFIG_BT_GATT_DIS=y
#CONFIG_BT_ATT_PREPARE_COUNT=5
#CONFIG_BT_DEVICE_APPEARANCE=833
#CONFIG_BT_DEVICE_NAME_DYNAMIC=y
#CONFIG_BT_DEVICE_NAME_MAX=65
#CONFIG_BT_GATT_CLIENT=y
# Let DIS information be read from settings
#CONFIG_BT_SETTINGS=y
CONFIG_SETTINGS_RUNTIME=y
CONFIG_SETTINGS=y
CONFIG_SETTINGS_NONE=y
```

## boards/pinetime_devkit0.conf
```kconfig
CONFIG_ST7789V=y
#CONFIG_LVGL_FONT_MONTSERRAT_28=y
#CONFIG_LVGL_FONT_MONTSERRAT_14=n
#CONFIG_LVGL_DISPLAY_DEV_NAME="ST7789V"
CONFIG_LV_MEM_SIZE_KILOBYTES=4
#CONFIG_LVGL_USE_LABEL=y
#CONFIG_LVGL_USE_CONT=y
#CONFIG_LVGL_USE_BTN=y
#CONFIG_LVGL_USE_SLIDER=y
#CONFIG_LVGL_USE_IMG=y
#CONFIG_LVGL_USE_THEME_MATERIAL=n
#CONFIG_ST7789V=y
#CONFIG_LVGL_TXT_ENC_UTF8=y
#CONFIG_LVGL_FONT_MONTSERRAT_14=y
#CONFIG_LVGL_FONT_UNSCII_8=n
#CONFIG_LVGL_VDB_SIZE=64
#CONFIG_LVGL_VDB_SIZE=6
CONFIG_USE_SEGGER_RTT=y
#CONFIG_LVGL_USE_THEME_MONO=y
#CONFIG_LVGL_THEME_DEFAULT_COLOR_PRIMARY_WHITE=y
#CONFIG_LVGL_THEME_DEFAULT_COLOR_SECONDARY_BLACK=y
# Time functions
#CONFIG_NEWLIB_LIBC=y
#CONFIG_LVGL_POINTER_KSCAN=y
#CONFIG_BT_DEVICE_NAME="pinetime_devkit0"
```

## src/main.c
```c
/*

 * Copyright (c) 2021 <najnesnaj@yahoo.com>
 *
 * SPDX-License-Identifier: Apache-2.0
 */

#include <zephyr/device.h>
#include <zephyr/drivers/display.h>
#include <zephyr/drivers/gpio.h>
#include <lvgl.h>
#include <stdio.h>
#include <string.h>
//#include <zephyr/zephyr.h>
#include <zephyr/kernel.h>
//#include "bt.h"

#include "clock.h"
#include "log.h"
#include "display.h"

#include "event_handler.h"
int main(void)
{
#if !(defined(CONFIG_BOARD_NATIVE_POSIX_64BIT)) //both the pinetime & ds_d6 have a real button 
	{
		init_button();
	}
#endif
	display_init();
//	clock_init();
//	event_handler_init();
//        bt_init();
	while (1) {
//		lv_task_handler();
		k_sleep(K_MSEC(100));
	}
	return 0;
}
```

## src/bt.c
```c
/*
 * Copyright (c) 2012-2014 Wind River Systems, Inc.
 * Copyright (c) 2015-2016 Intel Corporation
 * Copyright (c) 2020 Endian Technologies AB
 * Copyright (c) 2020 max00
 * Copyright (c) 2020 Prevas A/S
 * Copyright (c) 2021 najnesnaj@yahoo.com 
 * 
 * SPDX-License-Identifier: Apache-2.0
 */

#include <zephyr/types.h>
#include <stddef.h>
#include <stdbool.h>
#include <string.h>
#include <sys/byteorder.h>
#include <zephyr.h>

#include <settings/settings.h>

#include <bluetooth/bluetooth.h>
#include <bluetooth/hci.h>
#include <bluetooth/conn.h>
#include <bluetooth/uuid.h>
#include <bluetooth/gatt.h>

#ifdef CONFIG_MCUMGR
#include <mgmt/smp_bt.h>
#endif

#include "cts_sync.h"
#include "gfx.h"
#include "log.h"
#include "version.h"
#include "clock.h" //clock_show_time
#include "display.h"
/* ********** Function prototypes ********** */
static void connected(struct bt_conn *conn, uint8_t err);
static void disconnected(struct bt_conn *conn, uint8_t reason);
static bool le_param_req(struct bt_conn *conn, struct bt_le_conn_param *param);
static void le_param_updated(struct bt_conn *conn, uint16_t interval, uint16_t latency, uint16_t timeout);

/* ********** Variables ********** */

static struct k_work advertise_work;

static const struct bt_data ad[] = {
	BT_DATA_BYTES(BT_DATA_FLAGS, (BT_LE_AD_GENERAL | BT_LE_AD_NO_BREDR)),
	/* Device information */
	BT_DATA_BYTES(BT_DATA_UUID16_ALL,
		      0x0a, 0x18),
	/* Current time */
	BT_DATA_BYTES(BT_DATA_UUID16_ALL,
		      0x05, 0x18),
#ifdef CONFIG_MCUMGR
	/* SMP */
	BT_DATA_BYTES(BT_DATA_UUID128_ALL,
		      0x84, 0xaa, 0x60, 0x74, 0x52, 0x8a, 0x8b, 0x86,
		      0xd3, 0x4c, 0xb7, 0x1d, 0x1d, 0xdc, 0x53, 0x8d),
#endif
};

static struct bt_conn_cb m_conn_callbacks = {
	.connected = connected,
	.disconnected = disconnected,
	.le_param_req = le_param_req,
	.le_param_updated = le_param_updated
};

static struct bt_le_adv_param param = BT_LE_ADV_PARAM_INIT(
	BT_LE_ADV_OPT_CONNECTABLE | BT_LE_ADV_OPT_USE_NAME,
	BT_GAP_ADV_SLOW_INT_MIN,
	BT_GAP_ADV_SLOW_INT_MAX,
	NULL
);

/* ********** Functions ********** */
static int settings_runtime_load(void)
{/*
#if defined(CONFIG_BOARD_PINETIME)
	settings_runtime_set("bt/dis/model",
			     "PineTime",
			     sizeof("PineTime"));
	settings_runtime_set("bt/dis/manuf",
			     "PINE64",
			     sizeof("PINE64"));
	settings_runtime_set("bt/dis/hw",
			     "1.0a",
			     sizeof("1.0a"));
#endif
#if defined(CONFIG_BOARD_P8)
	settings_runtime_set("bt/dis/model",
			     "P8",
			     sizeof("P8"));
	settings_runtime_set("bt/dis/manuf",
			     "Colmi",
			     sizeof("Colmi"));
#endif
#if defined(CONFIG_BOARD_DS_D6)
	settings_runtime_set("bt/dis/model",
			     "ds_d6",
			     sizeof("ds_d6"));
	settings_runtime_set("bt/dis/manuf",
			     "Desay",
			     sizeof("desay"));
#endif
#if defined(CONFIG_BOARD_NATIVE_POSIX_64)
	settings_runtime_set("bt/dis/model",
			     "posix_64",
			     sizeof("posix_64"));
	settings_runtime_set("bt/dis/manuf",
			     "Native",
			     sizeof("Native"));
#endif
	*/
	settings_runtime_set("bt/dis/sw",
			     CONFIG_BT_DEVICE_NAME,
			     sizeof(CONFIG_BT_DEVICE_NAME));
	settings_runtime_set("bt/dis/fw",
			     FW_VERSION,
			     sizeof(FW_VERSION));
	return 0;
}

static void advertise(struct k_work *work)
{
	int rc;

	bt_le_adv_stop();

	rc = bt_le_adv_start(&param, ad, ARRAY_SIZE(ad), NULL, 0);
	if (rc) {
		LOG_ERR("Advertising failed to start (rc %d)", rc);
		return;
	}

	LOG_INF("Advertising successfully started");
}

static void connected(struct bt_conn *conn, uint8_t err)
{
	printk("test\n");
	if (err) {
		return;
	}
	LOG_INF("connected");
	cts_sync_enable(true);
	display_connect_event();
	//delay of some sort    todo jj
	clock_show_time();
}

static void disconnected(struct bt_conn *conn, uint8_t reason)
{
	LOG_INF("disconnected (reason: %u)", reason);
	cts_sync_enable(false);
	display_disconnect_event(); //shows first screen
	//display_set_bluetooth_disconnected(); //bt-symbol is displayed -- readability is not top...
	//gfx_bt_set_label(BT_ADVERTISING_ON);
	//gfx_update();
}

static bool le_param_req(struct bt_conn *conn, struct bt_le_conn_param *param)
{
	return true;
}

static void le_param_updated(struct bt_conn *conn, uint16_t interval, uint16_t latency, uint16_t timeout)
{

}

void bt_init(void)
{
	int err = bt_enable(NULL);
	if (err) {
		LOG_ERR("Bluetooth init failed (err %d)", err);
		return;
	}

	settings_load();
	settings_runtime_load();

	k_work_init(&advertise_work, advertise);
	bt_conn_cb_register(&m_conn_callbacks);
		LOG_INF("bt init callback started\n");

	k_work_submit(&advertise_work);
#ifdef CONFIG_MCUMGR
	/* Initialize the Bluetooth mcumgr transport. */
	smp_bt_register();
#endif
	cts_sync_init();

	LOG_INF("Bluetooth initialized"); //jj
	LOG_DBG("Bluetooth initialized");
}

void bt_adv_stop(void)
{
	k_sleep(K_MSEC(400));

	int err = bt_le_adv_stop();
	if (err) {
		LOG_ERR("Advertising failed to stop (err %d)", err);
		return;
	}
}
```

## src/cts_sync.c
```c
/*
 * Copyright (c) 2020 Dejvino
 * Copyright (c) 2020 Endian Technologies AB
 * Copyright (c) 2020 max00
 * Copyright (c) 2021 Najnesnaj 
 *
 * SPDX-License-Identifier: Apache-2.0
 */

#include <bluetooth/bluetooth.h>
#include <bluetooth/hci.h>
#include <bluetooth/conn.h>
#include <bluetooth/uuid.h>
#include <bluetooth/gatt.h>
#include <zephyr/types.h>
#include <time.h>
#include "log.h"
#include "cts_sync.h"
#include "clock.h"

/* ********** Definitions ********** */
#define CTS_SYNC_INTERVAL K_SECONDS(60)

/* ********** Function prototypes ********** */
static void cts_sync_timer_timeout_handler(struct k_timer *);
static void cts_sync_processor(struct bt_conn *, void *);

/* ********** Variables ********** */
static struct k_timer m_cts_sync_timer;
static struct bt_gatt_discover_params cts_discovery_params;
static struct bt_uuid_16 uuid = BT_UUID_INIT_16(0);
static struct bt_gatt_read_params read_params;
cts_datetime_t clock_datetime;
static struct {
	int offset;
	cts_datetime_t datetime;
} m_read_buf;

/* ********** Functions ********** */
void cts_sync_init()
{
	LOG_INF("CTS sync init\n");
	k_timer_init(&m_cts_sync_timer, cts_sync_timer_timeout_handler, NULL);
}

void cts_sync_enable(bool enable)
{
	if (enable) {
		k_timer_start(&m_cts_sync_timer, K_NO_WAIT, CTS_SYNC_INTERVAL);
	} else {
		k_timer_stop(&m_cts_sync_timer);
	}
}

static void sync_cts_to_clock(cts_datetime_t* cts_datetime)
{
	if (cts_datetime->year + cts_datetime->day + cts_datetime->hours
	    + cts_datetime->minutes + cts_datetime->seconds == 0) {
		LOG_WRN("Ignoring suspicious time data from companion application.");
		return;
	}

	LOG_INF("CTS sync to clock started.\n Y%04d D%03d T%2d:%2d:%2d",
		cts_datetime->year, cts_datetime->day,
		cts_datetime->hours, cts_datetime->minutes, cts_datetime->seconds);

	memcpy(&clock_datetime, cts_datetime, sizeof(clock_datetime));
	clock_sync_time(cts_datetime);
	LOG_INF("CTS sync to clock complete.");
}

void cts_update_datetime(struct tm *t)
{
	t->tm_year = clock_datetime.year -1900;
	t->tm_mon = clock_datetime.month -1;
	t->tm_mday = clock_datetime.day;
	t->tm_hour = clock_datetime.hours;
	t->tm_min = clock_datetime.minutes;
	t->tm_sec = clock_datetime.seconds;
}

static void cts_sync_timer_timeout_handler(struct k_timer *tmr)
{
	bt_conn_foreach(BT_CONN_TYPE_LE, cts_sync_processor, NULL);
}

uint8_t cts_sync_read(struct bt_conn *conn, uint8_t err,
				    struct bt_gatt_read_params *params,
				    //const void *data, u16_t length)
				    const void *data, uint16_t length)
{
	LOG_INF("Reading CCC data: err %d, %d bytes, offset %d.", err, length, m_read_buf.offset);

	if (!data || length <= 0) {
		sync_cts_to_clock(&m_read_buf.datetime);
		return BT_GATT_ITER_STOP;
	}

	memcpy(&m_read_buf.datetime + m_read_buf.offset, data, length);
	m_read_buf.offset += length;

	return BT_GATT_ITER_CONTINUE;
}

uint8_t cts_sync_service_discovered(struct bt_conn* conn, const struct bt_gatt_attr* attr,
        struct bt_gatt_discover_params* params)
{
	if (!attr) {
		LOG_INF("CTS Service Discovery completed");
		return BT_GATT_ITER_STOP;
	}
	LOG_INF("Discovered attribute, handle: %u", attr->handle);

	memset(&read_params, 0, sizeof(read_params));
	read_params.func = cts_sync_read;
	read_params.by_uuid.uuid = (struct bt_uuid *) &uuid;
	read_params.by_uuid.start_handle = attr->handle;
	read_params.by_uuid.end_handle = 0xffff;
	m_read_buf.offset = 0;
	if (bt_gatt_read(conn, &read_params) < 0) {
		LOG_DBG("Could not initiate read of CCC data.");
	}

	return BT_GATT_ITER_STOP;
}

static void cts_sync_processor(struct bt_conn *conn, void *data)
{
	memcpy(&uuid, BT_UUID_CTS_CURRENT_TIME, sizeof(uuid));
	cts_discovery_params.func = cts_sync_service_discovered;
	cts_discovery_params.start_handle = 0x0001;
	cts_discovery_params.end_handle = 0xFFFF;
	cts_discovery_params.type = BT_GATT_DISCOVER_CHARACTERISTIC;
	cts_discovery_params.uuid = (struct bt_uuid *) &uuid;

	if (bt_gatt_discover(conn, &cts_discovery_params) != 0) {
		LOG_ERR("CTS Sync > GATT discovery FAILED.");
	}
}
```

## src/display.c
```c
/*
 * Copyright (c) 2021 <najnesnaj@yahoo.com>
 *
 * SPDX-License-Identifier: Apache-2.0
 */

#include <zephyr/device.h>
#include <zephyr/drivers/display.h>
#include <zephyr/drivers/gpio.h>
#include <lvgl.h>
#include <stdio.h>
#include <string.h>
//#include <zephyr.h>
#include <zephyr/kernel.h>

#include "display.h"
#include "buttons.h"
#include "clock.h"
#include "event_handler.h"
#include <zephyr/logging/log.h>
LOG_MODULE_REGISTER(display, 3);

const static struct device * display_dev;

#define SCREEN_ID_0    0
#define SCREEN_ID_1    1
#define SCREEN_ID_2    2
#define SCREEN_ID_3    3
//#define SCREEN_COUNT   4 //last screen reserved for bt connect event
#define SCREEN_COUNT   3


#define PARAM_TOTAL 6 //total number of parameters


char * param_label[] = {
        "temp1",
        "timer1",
        "temp2",
        "timer2",
        "temp3",
        "timer3"
};

int param[6]={10,20,30,40,50,60};





enum battery_symbol {
        BAT_CHARGE,
        BAT_FULL,
        BAT_3,
        BAT_2,
        BAT_1,
        BAT_EMPTY
};

/*

void display_timer_handler(struct k_timer * timer);
void display_task_handler(struct k_work * work);

K_TIMER_DEFINE(display_timer, display_timer_handler, NULL);

K_WORK_DEFINE(display_work, display_task_handler);

#define TICK_PERIOD   (10)

void display_task_handler(struct k_work * work)
{
	lv_tick_inc(TICK_PERIOD);
	lv_task_handler();
}

void display_timer_handler(struct k_timer * timer)
{
	k_work_submit(&display_work);
}

*/

typedef struct {
	lv_obj_t * screen;
	int        count;
} screens_t;

/*---------------------------------------------------------------------------*/

static lv_obj_t   * button_obj;
static lv_obj_t   * screen0_label0_obj;
static lv_obj_t *time_label;
static lv_obj_t *date_label;
static lv_obj_t *title_label;
static lv_obj_t *battery_label;
static lv_obj_t *date_label;




static lv_obj_t   * screen1_label0_obj; 
static lv_obj_t   * screen1_label1_obj; 

//static lv_obj_t   * screen2_label0_obj; 
static lv_obj_t   * screen2_label1_obj; 
static lv_obj_t   * screen2_label2_obj; 

static screens_t screens [] = {
	{ .screen = NULL, .count = 1 },
	{ .screen = NULL, .count = 2 },
	{ .screen = NULL, .count = 3 },
	{ .screen = NULL, .count = 0 },
};
#define SCREENS_COUNT (sizeof(screens)/sizeof(screens[0]))

/*---------------------------------------------------------------------------*/
/*                                                                           */
/*---------------------------------------------------------------------------*/
void display_time_set_label(char *str)
{
	lv_label_set_text(time_label, str);
}
void display_date_set_label(char *str)
{
	lv_label_set_text(date_label, str);
}


//parameters are displayed on screen2
void display_label()
{
        //screen2_label1_obj=lv_label_create(lv_scr_act(), NULL);
        screen2_label1_obj=lv_label_create(lv_scr_act());
        //lv_obj_align(screen2_label1_obj, lv_scr_act(), LV_ALIGN_IN_TOP_LEFT, 0, 0);
        lv_obj_align(screen2_label1_obj,  LV_ALIGN_TOP_LEFT, 0, 0);
        //screen2_label2_obj=lv_label_create(lv_scr_act(), NULL);
        screen2_label2_obj=lv_label_create(lv_scr_act());
        //lv_obj_align(screen2_label2_obj, lv_scr_act(), LV_ALIGN_IN_TOP_RIGHT, 0, 0);
        lv_obj_align(screen2_label2_obj, LV_ALIGN_TOP_RIGHT, 0, 0);
}


void show_label(int parnr)
{
        char snum[5];
        sprintf(snum, "%d",param[parnr]);
        lv_label_set_text(screen2_label1_obj, param_label[parnr]);
        lv_label_set_text(screen2_label2_obj, snum);
}







void display_clock_update() // jj the clock apears in the first screen only 
{
             //                                   lv_scr_load(screens[0].screen);



}

/*---------------------------------------------------------------------------*/
/*        todo                                                               */
/*        kscan_touch works for pinetime                                     */
/*        have not found a way to do this out of tree                        */
/*        some minor modification of the focaltech driver is needed          */
/*---------------------------------------------------------------------------*/
/*
#if defined(CONFIG_LVGL_POINTER_KSCAN) 


static void button_event_cb(lv_obj_t * obj, lv_event_t event)
{
	static int screen_id = 0;  // init to first screen id
	static int param_id  = 0;  // init to first parameter index

	switch(event) {
		case LV_EVENT_PRESSED:
			break; 
		case LV_EVENT_SHORT_CLICKED:
			LOG_INF("Short clicked\n");
			break;

		case LV_EVENT_CLICKED:
			clock_increment_local_time();

			LOG_INF("Clicked\n");
			break;

		case LV_EVENT_LONG_PRESSED:
			clock_increment_local_time();
			clock_show_time();
			LOG_INF("Long press\n");
			break;

		case LV_EVENT_LONG_PRESSED_REPEAT:

			//this can be configured in menuconfig 
			//standard value < long_pressed
						screen_id++;
						if (screen_id >= SCREEN_COUNT)
						screen_id = 0;
						lv_scr_load(screens[screen_id].screen);
						param_id = 0;
						LOG_INF("BTN1: screen_id(%d)", screen_id);
			//   handle_button_event();



			LOG_INF("Long press repeat\n");
			break;

		case LV_EVENT_RELEASED:
			LOG_INF("Released\n");
			break;
	}

}
#endif
*/

/*---------------------------------------------------------------------------*/
/*                                                                           */
/*---------------------------------------------------------------------------*/
//todo if no touch screen define real button ds_d6




void display_battery(enum battery_symbol s)
{
        switch (s) {
                case BAT_CHARGE:
                        lv_label_set_text(battery_label, LV_SYMBOL_CHARGE);
                        break;
                case BAT_FULL:
                        lv_label_set_text(battery_label, LV_SYMBOL_BATTERY_FULL);
                        break;
                case BAT_3:
                        lv_label_set_text(battery_label, LV_SYMBOL_BATTERY_3);
                        break;
                case BAT_2:
                        lv_label_set_text(battery_label, LV_SYMBOL_BATTERY_2);
                        break;
                case BAT_1:
                        lv_label_set_text(battery_label, LV_SYMBOL_BATTERY_1);
                        break;
                default:
                        lv_label_set_text(battery_label, LV_SYMBOL_BATTERY_EMPTY);
        }
}






void display_button()
{
	/* the ds_d6 has a real button and no touchscreen, so no need for lvgl-button */
#if defined(CONFIG_LVGL_POINTER_KSCAN)
//#if defined(CONFIG_BOARD_NATIVE_POSIX_64BIT)
	button_obj = lv_btn_create(lv_scr_act(), NULL);
	lv_obj_set_width(button_obj, 5);
	lv_obj_set_height(button_obj, 5);
	//lv_obj_align(button_obj, NULL, LV_ALIGN_CENTER, 128, 0);
	//lv_obj_align(button_obj, NULL, LV_ALIGN_IN_RIGHT_MID, 0, 0);
	//lv_obj_align(button_obj, NULL, LV_ALIGN_RIGHT_MID, 0, 0);
	lv_obj_align(button_obj, LV_ALIGN_RIGHT_MID, 0, 0);
	lv_btn_set_fit(button_obj, LV_FIT_TIGHT);
	//screen0_label0_obj = lv_label_create(button_obj, NULL);
	screen0_label0_obj = lv_label_create(button_obj);
	lv_label_set_text(screen0_label0_obj, "O"); //substitute for real switch on physical watch
	lv_obj_set_event_cb(button_obj, button_event_cb);
#endif

}

void display_connect_event()
{
//      LOG_INF("display_connect_event");
        lv_scr_load(screens[3].screen); //display the CTS screen
//      lv_task_handler();//jj

}

void display_disconnect_event()
{
        lv_scr_load(screens[0].screen); //display the first screen
}





void display_btn_event(buttons_id_t btn_id)
{
	static int screen_id = 0;  // init to first screen id
	static int param_id  = 0;  // init to first parameter index

	//LOG_INF("%s: BTN%d", __func__, btn_id);

	switch (btn_id) {

		case BTN1_LONG:
			screen_id++;
			if (screen_id >= SCREEN_COUNT)
				screen_id = 0;
			lv_scr_load(screens[screen_id].screen);
			param_id = 0;
			LOG_INF("BTN1: screen_id(%d)", screen_id);
			break;

		case BTN1_SHORT:
			param_id++;
			if (param_id >= PARAM_TOTAL)  param_id = 0;
			show_label(param_id);
	//		if (param_id < 0)                          param_id = 0;
			LOG_INF("BTN2: screen_id(%d) param_id(%d)", screen_id, param_id);
			break;


		default:
			break;
	}
}

/*---------------------------------------------------------------------------*/
/*                                                                           */
/*---------------------------------------------------------------------------*/
void display_screens_init(void)
{
	//screens[0].screen = lv_obj_create(NULL, NULL);
	screens[0].screen = lv_obj_create(NULL);
	//screens[1].screen = lv_obj_create(NULL, NULL);
	screens[1].screen = lv_obj_create(NULL);
	//screens[2].screen = lv_obj_create(NULL, NULL);
	screens[2].screen = lv_obj_create(NULL);
	//screens[3].screen = lv_obj_create(NULL, NULL);
	screens[3].screen = lv_obj_create(NULL);

	// lv_theme_t * mono = lv_theme_mono_init(0, NULL);
	// lv_theme_set_current(mono);

	/*
	 *  build basic screen0
	 */
	lv_scr_load(screens[0].screen);
	//lv_obj_t * screen0_label = lv_label_create(lv_scr_act(), NULL);
	lv_obj_t * screen0_label = lv_label_create(lv_scr_act());
	lv_label_set_text(screen0_label, "Pg1");
	//lv_obj_align(screen0_label, screens[0].screen, LV_ALIGN_IN_TOP_RIGHT, 0, 0);
	//lv_obj_align(screen0_label, screens[0].screen, LV_ALIGN_TOP_RIGHT, 0, 0);
	lv_obj_align(screen0_label,  LV_ALIGN_TOP_RIGHT, 0, 0);
	/* the ds_d6 has a real button and no touchscreen, so no need for lvgl-button */
	display_button();

	/* Time label */
	//time_label = lv_label_create(lv_scr_act(), NULL);
	time_label = lv_label_create(lv_scr_act());
	//lv_obj_align(time_label, NULL, LV_ALIGN_IN_TOP_MID, 0, 0); //jj
	//lv_obj_align(time_label, NULL, LV_ALIGN_TOP_MID, 0, 0); //jj
	lv_obj_align(time_label, LV_ALIGN_TOP_MID, 0, 0); //jj
	lv_label_set_text(time_label, "00:00");
	/* Date label */
	//date_label = lv_label_create(lv_scr_act(), NULL);
	date_label = lv_label_create(lv_scr_act());
	//lv_obj_align(date_label, NULL, LV_ALIGN_IN_BOTTOM_MID, 0, 0);
	//lv_obj_align(date_label, NULL, LV_ALIGN_BOTTOM_MID, 0, 0);
	lv_obj_align(date_label,  LV_ALIGN_BOTTOM_MID, 0, 0);
	lv_label_set_text(date_label, "Mon 10 Jan");

	/* title label */
	//title_label = lv_label_create(lv_scr_act(), NULL);
	title_label = lv_label_create(lv_scr_act());
	//lv_obj_align(title_label, NULL, LV_ALIGN_IN_TOP_LEFT, 0, 0);
	//lv_obj_align(title_label, NULL, LV_ALIGN_TOP_LEFT, 0, 0);
	lv_obj_align(title_label,  LV_ALIGN_TOP_LEFT, 0, 0);
	//lv_label_set_text(title_label, LV_SYMBOL_BLUETOOTH"symb");
	//lv_label_set_text(title_label, LV_SYMBOL_BLUETOOTH);
	lv_label_set_text(title_label, LV_SYMBOL_WIFI);

	/* Battery label */
	//display_battery(3);
	//battery_label = lv_label_create(lv_scr_act(), NULL);
	battery_label = lv_label_create(lv_scr_act());
	display_battery(BAT_3); //todo just demo value -- need real level
	//lv_label_set_text(battery_label, LV_SYMBOL_BATTERY_2);
        //lv_obj_align(battery_label, NULL, LV_ALIGN_IN_BOTTOM_LEFT, 0, 0);
        //lv_obj_align(battery_label, NULL, LV_ALIGN_BOTTOM_LEFT, 0, 0);
        lv_obj_align(battery_label, LV_ALIGN_BOTTOM_LEFT, 0, 0);

	//battery_label = lv_label_create(lv_scr_act(), NULL);
	//lv_obj_align(battery_label, NULL, LV_ALIGN_IN_TOP_MID, 0, 0);
	//lv_label_set_text(battery_label, LV_SYMBOL_BATTERY_EMPTY);


	//	lv_obj_t * mask = lv_img_create(lv_scr_act(), NULL);
	//	lv_img_set_src(mask, &mask);
	//	lv_obj_align(mask, NULL, LV_ALIGN_CENTER, 0, 0);


	//  hello_world_label = lv_label_create(hello_world_button, NULL);
	// printf("pointer enabled\n");
	// lv_label_set_text(hello_world_label, "O"); //substitute for real switch on physical watch
	//screen0_slider_obj = lv_slider_create(lv_scr_act(), NULL);
	//lv_obj_set_height(screen0_slider_obj, 10);
	//lv_obj_set_width(screen0_slider_obj, 110);
	//lv_obj_align(screen0_slider_obj, NULL, LV_ALIGN_CENTER, 0, 0);
	//lv_slider_set_value(screen0_slider_obj, 15, LV_ANIM_ON);
	//screen0_slider_value = 15;

	/*
	 *  build basic screen1
	 */
	lv_scr_load(screens[1].screen);
	//lv_obj_t * screen1_page = lv_label_create(lv_scr_act(), NULL);
	lv_obj_t * screen1_page = lv_label_create(lv_scr_act());
	lv_label_set_text(screen1_page, "Pg2");
	//lv_obj_align(screen1_page, screens[1].screen, LV_ALIGN_IN_TOP_RIGHT, 0, 0);
	//lv_obj_align(screen1_page, screens[1].screen, LV_ALIGN_TOP_RIGHT, 0, 0);
	//lv_obj_align(screen1_page, screens[1].screen, LV_ALIGN_TOP_RIGHT, 0, 0);
	lv_obj_align(screen1_page,  LV_ALIGN_TOP_RIGHT, 0, 0);

	// to avoid creating the same button all over again jj
	display_button();

	//screen1_label0_obj = lv_label_create(lv_scr_act(), NULL);
	screen1_label0_obj = lv_label_create(lv_scr_act());
	lv_label_set_text(screen1_label0_obj, "0");
	//lv_obj_align(screen1_label0_obj, screens[1].screen, LV_ALIGN_IN_BOTTOM_LEFT, 5, -5);
	//lv_obj_align(screen1_label0_obj, screens[1].screen, LV_ALIGN_BOTTOM_LEFT, 5, -5);
	lv_obj_align(screen1_label0_obj,  LV_ALIGN_BOTTOM_LEFT, 5, -5);

	//screen1_label1_obj = lv_label_create(lv_scr_act(), NULL);
	screen1_label1_obj = lv_label_create(lv_scr_act());
	lv_label_set_text(screen1_label1_obj, "0");
	//lv_obj_align(screen1_label1_obj, screens[1].screen, LV_ALIGN_IN_BOTTOM_RIGHT, -15, -5);
	//lv_obj_align(screen1_label1_obj, screens[1].screen, LV_ALIGN_BOTTOM_RIGHT, -15, -5);
	lv_obj_align(screen1_label1_obj, LV_ALIGN_BOTTOM_RIGHT, -15, -5);

	//	lv_obj_t * icon_1 = lv_img_create(lv_scr_act(), NULL);
	//	lv_img_set_src(icon_1, &icon1);
	//	lv_obj_align(icon_1, NULL, LV_ALIGN_CENTER, 0, 0);

	/*
	 *  build basic screen2
	 */
	lv_scr_load(screens[2].screen);
	//lv_obj_t * screen2_page = lv_label_create(lv_scr_act(), NULL);
	lv_obj_t * screen2_page = lv_label_create(lv_scr_act());
	lv_label_set_text(screen2_page, "Pg3");
	//lv_obj_align(screen2_page, screens[2].screen, LV_ALIGN_IN_BOTTOM_LEFT, 0, 0);
	//lv_obj_align(screen2_page, screens[2].screen, LV_ALIGN_BOTTOM_LEFT, 0, 0);
	lv_obj_align(screen2_page,  LV_ALIGN_BOTTOM_LEFT, 0, 0);
	// why define the same button all over again? jj
	display_button();
        display_label(); //parameters on screen 2
	show_label(1); //show first parameters on list --short click to scroll
	//
//	lv_obj_t * screen2_label0_tag = lv_label_create(lv_scr_act(), NULL);
//	lv_label_set_text(screen2_label0_tag, "value-0");
//	lv_obj_align(screen2_label0_tag, screens[2].screen, LV_ALIGN_IN_TOP_RIGHT, -70, 2);

//	screen2_label0_obj = lv_label_create(lv_scr_act(), NULL);
//	lv_label_set_text(screen2_label0_obj, "0");
//	lv_obj_align(screen2_label0_obj, screens[2].screen, LV_ALIGN_IN_TOP_RIGHT, -45, 2);

	//
//	lv_obj_t * screen2_label1_tag = lv_label_create(lv_scr_act(), NULL);
//	lv_label_set_text(screen2_label1_tag, "value-1");
//	lv_obj_align(screen2_label1_tag, screens[2].screen, LV_ALIGN_IN_RIGHT_MID, -70, 0);

//	screen2_label1_obj = lv_label_create(lv_scr_act(), NULL);
//	lv_label_set_text(screen2_label1_obj, "0");
//	lv_obj_align(screen2_label1_obj, screens[2].screen, LV_ALIGN_IN_RIGHT_MID, -45, 0);

	//
//	lv_obj_t * screen2_value2_tag = lv_label_create(lv_scr_act(), NULL);
//	lv_label_set_text(screen2_value2_tag, "value-2");
//	lv_obj_align(screen2_value2_tag, screens[2].screen, LV_ALIGN_IN_BOTTOM_RIGHT, -70, -2);

//	screen2_label2_obj = lv_label_create(lv_scr_act(), NULL);
//	lv_label_set_text(screen2_label2_obj, "0");
//	lv_obj_align(screen2_label2_obj, screens[2].screen, LV_ALIGN_IN_BOTTOM_RIGHT, -45, -2);

	//#if 0
	//	lv_obj_t * icon_2 = lv_img_create(lv_scr_act(), NULL);
	//	lv_img_set_src(icon_2, &icon2);
	//#endif

	/*
	 *  build basic screen3
	 */
	lv_scr_load(screens[3].screen);
	//lv_obj_t * screen3_page = lv_label_create(lv_scr_act(), NULL);
	lv_obj_t * screen3_page = lv_label_create(lv_scr_act());
	lv_label_set_text(screen3_page, "BT");
	//lv_obj_align(screen3_page, screens[3].screen, LV_ALIGN_IN_TOP_RIGHT, 0, 0);
	//lv_obj_align(screen3_page, screens[3].screen, LV_ALIGN_TOP_RIGHT, 0, 0);
	lv_obj_align(screen3_page,  LV_ALIGN_TOP_RIGHT, 0, 0);
        /* Bluetooth label */
        //title_label = lv_label_create(lv_scr_act(), NULL);
        title_label = lv_label_create(lv_scr_act());
        //lv_obj_align(title_label, NULL, LV_ALIGN_IN_TOP_LEFT, 0, 0);
        //lv_obj_align(title_label, NULL, LV_ALIGN_TOP_LEFT, 0, 0);
        lv_obj_align(title_label, LV_ALIGN_TOP_LEFT, 0, 0);
        lv_label_set_text(title_label, LV_SYMBOL_BLUETOOTH);

	// why define the same button all over again? jj
	display_button();

	//	lv_obj_t * icon_3 = lv_img_create(lv_scr_act(), NULL);
	//	lv_img_set_src(icon_3, &icon3);
	//	lv_obj_align(icon_3, NULL, LV_ALIGN_CENTER, 0, 0);
}

/*---------------------------------------------------------------------------*/
/*                                                                           */
/*---------------------------------------------------------------------------*/
#if defined(CONFIG_BOARD_PINETIME_DEVKIT0)

//TODO this is backlighting mid, might be necessary to set to led2 = high
//#define LED0_NODE DT_ALIAS(led1)
/* Locate led0 as alias or label by that name */
#if DT_NODE_EXISTS(DT_ALIAS(led0))
#define LED0 DT_ALIAS(led0)
#elif DT_NODE_EXISTS(DT_NODELABEL(led0))
#define LED0 DT_NODELABEL(led0)
#else
#define LED0 DT_INVALID_NODE
#endif




//#if DT_NODE_HAS_STATUS(LED0_NODE, okay)
//#define LED0    DT_GPIO_LABEL(LED0_NODE, gpios)
//#define PIN     DT_GPIO_PIN(LED0_NODE, gpios)
//#define FLAGS   DT_GPIO_FLAGS(LED0_NODE, gpios)
//#endif

#if DT_NODE_EXISTS(LED0)
#define LED0_DEV DT_PHANDLE(LED0, gpios)
#define LED0_PIN DT_PHA(LED0, gpios, pin)
#define LED0_FLAGS DT_PHA(LED0, gpios, flags)
#else
#define LED0 DT_INVALID_NODE
#endif

static const struct device *const led_dev = DEVICE_DT_GET(LED0_DEV);
//#endif /* LED0 */
	
#endif /* PINETIME_DEVKIT0 */

static void backlight_switch(bool enable)
{
#if defined(CONFIG_BOARD_PINETIME_DEVKIT0)

	const struct device *dev;

	//dev = device_get_binding(LED0);
//	dev = DEVICE_DT_GET(LED0_DEV);
	//dev = device_get_binding(LED0);
	/* If you have a backlight, set it up and turn it on here */
	gpio_pin_configure(dev, LED0_PIN, GPIO_OUTPUT_ACTIVE | LED0_FLAGS);
	//   gpio_pin_configure(dev, LED, GPIO_DIR_OUT);
	if (enable==true) 
	gpio_pin_set(dev, LED0_PIN, 1);
	else
	gpio_pin_set(dev, LED0_PIN, 0);
	//gpio_pin_write(dev, LED, 0);
#endif
}




int display_init(void)
{
//#if defined(CONFIG_BOARD_PINETIME_DEVKIT0)
	backlight_switch(true); //jj check which board has backlight is done in procedure
//#endif
//	display_dev = device_get_binding(CONFIG_LVGL_DISPLAY_DEV_NAME);
        display_dev = DEVICE_DT_GET(DT_CHOSEN(zephyr_display));
        if (!device_is_ready(display_dev)) {
                LOG_ERR("Device not ready, aborting test");
                return 0;
        }
//	if (display_dev == NULL) {
//		LOG_ERR("device not found. %s", CONFIG_LVGL_DISPLAY_DEV_NAME);
//		return -1;
//	}

	//lv_init();

	display_screens_init();

	/*
	 *  First screen will be screen1
	 */
	lv_scr_load(screens[0].screen);

	/*
	 *  Turn on display
	 */
	lv_task_handler();//jj
	display_blanking_off(display_dev);

	/* 
	 * Register for button press notifications.
	 */
	//buttons_register_notify_handler(display_btn_event);

	/*
	 *  Start task handler timer loop
	 */
//	k_timer_start(&display_timer, K_MSEC(TICK_PERIOD), K_MSEC(TICK_PERIOD));

	return 0;
};
```

## src/event_handler.c
```c
/*
 * Copyright (c) 2023 najnesnaj@yahoo.com
 *
 * SPDX-License-Identifier: Apache-2.0
 */

//#include <zephyr/zephyr.h>
#include <zephyr/kernel.h>
#include <zephyr/drivers/gpio.h>
#include <zephyr/drivers/sensor.h>
#include <stdbool.h>
//#include "battery.h"
#include "bt.h"
#include "clock.h"
//#include "display.h"
#include "event_handler.h"
#include "log.h"
#include "buttons.h"

/* ********** defines ********** */
#define BAT_CHA 2 //jj
#define BTN_PORT DT_GPIO_LABEL(DT_ALIAS(sw0), gpios)
#define BTN_IN  DT_GPIO_PIN(DT_ALIAS(sw0), gpios)
#define BTN_OUT 3 //jj 
#define EDGE    (GPIO_INT_EDGE | GPIO_INT_DOUBLE_EDGE)
#define PULL_UP DT_GPIO_FLAGS(DT_ALIAS(sw0), gpios)
#define DISPLAY_TIMEOUT K_SECONDS(500) //jj suppose you leave display on -- time should be updated
#define CLOCK_UPDATE K_SECONDS(20) //jj every minute clock should get update 
/* ********** ******* ********** */

/* ********** variables ********** */
static struct k_timer clock_update_timer; //jj

/* ********** ******* ********** */
/* setup buttons **** ********** */
/* ********** ******* ********** */

//when used with the native_posix_64 virtual device there are no buttons ...
//#if !(defined(CONFIG_BOARD_NATIVE_POSIX_64BIT))

#define SW0_NODE        DT_ALIAS(sw0)

#if DT_NODE_HAS_STATUS(SW0_NODE, okay)
//#define SW0_GPIO_LABEL  DT_GPIO_LABEL(SW0_NODE, gpios)
//#define SW0_GPIO_PIN    DT_GPIO_PIN(SW0_NODE, gpios)
//#define SW0_GPIO_FLAGS  (GPIO_INPUT | DT_GPIO_FLAGS(SW0_NODE, gpios))
#else
//TODO some warning about unsupported
//#error "Unsupported board: sw0 devicetree alias is not defined"
#define SW0_GPIO_LABEL  ""
#define SW0_GPIO_PIN    0
#define SW0_GPIO_FLAGS  0
#endif

#if defined(CONFIG_BOARD_PINETIME_DEVKIT0) //pinetime needs port 15 high for switch to work
#define SW1_NODE        DT_ALIAS(sw1)
#define SW1_GPIO_PIN    DT_GPIO_PIN(SW1_NODE, gpios)
#define SW1_GPIO_FLAGS  (GPIO_OUTPUT | DT_GPIO_FLAGS(SW1_NODE, gpios))
#define BUTTON_THRESH 4 //threshold to distinguish between short and long press
#define BUTTON_DOUBLE_THRESH 2 //double click
#endif

#if defined(CONFIG_BOARD_NATIVE_POSIX_64BIT)
#define BUTTON_THRESH 6 //threshold to distinguish between short and long press
//when used in a real watch it will probable have to be less
#define BUTTON_DOUBLE_THRESH 12 //double click
#endif

#if defined(CONFIG_BOARD_DS_D6)
#define BUTTON_THRESH 3 //threshold to distinguish between short and long press
#define BUTTON_DOUBLE_THRESH 2 //double click
#endif



static uint8_t button_press_cnt;
//struct k_timer button_timer;




//when the timer expires the number of presses is analysed
void button_timer_handler(struct k_timer *dummy)
{
	//TODO LOGGIN
	//LOG_INF("timer expired\n");
	//LOG_INF("press count %d\n", button_press_cnt);
	if (button_press_cnt >= BUTTON_DOUBLE_THRESH){
	//	LOG_INF("long press\n");

		//TODO DISPLAY button event
		//display_btn_event(BTN1_LONG);
	}
	if (button_press_cnt <= BUTTON_THRESH){ //short press is used to scroll trough the labels with their value
	//	LOG_INF("short press\n");
		//TODO DISPLAY button event
		//display_btn_event(BTN1_SHORT);
		//  show_label(label_select_cnt);
		//  label_select_cnt++;
		// if (label_select_cnt ==  PARAM_TOTAL) label_select_cnt=0;
	}
	if ((button_press_cnt > BUTTON_THRESH) && (button_press_cnt < BUTTON_DOUBLE_THRESH)){
	//	LOG_INF("double click\n");
	}
	button_press_cnt=0;


}

/*timer used to detect lenght of pushing*/
struct k_timer button_timer;
K_TIMER_DEFINE(button_timer, button_timer_handler,NULL);





void button_pressed(const struct device *dev, struct gpio_callback *cb,
		uint32_t pins)
{
	buttons_id_t btn_id;
//TODO loggin
//	LOG_INF("Button pressed at %" PRIu32 "\n", k_cycle_get_32());

	if (button_press_cnt == 0U) {
		k_timer_start(&button_timer, K_SECONDS(1), K_NO_WAIT);
		btn_id=BTN1_SHORT;
	}

	if (k_timer_status_get(&button_timer) > 0) {
		/* timer has expired */
		//display_btn_event(BTN1_SHORT);
		button_press_cnt=0;
	} else  {
		/* timer still running */
		button_press_cnt++;
	}



}

//TODO adapt to posix
//this is used in case of native_posix -- virtual button
//static void button_event_cb(lv_obj_t * obj, lv_event_t event)
//void button_event_cb(lv_obj_t * obj, lv_event_t event)
//static void button_event_cb(void)
//{

 //       LOG_INF("Button pressed at %" PRIu32 "\n", k_cycle_get_32());
  //      if (button_press_cnt == 0U) {
   //             k_timer_start(&button_timer, K_SECONDS(1), K_NO_WAIT);
//                printf("Buttontime started" );
 //       }

  //      if (k_timer_status_get(&button_timer) > 0) {
   //             button_press_cnt=0;
    //    } else  {
                /* timer still running */
     //           button_press_cnt++;
      //  }

//}


//TODO DT_NODE_HAS_STATUS condition
static struct gpio_callback button_cb_data;
static const struct gpio_dt_spec button = GPIO_DT_SPEC_GET_OR(SW0_NODE, gpios, {0});

void init_button(void)
{
//	const struct device *button;
	int ret;
//button = device_get_binding(SW0_GPIO_LABEL);
	//int val = gpio_pin_get_dt(&button);
	//if (val >= 0) {
		//printk("Error: didn't find %s device\n", SW0_GPIO_LABEL);
	//	printk("Error: didn't find %s device\n", button.port->name);
		//printk("Error: didn't find  device\n");
	//	return;
	//}
        if (!device_is_ready(button.port)) {
                printk("Error: button device %s is not ready\n", button.port->name);
                return;
        }
	//ret = gpio_pin_configure(button, SW0_GPIO_PIN, SW0_GPIO_FLAGS);
	//ret = gpio_pin_configure(val, SW0_GPIO_PIN, SW0_GPIO_FLAGS);
	ret = gpio_pin_configure_dt(&button, GPIO_INPUT);
	if (ret != 0) {
		printk("Error %d: failed to configure %s pin %d\n", ret, button.port->name, button.pin);
		//printk("Error %d: failed to configure %s pin %d\n",
		//printk("Error  failed to configure  pin \n");
		return;
	}
        ret = gpio_pin_interrupt_configure_dt(&button, GPIO_INT_EDGE_TO_ACTIVE);
	if (ret != 0) {
	                printk("Error %d: failed to configure interrupt on %s pin %d\n", ret, button.port->name, button.pin);
	                return;
        }
//	ret = gpio_pin_interrupt_configure(val,
//			SW0_GPIO_PIN,
//			GPIO_INT_EDGE_TO_ACTIVE);
//	if (ret != 0) {
	//	printk("Error %d: failed to configure interrupt on %s pin %d\n",
	//			ret, SW0_GPIO_LABEL, SW0_GPIO_PIN);
//		printk("Error  failed to interrupt on  pin \n");
//		return;
//	}
#if defined(CONFIG_BOARD_PINETIME_DEVKIT0)
	//port 15 has to be high in order for the button to work


	//gpio_pin_configure(button, SW1_GPIO_PIN,SW1_GPIO_FLAGS); //push button out
	//gpio_pin_configure(val, SW1_GPIO_PIN,SW1_GPIO_FLAGS); //push button out
	//gpio_pin_configure(val, SW1_GPIO_PIN,SW1_GPIO_FLAGS); //push button out
//	ret = gpio_pin_configure_dt(&button, SW1_GPIO_PIN);
	//gpio_pin_set(button, SW1_GPIO_PIN, 1); //set port high
//	gpio_pin_set(val, SW1_GPIO_PIN, 1); //set port high

//TODO in board definition key_out is defined, by default high -- does this work?

#endif


        gpio_init_callback(&button_cb_data, button_pressed, BIT(button.pin));
        gpio_add_callback(button.port, &button_cb_data);

	//gpio_init_callback(&button_cb_data, button_pressed, BIT(SW0_GPIO_PIN));
	//gpio_add_callback(button, &button_cb_data);
	//gpio_add_callback(val, &button_cb_data);
	//printk("Set up button at %s pin %d\n", SW0_GPIO_LABEL, SW0_GPIO_PIN);
	printk("Set up button at pin \n");



}
//#endif

//static struct gpio_callback button_cb;

/* ********** ********* ********** */


/* ********** init function ********** */
void event_handler_init()
{

	/* Start timers */
	k_timer_init(&clock_update_timer, handle_clock_update, NULL); //jj
	k_timer_start(&clock_update_timer,CLOCK_UPDATE, K_NO_WAIT); //jj

	clock_show_time();

	LOG_DBG("Event handler init: Done");
}
/* ********** ************ ********** */

/* ********** interrupt handlers ********** */


void button_pressed_isr(const struct device *gpiobtn, struct gpio_callback *cb, uint32_t pins)
{
	//backlight_switch(true);

	handle_button_event();
}

void handle_clock_update(struct k_timer *clock_update) //jj if clock displayed, it should get the updated time
{
	printk("handle_clock_update\n");
	clock_increment_local_time();
	clock_show_time();
	//TODO
	//display_clock_update(); //multiple screens but clock only appears in 1st
	k_timer_start(clock_update,CLOCK_UPDATE, K_NO_WAIT); //timer gets started again -- perpetuum mobile
}


/* ********** ************** ********** */
int handle_button_event(void)
{
	clock_increment_local_time();
	clock_show_time();
	return 1;
}
```
