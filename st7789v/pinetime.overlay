/*
 * Copyright (c) 2019 Creative JJ
 *
 * SPDX-License-Identifier: Apache-2.0
 */

&spi0 {
	status = "okay";
	sck-pin = <2>;
	mosi-pin = <3>;
	miso-pin = <4>;
	cs-gpios = <&gpio0 25 0>;

	st7789v@0 {
		compatible = "sitronix,st7789v";
		label = "DISPLAY";
		spi-max-frequency = <8000000>;
		reg = <0>;
		cmd-data-gpios = <&gpio0 18 0>;
		reset-gpios = <&gpio0 26 0>;
		width = <240>;
		height = <240>;
		x-offset = <0>;
		y-offset = <0>;
	};
};
