/*
 * Copyright (c) 2019 Creative JJ
 *
 * SPDX-License-Identifier: Apache-2.0
 */

&spi0 {
	status = "okay";
	sck-pin = <2>;
	mosi-pin = <3>;
	miso-pin = <4>;
	cs-gpios = <&gpio0 25 0>;

	st7789v@0 {
		compatible = "sitronix,st7789v";
		label = "DISPLAY";
		spi-max-frequency = <8000000>;
		reg = <0>;
		cmd-data-gpios = <&gpio0 18 0>;
		reset-gpios = <&gpio0 26 0>;
		width = <240>;
		height = <240>;
		x-offset = <0>;
		y-offset = <0>;


 


 
		vcom = <0x19>;


 
		gctrl = <0x35>;


 
		vrhs = <0x12>;


 
		vdvs = <0x20>;


 
		mdac = <0x00>;


 
		gamma = <0x01>;


 
		colmod = <0x05>;


 
		lcm = <0x2c>;


 
		porch-param = [0c 0c 00 33 33];


 
		cmd2en-param = [5a 69 02 01];


 
		pwctrl1-param = [a4 a1];


 
		pvgam-param = [D0 04 0D 11 13 2B 3F 54 4C 18 0D 0B 1F 23];


 
		nvgam-param = [D0 04 0C 11 13 2C 3F 44 51 2F 1F 1F 20 23];


 
		ram-param = [00 F0];


 
		rgb-param = [CD 08 14];
	};
};
