## samples/shell_bt_nus/build_1/Kconfig/Kconfig.modules
```kconfig
menu "nrf (/home/naj/ncs/v2.4.0/nrf)"
osource "/home/naj/ncs/v2.4.0/nrf/Kconfig.nrf"
config ZEPHYR_NRF_MODULE
	bool
	default y
endmenu
menu "hostap (/home/naj/ncs/v2.4.0/modules/lib/hostap)"
osource "/home/naj/ncs/v2.4.0/modules/lib/hostap/zephyr/Kconfig"
config ZEPHYR_HOSTAP_MODULE
	bool
	default y
endmenu
menu "mcuboot (/home/naj/ncs/v2.4.0/bootloader/mcuboot)"
osource "$(ZEPHYR_MCUBOOT_KCONFIG)"
config ZEPHYR_MCUBOOT_MODULE
	bool
	default y
endmenu
menu "mbedtls (/home/naj/ncs/v2.4.0/modules/crypto/mbedtls)"
osource "$(ZEPHYR_MBEDTLS_KCONFIG)"
config ZEPHYR_MBEDTLS_MODULE
	bool
	default y
endmenu
menu "trusted-firmware-m (/home/naj/ncs/v2.4.0/modules/tee/tf-m/trusted-firmware-m)"
osource "$(ZEPHYR_TRUSTED_FIRMWARE_M_KCONFIG)"
config ZEPHYR_TRUSTED_FIRMWARE_M_MODULE
	bool
	default y
endmenu
menu "cjson (/home/naj/ncs/v2.4.0/modules/lib/cjson)"
osource "$(ZEPHYR_CJSON_KCONFIG)"
config ZEPHYR_CJSON_MODULE
	bool
	default y
endmenu
menu "azure-sdk-for-c (/home/naj/ncs/v2.4.0/modules/lib/azure-sdk-for-c)"
osource "$(ZEPHYR_AZURE_SDK_FOR_C_KCONFIG)"
config ZEPHYR_AZURE_SDK_FOR_C_MODULE
	bool
	default y
endmenu
menu "cirrus-logic (/home/naj/ncs/v2.4.0/modules/hal/cirrus-logic)"
osource "/home/naj/ncs/v2.4.0/modules/hal/cirrus-logic/Kconfig"
config ZEPHYR_CIRRUS_LOGIC_MODULE
	bool
	default y
endmenu
menu "openthread (/home/naj/ncs/v2.4.0/modules/lib/openthread)"
osource "$(ZEPHYR_OPENTHREAD_KCONFIG)"
config ZEPHYR_OPENTHREAD_MODULE
	bool
	default y
endmenu
menu "memfault-firmware-sdk (/home/naj/ncs/v2.4.0/modules/lib/memfault-firmware-sdk)"
osource "/home/naj/ncs/v2.4.0/modules/lib/memfault-firmware-sdk/ports/zephyr/Kconfig"
config ZEPHYR_MEMFAULT_FIRMWARE_SDK_MODULE
	bool
	default y
endmenu
menu "canopennode (/home/naj/ncs/v2.4.0/modules/lib/canopennode)"
osource "$(ZEPHYR_CANOPENNODE_KCONFIG)"
config ZEPHYR_CANOPENNODE_MODULE
	bool
	default y
endmenu
menu "chre (/home/naj/ncs/v2.4.0/modules/lib/chre)"
osource "/home/naj/ncs/v2.4.0/modules/lib/chre/platform/zephyr/Kconfig"
config ZEPHYR_CHRE_MODULE
	bool
	default y
endmenu
menu "fatfs (/home/naj/ncs/v2.4.0/modules/fs/fatfs)"
osource "$(ZEPHYR_FATFS_KCONFIG)"
config ZEPHYR_FATFS_MODULE
	bool
	default y
endmenu
menu "hal_nordic (/home/naj/ncs/v2.4.0/modules/hal/nordic)"
osource "$(ZEPHYR_HAL_NORDIC_KCONFIG)"
config ZEPHYR_HAL_NORDIC_MODULE
	bool
	default y
endmenu
menu "liblc3 (/home/naj/ncs/v2.4.0/modules/lib/liblc3)"
osource "$(ZEPHYR_LIBLC3_KCONFIG)"
config ZEPHYR_LIBLC3_MODULE
	bool
	default y
endmenu
menu "littlefs (/home/naj/ncs/v2.4.0/modules/fs/littlefs)"
osource "$(ZEPHYR_LITTLEFS_KCONFIG)"
config ZEPHYR_LITTLEFS_MODULE
	bool
	default y
endmenu
menu "loramac-node (/home/naj/ncs/v2.4.0/modules/lib/loramac-node)"
osource "$(ZEPHYR_LORAMAC_NODE_KCONFIG)"
config ZEPHYR_LORAMAC_NODE_MODULE
	bool
	default y
endmenu
menu "lvgl (/home/naj/ncs/v2.4.0/modules/lib/gui/lvgl)"
osource "/home/naj/ncs/v2.4.0/modules/lib/gui/lvgl/zephyr/Kconfig"
config ZEPHYR_LVGL_MODULE
	bool
	default y
endmenu
menu "lz4 (/home/naj/ncs/v2.4.0/modules/lib/lz4)"
osource "$(ZEPHYR_LZ4_KCONFIG)"
config ZEPHYR_LZ4_MODULE
	bool
	default y
endmenu
menu "nanopb (/home/naj/ncs/v2.4.0/modules/lib/nanopb)"
osource "$(ZEPHYR_NANOPB_KCONFIG)"
config ZEPHYR_NANOPB_MODULE
	bool
	default y
endmenu
menu "picolibc (/home/naj/ncs/v2.4.0/modules/lib/picolibc)"
osource "/home/naj/ncs/v2.4.0/modules/lib/picolibc/zephyr/Kconfig"
config ZEPHYR_PICOLIBC_MODULE
	bool
	default y
endmenu
menu "segger (/home/naj/ncs/v2.4.0/modules/debug/segger)"
osource "$(ZEPHYR_SEGGER_KCONFIG)"
config ZEPHYR_SEGGER_MODULE
	bool
	default y
endmenu
menu "TraceRecorder (/home/naj/ncs/v2.4.0/modules/debug/TraceRecorder)"
osource "/home/naj/ncs/v2.4.0/modules/debug/TraceRecorder/kernelports/Zephyr/Kconfig"
config ZEPHYR_TRACERECORDER_MODULE
	bool
	default y
endmenu
menu "uoscore-uedhoc (/home/naj/ncs/v2.4.0/modules/lib/uoscore-uedhoc)"
osource "$(ZEPHYR_UOSCORE_UEDHOC_KCONFIG)"
config ZEPHYR_UOSCORE_UEDHOC_MODULE
	bool
	default y
endmenu
menu "zcbor (/home/naj/ncs/v2.4.0/modules/lib/zcbor)"
osource "$(ZEPHYR_ZCBOR_KCONFIG)"
config ZEPHYR_ZCBOR_MODULE
	bool
	default y
endmenu
menu "zscilib (/home/naj/ncs/v2.4.0/modules/lib/zscilib)"
osource "/home/naj/ncs/v2.4.0/modules/lib/zscilib/Kconfig.zscilib"
config ZEPHYR_ZSCILIB_MODULE
	bool
	default y
endmenu
menu "nrfxlib (/home/naj/ncs/v2.4.0/nrfxlib)"
osource "/home/naj/ncs/v2.4.0/nrfxlib/Kconfig.nrfxlib"
config ZEPHYR_NRFXLIB_MODULE
	bool
	default y
endmenu
menu "connectedhomeip (/home/naj/ncs/v2.4.0/modules/lib/matter)"
osource "/home/naj/ncs/v2.4.0/modules/lib/matter/config/nrfconnect/chip-module/Kconfig"
config ZEPHYR_CONNECTEDHOMEIP_MODULE
	bool
	default y
endmenu
```

## samples/shell_bt_nus/build_2/Kconfig/Kconfig.shield
```kconfig
osource "/home/naj/ncs/v2.4.0/zephyr/samples/subsys/display/lvgl/boards/shields/*/Kconfig.shield"
osource "/home/naj/ncs/v2.4.0/nrf/boards/shields/*/Kconfig.shield"
```

## subsys/battery/Kconfig
```kconfig
config BATTERY
    bool "Battery measurement"
    select ADC
    select ADC_0
    #select CONFIG_NRFX_SAADC #if battery skips adc api
    help
      Enable battery measurement

if BATTERY

config BATTERY_SHELL
    bool "Shell commands"
    default y
    depends on SHELL
    help
      Enable shell commands for battery

endif
```

## west.yml
```yaml
# The west manifest file for the Pinetime.
#
# The per-installation west configuration file specifies the location of this
# manifest file. The "path" option in the [manifest] section of .west/config
# defines the folder that contains west.yml. The path is relative to the folder
# that contains .west.
#
# You can create your own manifest files and put them in any
# repository you want, to create your own custom Pinetime installation.
# For example, you could create a manifest file in your own
# out-of-tree application directory, which would pull the pinetime repository
# in as an ordinary project.
#
# You can pass your manifest repositories to west init when creating a
# new pinetime installation. See the west documentation for more
# information.

manifest:
  defaults:
    remote: pinetime

  remotes:
    - name: pinetime
      url-base: https://github.com/nordic-krch
    - name: zephyrproject
      url-base: https://github.com/zephyrproject-rtos
    - name: armmbed
      url-base: https://github.com/ARMmbed

  # The list of external projects for the Pinetime.
  #
  projects:
    - name: zephyr
      west-commands: scripts/west-commands.yml
      revision: cbe6edcfa7049d02b8f2215abc8ccb828c86d646
      remote: zephyrproject
    - name: ci-tools
      revision: eb7f1e19eff28d486c64b850ef7b9dcd0331a7af
      path: tools/ci-tools
      remote: zephyrproject
    - name: fatfs
      revision: 0c1288bb817c1976388e0f55e8483f671ae437ab
      path: modules/fs/fatfs
      remote: zephyrproject
    - name: hal_nordic
      revision: 8506c348b6da91a9f53bcbb181ecd82b752b9eed
      path: modules/hal/nordic
      remote: zephyrproject
    - name: libmetal
      revision: 45e630d6152824f807d3f919958605c4626cbdff
      path: modules/hal/libmetal
      remote: zephyrproject
    - name: lvgl
      revision: 74fc2e753a997bd71cefa34dd9c56dcb954b42e2
      path: modules/lib/gui/lvgl
      remote: zephyrproject
    - name: mbedtls
      revision: 3776c158fe138a72c97c187e4d31c81c37884be9
      path: modules/crypto/mbedtls
      remote: zephyrproject
    - name: mcuboot
      revision: c2bd757332bfde11c27019f937b0c61d5e9b9fd9
      path: bootloader/mcuboot
      remote: zephyrproject
    - name: mcumgr
      revision: b18b3d16441f40cf983aa034258e8f7c97bfe9bf
      path: modules/lib/mcumgr
      remote: zephyrproject
    - name: net-tools
      revision: 30b7efa827b04d2e47840716b0372737fe7d6c92
      path: tools/net-tools
      remote: zephyrproject
    - name: nffs
      revision: 00dd4fab1a00f2f6e995ef3f2e7c3814689f8885
      path: modules/fs/nffs
      remote: zephyrproject
    - name: open-amp
      revision: 9b591b289e1f37339bd038b5a1f0e6c8ad39c63a
      path: modules/lib/open-amp
      remote: zephyrproject
    - name: segger
      revision: 6fcf61606d6012d2c44129edc033f59331e268bc
      path: modules/debug/segger
      remote: zephyrproject
    - name: tinycbor
      path: modules/lib/tinycbor
      revision: 0fc68fceacd1efc1ce809c5880c380f3d98b7b6e
      remote: zephyrproject
    - name: littlefs
      path: modules/fs/littlefs
      revision: fe9572dd5a9fcf93a249daa4233012692bd2881d
      remote: zephyrproject
    - name: mipi-sys-t
      path: modules/debug/mipi-sys-t
      revision: baf51863f19f009b92e762115ba5572a5b996b92
      remote: zephyrproject
    - name: nrf_hw_models
      path: modules/bsim_hw_models/nrf_hw_models
      revision: fec69703cb1ca06fcdab6d5fde01274f0fc5c759
      remote: zephyrproject
    - name: edtt
      path: tools/edtt
      revision: dd4dd502ef2fbeced6ef7faaba562a7ddca45632
      remote: zephyrproject

  self:
    path: pinetime
```
