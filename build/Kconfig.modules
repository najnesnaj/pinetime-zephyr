## docs/app/build/Kconfig/Kconfig.modules
```kconfig
menu "hal_nordic (/root/work/modules/hal/nordic)"
osource "$(ZEPHYR_HAL_NORDIC_KCONFIG)"
config ZEPHYR_HAL_NORDIC_MODULE
	bool
	default y
endmenu
menu "sof (/root/work/modules/audio/sof)"
osource "/root/work/modules/audio/sof/zephyr/Kconfig"
config ZEPHYR_SOF_MODULE
	bool
	default y
endmenu
menu "oswatch_drivers (/root/work/app/oswatch-bt/oswatch_drivers)"
osource "/root/work/app/oswatch-bt/oswatch_drivers/zephyr/Kconfig"
config ZEPHYR_OSWATCH_DRIVERS_MODULE
	bool
	default y
endmenu
```

## docs/app/build/Kconfig/Kconfig.shield
```kconfig
osource "/root/work/app/oswatch-bt/boards/shields/*/Kconfig.shield"
osource "/root/work/zephyr/boards/shields/*/Kconfig.shield"
osource "/root/work/zephyr/boards/shields/*/Kconfig.shield"
```

## docs/app/samples/hrs3300/sample.yaml
```yaml
sample:
  description: TBD
  name: TBD
tests:
  sample.sensor.hrs3300:
    harness: sensor
    tags: sensors
    depends_on: i2c
```

## docs/app/samples/sdlbutton/boards/pinetime_devkit1.conf
```kconfig
CONFIG_ST7789V=y
CONFIG_LVGL_FONT_MONTSERRAT_28=y
CONFIG_LVGL_FONT_MONTSERRAT_14=n
CONFIG_KSCAN2=y
CONFIG_KSCAN_FT9999_PERIOD=10
CONFIG_KSCANR2_INIT_PRIORITY=40
CONFIG_KSCAN_FT9999=y
CONFIG_LVGL_DISPLAY_DEV_NAME="ST7789V"
#CONFIG_LVGL_HOR_RES_MAX=240
#CONFIG_LVGL_VER_RES_MAX=240
#CONFIG_LVGL_VDB_SIZE=5
#CONFIG_LVGL_BITS_PER_PIXEL=32
```

## drivers/Kconfig
```kconfig
# drivers configuration options

# Copyright (c) 2015 Intel Corporation
# SPDX-License-Identifier: Apache-2.0

menu "Device Drivers"


source "drivers/sensor/Kconfig"


endmenu
```

## drivers/sensor/Kconfig
```kconfig
# Sensor configuration options

# Copyright (c) 2016 Intel Corporation
# SPDX-License-Identifier: Apache-2.0


menu "Sensor drivers"


rsource "bma421/Kconfig"

rsource "hrs3300/Kconfig"

rsource "cst816s/Kconfig"

endmenu
```

## drivers/sensor/bma421/Kconfig
```kconfig
# BMA421 Three Axis Accelerometer configuration options

# Copyright (c) 2016 Intel Corporation
# SPDX-License-Identifier: Apache-2.0

menuconfig BMA421
	bool "BMA421 Three Axis Accelerometer Family"
	depends on I2C
	help
	  Enable driver for BMA421 I2C-based triaxial accelerometer sensor
	  family.

if BMA421

choice
	prompt "Chip type"
	default BMA421_CHIP_BMA421
	help
	  Choose desired chip type from the BMA421 family.

config BMA421_CHIP_BMA421
	bool "BMA421"
	help
	  Choose this option to enable the BMA421 chip.

endchoice

config BMA421_NAME
	string "Driver name"
	default "BMA421" if BMA421_CHIP_BMA421
	help
	  Device name with which the sensor is identified.

config BMA421_I2C_ADDR
	hex "BMA421 I2C address"
	default 0x18 if BMA421_CHIP_BMA421
	help
	  I2C address of the BMA421 sensor.

	  0x10: Use if the SDO pin is pulled to GND.
	  0x10: Use if the SDO pin is pulled to VDDIO.
	  0x18: Use if the SDO pin is pulled to GND.
	  0x19: Use if the SDO pin is pulled to VDDIO.

config BMA421_I2C_MASTER_DEV_NAME
	string "I2C master device name"
	default "I2C_1"
	help
	  Specify the device name of the I2C master device to which chip is
	  connected.

choice
	prompt "Trigger mode"
	default BMA421_TRIGGER_GLOBAL_THREAD
	help
	  Specify the type of triggering to be used by the driver.

config BMA421_TRIGGER_NONE
	bool "No trigger"

config BMA421_TRIGGER_GLOBAL_THREAD
	bool "Use global thread"
	depends on GPIO
	select BMA421_TRIGGER

config BMA421_TRIGGER_OWN_THREAD
	bool "Use own thread"
	depends on GPIO
	select BMA421_TRIGGER

endchoice

config BMA421_TRIGGER
	bool

config BMA421_GPIO_DEV_NAME
	string "GPIO device"
	default "GPIO_0"
	depends on BMA421_TRIGGER
	help
	  The device name of the GPIO device to which the chip's interrupt pins
	  are connected.

config BMA421_GPIO_PIN_NUM
	int "Interrupt GPIO pin number"
	default 8
	depends on BMA421_TRIGGER
	help
	  The number of the GPIO on which the interrupt signal from the chip
	  will be received.

config BMA421_THREAD_PRIORITY
	int "Thread priority"
	depends on BMA421_TRIGGER_OWN_THREAD
	default 10
	help
	  Priority of thread used by the driver to handle interrupts.

config BMA421_THREAD_STACK_SIZE
	int "Thread stack size"
	depends on BMA421_TRIGGER_OWN_THREAD
	default 1024
	help
	  Stack size of thread used by the driver to handle interrupts.

choice
	prompt "Acceleration measurement range"
	default BMA421_ACC_RANGE_2G
	help
	  Measurement range for acceleration values.

config BMA421_ACC_RANGE_2G
	bool "+/-2g"

config BMA421_ACC_RANGE_4G
	bool "+/-4g"

config BMA421_ACC_RANGE_8G
	bool "+/-8g"

config BMA421_ACC_RANGE_16G
	bool "+/-16g"

endchoice

choice
	prompt "Acceleration data filter bandwidth"
	default BMA421_ACC_ODR_7
	help
	  Bandwidth of filtered acceleration data.

config BMA421_ACC_ODR_1
	bool "7.81Hz"

config BMA421_ACC_ODR_2
	bool "15.63HZ"

config BMA421_ACC_ODR_3
	bool "31.25Hz"

config BMA421_ACC_ODR_4
	bool "62.5Hz"

config BMA421_ACC_ODR_5
	bool "125Hz"

config BMA421_ACC_ODR_6
	bool "250HZ"

config BMA421_ACC_ODR_7
	bool "500Hz"

config BMA421_ACC_ODR_8
	bool "1000Hz"

config BMA421_ACC_ODR_9
	bool "2000Hz"

config BMA421_ACC_ODR_10
	bool "4000Hz"

config BMA421_ACC_ODR_11
	bool "8000Hz"

config BMA421_ACC_ODR_12
	bool "16000Hz"

config BMA421_PMU_ODR_13
	bool "unfiltered"

endchoice

endif # BMA421
```

## drivers/sensor/cst816s/Kconfig
```kconfig
# CST816S Hynitron touchscreen
# SPDX-License-Identifier: Apache-2.0
#
#menuconfig CST816S
#	bool "hynitron cst816 touchscreen "
#	depends on I2C
#	help
#	 Enable driver for hynitron touchscreen. 
menuconfig CST816S
        bool "CST816S Touchscreen"
        depends on I2C
        help
          Enable driver for hynitron touchscreen. 

if CST816S

config CST816S_NAME
	string "Driver name"
	default "CST816S" if CST816S_CHIP_CST816S
	help
	  Device name with which the sensor is identified.

config CST816S_I2C_ADDR
	hex "CST816S I2C address"
	default 0x15
	help
	  I2C address of the CST816S sensor.

config CST816S_I2C_MASTER_DEV_NAME
	string "I2C master device name"
	default "I2C_1"
	help
	  Specify the device name of the I2C master device to which chip is
	  connected.


config CST816S_GPIO_DEV_NAME
	string "GPIO device"
	default "GPIO_0"
	depends on CST816S_TRIGGER
	help
	  The device name of the GPIO device to which the chip's interrupt pins
	  are connected.

config CST816S_GPIO_PIN_NUM
	int "Interrupt GPIO pin number"
	default 28
	depends on CST816S_TRIGGER
	help
	  The number of the GPIO on which the interrupt signal from the chip
	  will be received.

config CST816S_THREAD_PRIORITY
	int "Thread priority"
	depends on CST816S_TRIGGER_OWN_THREAD
	default 10
	help
	  Priority of thread used by the driver to handle interrupts.

config CST816S_THREAD_STACK_SIZE
	int "Thread stack size"
	depends on CST816S_TRIGGER_OWN_THREAD
	default 1024
	help
	  Stack size of thread used by the driver to handle interrupts.





choice
	prompt "Trigger mode"
	default CST816S_TRIGGER_NONE
	help
	  Specify the type of triggering used by the driver.

config CST816S_TRIGGER_NONE
	bool "No trigger"

config CST816S_TRIGGER_GLOBAL_THREAD
	bool "Use global thread"
	depends on GPIO
	select CST816S_TRIGGER

config CST816S_TRIGGER_OWN_THREAD
	bool "Use own thread"
	depends on GPIO
	select CST816S_TRIGGER

endchoice

config CST816S_TRIGGER
	bool

config CST816S_THREAD_PRIORITY
	int "Thread priority"
	depends on CST816S_TRIGGER_OWN_THREAD && CST816S_TRIGGER
	default 10
	help
	  Priority of thread used by the driver to handle interrupts.

config CST816S_THREAD_STACK_SIZE
	int "Thread stack size"
	depends on CST816S_TRIGGER_OWN_THREAD && CST816S_TRIGGER
	default 1024
	help
	  Stack size of thread used by the driver to handle interrupts.

config CST816S_ACTIVITY_THRESHOLD
	int "Upper threshold value"
	default 1000
	help
	  Unsigned value that the adxl362 samples are
	  compared to in activity trigger mode.

config CST816S_INACTIVITY_THRESHOLD
	int "Lower threshold value"
	default 100
	help
	  Unsigned value that the adxl362 samples are
	  compared to in inactivity trigger mode.

config CST816S_INTERRUPT_MODE
	int "Activity and inactivity interrupt mode"
	default 0
	help
	  Unsigned value that sets the CST816S in different
	  interrupt modes.
	  0 - Default mode
	  1 - Linked mode
	  3 - Loop mode






endif # CST816S
```

## dts/bindings/sensor/bosch,bma421-i2c.yaml
```yaml
# Copyright (c) 2019, Linaro Limited
# SPDX-License-Identifier: Apache-2.0


description:  This is a representation of the BME280 Integrated environmental sensor

compatible: "bosch,bma421"

include: i2c-device.yaml

properties:
            int1-gpios:
                      type: phandle-array
                      required: false
```

## dts/bindings/sensor/hx,hrs3300.yaml
```yaml
# Copyright (c) 2018, NXP
# SPDX-License-Identifier: Apache-2.0


description: This is a representation of the HRS3300 heart rate sensor

compatible: "hx,hrs3300"

include: i2c-device.yaml
```

## dts/bindings/sensor/hynitron,cst816s.yaml
```yaml
# SPDX-License-Identifier: Apache-2.0


description: This is a representation of the Hynitron,CST816S touchscreen sensor

compatible: "hynitron,cst816s"

include: i2c-device.yaml

properties:
            int1-gpios:
                      type: phandle-array
                      required: false
```

## pinetime/pinetime_defconfig
```kconfig
# SPDX-License-Identifier: Apache-2.0

CONFIG_ARM=y
CONFIG_SOC_FAMILY_NRF=y
CONFIG_SOC_SERIES_NRF52X=y
CONFIG_SOC_NRF52832_QFAA=y
CONFIG_BOARD_PINETIME=y

# Enable MPU
CONFIG_ARM_MPU=y

# enable GPIO
CONFIG_GPIO=y

# enable uart driver
#CONFIG_SERIAL=y
#CONFIG_UART_0_NRF_UART=y

# enable console
#CONFIG_CONSOLE=y
#CONFIG_UART_CONSOLE=y

# additional board options
CONFIG_GPIO_AS_PINRESET=y


#CONFIG_CLOCK_CONTROL_NRF=y
#CONFIG_CLOCK_CONTROL_NRF_K32SRC_SYNTH=y
#CONFIG_CLOCK_CONTROL_NRF_K32SRC_20PPM=y
#CONFIG_CLOCK_CONTROL_NRF_K32SRC_250PPM=y
#
CONFIG_CLOCK_CONTROL_NRF=y
# CONFIG_CLOCK_CONTROL_NRF_K32SRC_RC is not set
CONFIG_CLOCK_CONTROL_NRF_K32SRC_XTAL=y
# # CONFIG_CLOCK_CONTROL_NRF_K32SRC_SYNTH is not set
# # CONFIG_CLOCK_CONTROL_NRF_K32SRC_EXT_LOW_SWING is not set
# # CONFIG_CLOCK_CONTROL_NRF_K32SRC_EXT_FULL_SWING is not set
CONFIG_CLOCK_CONTROL_NRF_K32SRC_500PPM=y

CONFIG_SPI=y
CONFIG_DISPLAY=y
CONFIG_ST7789V=y
CONFIG_ST7789V_RGB565=y
CONFIG_LVGL_BITS_PER_PIXEL=16
CONFIG_LVGL_HOR_RES=240
CONFIG_LVGL_VER_RES=240
CONFIG_LVGL_DISPLAY_DEV_NAME="ST7789V"
```

## pinetime_devkit0/build/Kconfig/Kconfig.modules
```kconfig
menu "canopennode (/root/zephyrproject/modules/lib/canopennode)"
osource "$(ZEPHYR_CANOPENNODE_KCONFIG)"
config ZEPHYR_CANOPENNODE_MODULE
	bool
	default y
endmenu
menu "chre (/root/zephyrproject/modules/lib/chre)"
osource "/root/zephyrproject/modules/lib/chre/platform/zephyr/Kconfig"
config ZEPHYR_CHRE_MODULE
	bool
	default y
endmenu
menu "fatfs (/root/zephyrproject/modules/fs/fatfs)"
osource "$(ZEPHYR_FATFS_KCONFIG)"
config ZEPHYR_FATFS_MODULE
	bool
	default y
endmenu
menu "hal_espressif (/root/zephyrproject/modules/hal/espressif)"
osource "/root/zephyrproject/modules/hal/espressif/zephyr/Kconfig"
config ZEPHYR_HAL_ESPRESSIF_MODULE
	bool
	default y
endmenu
menu "hal_ethos_u (/root/zephyrproject/modules/hal/ethos_u)"
osource "$(ZEPHYR_HAL_ETHOS_U_KCONFIG)"
config ZEPHYR_HAL_ETHOS_U_MODULE
	bool
	default y
endmenu
menu "hal_gigadevice (/root/zephyrproject/modules/hal/gigadevice)"
osource "$(ZEPHYR_HAL_GIGADEVICE_KCONFIG)"
config ZEPHYR_HAL_GIGADEVICE_MODULE
	bool
	default y
endmenu
menu "hal_infineon (/root/zephyrproject/modules/hal/infineon)"
osource "$(ZEPHYR_HAL_INFINEON_KCONFIG)"
config ZEPHYR_HAL_INFINEON_MODULE
	bool
	default y
endmenu
menu "hal_nordic (/root/zephyrproject/modules/hal/nordic)"
osource "$(ZEPHYR_HAL_NORDIC_KCONFIG)"
config ZEPHYR_HAL_NORDIC_MODULE
	bool
	default y
endmenu
menu "hal_nxp (/root/zephyrproject/modules/hal/nxp)"
osource "$(ZEPHYR_HAL_NXP_KCONFIG)"
config ZEPHYR_HAL_NXP_MODULE
	bool
	default y
endmenu
menu "hal_rpi_pico (/root/zephyrproject/modules/hal/rpi_pico)"
osource "$(ZEPHYR_HAL_RPI_PICO_KCONFIG)"
config ZEPHYR_HAL_RPI_PICO_MODULE
	bool
	default y
endmenu
menu "silabs (/root/zephyrproject/modules/hal/silabs)"
osource "/root/zephyrproject/modules/hal/silabs/zephyr/Kconfig"
config ZEPHYR_SILABS_MODULE
	bool
	default y
endmenu
menu "hal_telink (/root/zephyrproject/modules/hal/telink)"
osource "/root/zephyrproject/modules/hal/telink/Kconfig"
config ZEPHYR_HAL_TELINK_MODULE
	bool
	default y
endmenu
menu "liblc3 (/root/zephyrproject/modules/lib/liblc3)"
osource "$(ZEPHYR_LIBLC3_KCONFIG)"
config ZEPHYR_LIBLC3_MODULE
	bool
	default y
endmenu
menu "littlefs (/root/zephyrproject/modules/fs/littlefs)"
osource "$(ZEPHYR_LITTLEFS_KCONFIG)"
config ZEPHYR_LITTLEFS_MODULE
	bool
	default y
endmenu
menu "loramac-node (/root/zephyrproject/modules/lib/loramac-node)"
osource "$(ZEPHYR_LORAMAC_NODE_KCONFIG)"
config ZEPHYR_LORAMAC_NODE_MODULE
	bool
	default y
endmenu
menu "lvgl (/root/zephyrproject/modules/lib/gui/lvgl)"
osource "/root/zephyrproject/modules/lib/gui/lvgl/zephyr/Kconfig"
config ZEPHYR_LVGL_MODULE
	bool
	default y
endmenu
menu "lz4 (/root/zephyrproject/modules/lib/lz4)"
osource "$(ZEPHYR_LZ4_KCONFIG)"
config ZEPHYR_LZ4_MODULE
	bool
	default y
endmenu
menu "mbedtls (/root/zephyrproject/modules/crypto/mbedtls)"
osource "$(ZEPHYR_MBEDTLS_KCONFIG)"
config ZEPHYR_MBEDTLS_MODULE
	bool
	default y
endmenu
menu "nanopb (/root/zephyrproject/modules/lib/nanopb)"
osource "$(ZEPHYR_NANOPB_KCONFIG)"
config ZEPHYR_NANOPB_MODULE
	bool
	default y
endmenu
menu "openthread (/root/zephyrproject/modules/lib/openthread)"
osource "$(ZEPHYR_OPENTHREAD_KCONFIG)"
config ZEPHYR_OPENTHREAD_MODULE
	bool
	default y
endmenu
menu "picolibc (/root/zephyrproject/modules/lib/picolibc)"
osource "/root/zephyrproject/modules/lib/picolibc/zephyr/Kconfig"
config ZEPHYR_PICOLIBC_MODULE
	bool
	default y
endmenu
menu "segger (/root/zephyrproject/modules/debug/segger)"
osource "$(ZEPHYR_SEGGER_KCONFIG)"
config ZEPHYR_SEGGER_MODULE
	bool
	default y
endmenu
menu "sof (/root/zephyrproject/modules/audio/sof)"
osource "/root/zephyrproject/modules/audio/sof/zephyr/Kconfig"
config ZEPHYR_SOF_MODULE
	bool
	default y
endmenu
menu "tflite-micro (/root/zephyrproject/modules/lib/tflite-micro)"
osource "$(ZEPHYR_TFLITE_MICRO_KCONFIG)"
config ZEPHYR_TFLITE_MICRO_MODULE
	bool
	default y
endmenu
menu "TraceRecorder (/root/zephyrproject/modules/debug/TraceRecorder)"
osource "/root/zephyrproject/modules/debug/TraceRecorder/kernelports/Zephyr/Kconfig"
config ZEPHYR_TRACERECORDER_MODULE
	bool
	default y
endmenu
menu "trusted-firmware-m (/root/zephyrproject/modules/tee/tf-m/trusted-firmware-m)"
osource "$(ZEPHYR_TRUSTED_FIRMWARE_M_KCONFIG)"
config ZEPHYR_TRUSTED_FIRMWARE_M_MODULE
	bool
	default y
endmenu
menu "trusted-firmware-a (/root/zephyrproject/modules/tee/tf-a/trusted-firmware-a)"
osource "$(ZEPHYR_TRUSTED_FIRMWARE_A_KCONFIG)"
config ZEPHYR_TRUSTED_FIRMWARE_A_MODULE
	bool
	default y
endmenu
menu "uoscore-uedhoc (/root/zephyrproject/modules/lib/uoscore-uedhoc)"
osource "$(ZEPHYR_UOSCORE_UEDHOC_KCONFIG)"
config ZEPHYR_UOSCORE_UEDHOC_MODULE
	bool
	default y
endmenu
menu "zcbor (/root/zephyrproject/modules/lib/zcbor)"
osource "$(ZEPHYR_ZCBOR_KCONFIG)"
config ZEPHYR_ZCBOR_MODULE
	bool
	default y
endmenu
menu "zscilib (/root/zephyrproject/modules/lib/zscilib)"
osource "/root/zephyrproject/modules/lib/zscilib/Kconfig.zscilib"
config ZEPHYR_ZSCILIB_MODULE
	bool
	default y
endmenu
menu "thrift (/root/zephyrproject/modules/lib/thrift)"
osource "$(ZEPHYR_THRIFT_KCONFIG)"
config ZEPHYR_THRIFT_MODULE
	bool
	default y
endmenu
```

## samples/oswatch-cts/boards/arm/pinetime_devkit1/Kconfig.board
```kconfig
# PineTime DevKit0 board configuration

# Copyright (c) 2020 Stephane Dorre <stephane.dorre@gmail.com>
# SPDX-License-Identifier: Apache-2.0
# Copyright (c) 2021 <najnesnaj@yahoo.com>

config BOARD_PINETIME_DEVKIT1
	bool "PineTime DevKit1"
	depends on SOC_NRF52832_QFAA
```
